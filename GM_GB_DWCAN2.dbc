VERSION ""

NS_ :

BS_:

BU_:
VAL_TABLE_ Sig0068 0 "FALSE" 1 "TRUE" ;
VAL_TABLE_ ACP3_MCU_CAN2_ClscCANHrtBtActv 0 "FALSE" 1 "TRUE" ;
VAL_TABLE_ Sig0094 0 "FALSE" 1 "TRUE" ;
VAL_TABLE_ Sig0098 0 "FALSE" 1 "TRUE" ;
VAL_TABLE_ Sig0111 0 "FALSE" 1 "TRUE" ;
VAL_TABLE_ Sig0112 0 "FALSE" 1 "TRUE" ;
VAL_TABLE_ AE44CAP_AE44CtlAngReqActvAuth 0 "FALSE" 1 "TRUE" ;
VAL_TABLE_ AE44OBG2P_Cnfd8 0 "Highly Speculative" 1 "Speculative" 2 "Confident" 3 "Highly Confident" ;
VAL_TABLE_ AE44OBG2P_Typ6 0 "NoObject" 1 "Straight_0Corner" 2 "Straight_1Corner" 3 "Straight_2Corners" 4 "Point" 5 "Curbstone" 6 "Blind Area" ;
VAL_TABLE_ AE44OBG2P_Cnfd4 0 "Highly Speculative" 1 "Speculative" 2 "Confident" 3 "Highly Confident" ;
VAL_TABLE_ AE44OBG2P_Hght7 0 "Unknown" 1 "Traversable" 2 "High_Object" 3 "Low_Object" ;
VAL_TABLE_ AE44OBG2P_Hght8 0 "Unknown" 1 "Traversable" 2 "High_Object" 3 "Low_Object" ;
VAL_TABLE_ AE44OBG2P_Typ4 0 "NoObject" 1 "Straight_0Corner" 2 "Straight_1Corner" 3 "Straight_2Corners" 4 "Point" 5 "Curbstone" 6 "Blind Area" ;
VAL_TABLE_ AE44OBG2P_Cnfd1 0 "Highly Speculative" 1 "Speculative" 2 "Confident" 3 "Highly Confident" ;
VAL_TABLE_ AE44OBG2P_Cnfd6 0 "Highly Speculative" 1 "Speculative" 2 "Confident" 3 "Highly Confident" ;
VAL_TABLE_ AE44OBG2P_Typ2 0 "NoObject" 1 "Straight_0Corner" 2 "Straight_1Corner" 3 "Straight_2Corners" 4 "Point" 5 "Curbstone" 6 "Blind Area" ;
VAL_TABLE_ AE44OBG2P_Cnfd3 0 "Highly Speculative" 1 "Speculative" 2 "Confident" 3 "Highly Confident" ;
VAL_TABLE_ AE44OBG2P_Hght5 0 "Unknown" 1 "Traversable" 2 "High_Object" 3 "Low_Object" ;
VAL_TABLE_ AE44OBG2P_Hght4 0 "Unknown" 1 "Traversable" 2 "High_Object" 3 "Low_Object" ;
VAL_TABLE_ AE44OBG2P_Cnfd5 0 "Highly Speculative" 1 "Speculative" 2 "Confident" 3 "Highly Confident" ;
VAL_TABLE_ AE44OBG2P_Hght2 0 "Unknown" 1 "Traversable" 2 "High_Object" 3 "Low_Object" ;
VAL_TABLE_ AE44OBG2P_Typ3 0 "NoObject" 1 "Straight_0Corner" 2 "Straight_1Corner" 3 "Straight_2Corners" 4 "Point" 5 "Curbstone" 6 "Blind Area" ;
VAL_TABLE_ AE44OBG2P_Cnfd7 0 "Highly Speculative" 1 "Speculative" 2 "Confident" 3 "Highly Confident" ;
VAL_TABLE_ AE44OBG2P_Typ1 0 "NoObject" 1 "Straight_0Corner" 2 "Straight_1Corner" 3 "Straight_2Corners" 4 "Point" 5 "Curbstone" 6 "Blind Area" ;
VAL_TABLE_ AE44OBG2P_Typ5 0 "NoObject" 1 "Straight_0Corner" 2 "Straight_1Corner" 3 "Straight_2Corners" 4 "Point" 5 "Curbstone" 6 "Blind Area" ;
VAL_TABLE_ AE44OBG2P_Hght3 0 "Unknown" 1 "Traversable" 2 "High_Object" 3 "Low_Object" ;
VAL_TABLE_ AE44OBG2P_Cnfd2 0 "Highly Speculative" 1 "Speculative" 2 "Confident" 3 "Highly Confident" ;
VAL_TABLE_ AE44OBG2P_Typ7 0 "NoObject" 1 "Straight_0Corner" 2 "Straight_1Corner" 3 "Straight_2Corners" 4 "Point" 5 "Curbstone" 6 "Blind Area" ;
VAL_TABLE_ AE44OBG2P_Hght6 0 "Unknown" 1 "Traversable" 2 "High_Object" 3 "Low_Object" ;
VAL_TABLE_ AE44OBG2P_Typ8 0 "NoObject" 1 "Straight_0Corner" 2 "Straight_1Corner" 3 "Straight_2Corners" 4 "Point" 5 "Curbstone" 6 "Blind Area" ;
VAL_TABLE_ AE44OBG2P_Hght1 0 "Unknown" 1 "Traversable" 2 "High_Object" 3 "Low_Object" ;
VAL_TABLE_ AE44SP_AE44StsAuth 0 "Off" 1 "Standby" 2 "Search_Phase" 3 "Exit_Park" 4 "Enabled" 5 "Guidance_Phase" 6 "Finished" 7 "Error" ;
VAL_TABLE_ AE44SP_AE44TransRngReqAuth 0 "No_Request" 1 "Park" 2 "Reverse" 3 "Neutral" 4 "Drive" ;
VAL_TABLE_ AE44SP_AE44TransRngActvnReqdAuth 0 "FALSE" 1 "TRUE" ;
VAL_TABLE_ Sig0224 0 "FALSE" 1 "TRUE" ;
VAL_TABLE_ Sig0304 0 "FALSE" 1 "TRUE" ;
VAL_TABLE_ SuprRmtPrkPwrModeReq 0 "No Request" 1 "Off" 2 "Propulsion" ;
VAL_TABLE_ SuprRmtPrkDrLckReq 0 "No Request" 1 "Lock" 2 "Unlock" ;
VAL_TABLE_ ASOCNP_LKATakeStrgIndOnAuth 0 "FALSE" 1 "TRUE" ;
VAL_TABLE_ Sig0116 0 "FALSE" 1 "TRUE" ;
VAL_TABLE_ Sig0125 0 "Highly Speculative" 1 "Speculative" 2 "Confident" 3 "Highly Confident" ;
VAL_TABLE_ Sig0129 0 "Following" 1 "Oncoming" 2 "Following Goup" 3 "Oncoming Group" 4 "Unknown" ;
VAL_TABLE_ Sig0128 0 "Highly Speculative" 1 "Speculative" 2 "Confident" 3 "Highly Confident" ;
VAL_TABLE_ Sig0127 0 "Highly Speculative" 1 "Speculative" 2 "Confident" 3 "Highly Confident" ;
VAL_TABLE_ Sig0126 0 "Highly Speculative" 1 "Speculative" 2 "Confident" 3 "Highly Confident" ;
VAL_TABLE_ Sig0132 0 "Following" 1 "Oncoming" 2 "Following Goup" 3 "Oncoming Group" 4 "Unknown" ;
VAL_TABLE_ Sig0131 0 "Following" 1 "Oncoming" 2 "Following Goup" 3 "Oncoming Group" 4 "Unknown" ;
VAL_TABLE_ Sig0130 0 "Following" 1 "Oncoming" 2 "Following Goup" 3 "Oncoming Group" 4 "Unknown" ;
VAL_TABLE_ Sig0139 0 "No Object" 1 "New Object" 2 "Latent Track Not Detected This Cycle" 3 "Measured This Cycle" ;
VAL_TABLE_ Sig0138 0 "No Object" 1 "New Object" 2 "Latent Track Not Detected This Cycle" 3 "Measured This Cycle" ;
VAL_TABLE_ Sig0137 0 "No Object" 1 "New Object" 2 "Latent Track Not Detected This Cycle" 3 "Measured This Cycle" ;
VAL_TABLE_ Sig0140 0 "No Object" 1 "New Object" 2 "Latent Track Not Detected This Cycle" 3 "Measured This Cycle" ;
VAL_TABLE_ Sig0145 0 "Unknown" 1 "Host Lane" 2 "Right Lane" 3 "Left Lane" ;
VAL_TABLE_ Sig0148 0 "Unknown" 1 "Host Lane" 2 "Right Lane" 3 "Left Lane" ;
VAL_TABLE_ Sig0147 0 "Unknown" 1 "Host Lane" 2 "Right Lane" 3 "Left Lane" ;
VAL_TABLE_ Sig0146 0 "Unknown" 1 "Host Lane" 2 "Right Lane" 3 "Left Lane" ;
VAL_TABLE_ Sig0150 0 "FALSE" 1 "TRUE" ;
VAL_TABLE_ Sig0152 0 "FALSE" 1 "TRUE" ;
VAL_TABLE_ Sig0154 0 "FALSE" 1 "TRUE" ;
VAL_TABLE_ Sig0158 0 "UNKNOWN" 1 "4 WHEEL VEHICLE" 2 "LARGE VEHICLE" 3 "MOTORCYCLE/BICYCLE" 4 "PEDESTRIAN" 5 "FIXED OVERHEAD OBJECT" 6 "FIXED ROADSIDE OBJECT" 7 "NO OBJECT PRESENT" 8 "PEDESTRIAN STANDING OUTSIDE DANGER ZONE" 9 "PEDESTRIAN MOVING OUT OF DANGER ZONE" 10 "PEDESTRIAN MOVING INTO DANGER ZONE" 11 "CHILD CLOSE TO DANGER ZONE" 12 "CLUSTER OBJECT" ;
VAL_TABLE_ Sig0157 0 "UNKNOWN" 1 "4 WHEEL VEHICLE" 2 "LARGE VEHICLE" 3 "MOTORCYCLE/BICYCLE" 4 "PEDESTRIAN" 5 "FIXED OVERHEAD OBJECT" 6 "FIXED ROADSIDE OBJECT" 7 "NO OBJECT PRESENT" 8 "PEDESTRIAN STANDING OUTSIDE DANGER ZONE" 9 "PEDESTRIAN MOVING OUT OF DANGER ZONE" 10 "PEDESTRIAN MOVING INTO DANGER ZONE" 11 "CHILD CLOSE TO DANGER ZONE" 12 "CLUSTER OBJECT" ;
VAL_TABLE_ Sig0156 0 "FALSE" 1 "TRUE" ;
VAL_TABLE_ Sig0160 0 "UNKNOWN" 1 "4 WHEEL VEHICLE" 2 "LARGE VEHICLE" 3 "MOTORCYCLE/BICYCLE" 4 "PEDESTRIAN" 5 "FIXED OVERHEAD OBJECT" 6 "FIXED ROADSIDE OBJECT" 7 "NO OBJECT PRESENT" 8 "PEDESTRIAN STANDING OUTSIDE DANGER ZONE" 9 "PEDESTRIAN MOVING OUT OF DANGER ZONE" 10 "PEDESTRIAN MOVING INTO DANGER ZONE" 11 "CHILD CLOSE TO DANGER ZONE" 12 "CLUSTER OBJECT" ;
VAL_TABLE_ Sig0159 0 "UNKNOWN" 1 "4 WHEEL VEHICLE" 2 "LARGE VEHICLE" 3 "MOTORCYCLE/BICYCLE" 4 "PEDESTRIAN" 5 "FIXED OVERHEAD OBJECT" 6 "FIXED ROADSIDE OBJECT" 7 "NO OBJECT PRESENT" 8 "PEDESTRIAN STANDING OUTSIDE DANGER ZONE" 9 "PEDESTRIAN MOVING OUT OF DANGER ZONE" 10 "PEDESTRIAN MOVING INTO DANGER ZONE" 11 "CHILD CLOSE TO DANGER ZONE" 12 "CLUSTER OBJECT" ;
VAL_TABLE_ Sig0171 0 "FALSE" 1 "TRUE" ;
VAL_TABLE_ Sig0180 0 "Highly Speculative" 1 "Speculative" 2 "Confident" 3 "Highly Confident" ;
VAL_TABLE_ Sig0184 0 "Following" 1 "Oncoming" 2 "Following Goup" 3 "Oncoming Group" 4 "Unknown" ;
VAL_TABLE_ Sig0183 0 "Highly Speculative" 1 "Speculative" 2 "Confident" 3 "Highly Confident" ;
VAL_TABLE_ Sig0182 0 "Highly Speculative" 1 "Speculative" 2 "Confident" 3 "Highly Confident" ;
VAL_TABLE_ Sig0181 0 "Highly Speculative" 1 "Speculative" 2 "Confident" 3 "Highly Confident" ;
VAL_TABLE_ Sig0187 0 "Following" 1 "Oncoming" 2 "Following Goup" 3 "Oncoming Group" 4 "Unknown" ;
VAL_TABLE_ Sig0186 0 "Following" 1 "Oncoming" 2 "Following Goup" 3 "Oncoming Group" 4 "Unknown" ;
VAL_TABLE_ Sig0185 0 "Following" 1 "Oncoming" 2 "Following Goup" 3 "Oncoming Group" 4 "Unknown" ;
VAL_TABLE_ Sig0194 0 "No Object" 1 "New Object" 2 "Latent Track Not Detected This Cycle" 3 "Measured This Cycle" ;
VAL_TABLE_ Sig0193 0 "No Object" 1 "New Object" 2 "Latent Track Not Detected This Cycle" 3 "Measured This Cycle" ;
VAL_TABLE_ Sig0192 0 "No Object" 1 "New Object" 2 "Latent Track Not Detected This Cycle" 3 "Measured This Cycle" ;
VAL_TABLE_ Sig0195 0 "No Object" 1 "New Object" 2 "Latent Track Not Detected This Cycle" 3 "Measured This Cycle" ;
VAL_TABLE_ Sig0200 0 "Unknown" 1 "Host Lane" 2 "Right Lane" 3 "Left Lane" ;
VAL_TABLE_ Sig0203 0 "Unknown" 1 "Host Lane" 2 "Right Lane" 3 "Left Lane" ;
VAL_TABLE_ Sig0202 0 "Unknown" 1 "Host Lane" 2 "Right Lane" 3 "Left Lane" ;
VAL_TABLE_ Sig0201 0 "Unknown" 1 "Host Lane" 2 "Right Lane" 3 "Left Lane" ;
VAL_TABLE_ Sig0205 0 "FALSE" 1 "TRUE" ;
VAL_TABLE_ Sig0207 0 "FALSE" 1 "TRUE" ;
VAL_TABLE_ Sig0209 0 "FALSE" 1 "TRUE" ;
VAL_TABLE_ Sig0213 0 "UNKNOWN" 1 "4 WHEEL VEHICLE" 2 "LARGE VEHICLE" 3 "MOTORCYCLE/BICYCLE" 4 "PEDESTRIAN" 5 "FIXED OVERHEAD OBJECT" 6 "FIXED ROADSIDE OBJECT" 7 "NO OBJECT PRESENT" 8 "PEDESTRIAN STANDING OUTSIDE DANGER ZONE" 9 "PEDESTRIAN MOVING OUT OF DANGER ZONE" 10 "PEDESTRIAN MOVING INTO DANGER ZONE" 11 "CHILD CLOSE TO DANGER ZONE" 12 "CLUSTER OBJECT" ;
VAL_TABLE_ Sig0212 0 "UNKNOWN" 1 "4 WHEEL VEHICLE" 2 "LARGE VEHICLE" 3 "MOTORCYCLE/BICYCLE" 4 "PEDESTRIAN" 5 "FIXED OVERHEAD OBJECT" 6 "FIXED ROADSIDE OBJECT" 7 "NO OBJECT PRESENT" 8 "PEDESTRIAN STANDING OUTSIDE DANGER ZONE" 9 "PEDESTRIAN MOVING OUT OF DANGER ZONE" 10 "PEDESTRIAN MOVING INTO DANGER ZONE" 11 "CHILD CLOSE TO DANGER ZONE" 12 "CLUSTER OBJECT" ;
VAL_TABLE_ Sig0211 0 "FALSE" 1 "TRUE" ;
VAL_TABLE_ Sig0215 0 "UNKNOWN" 1 "4 WHEEL VEHICLE" 2 "LARGE VEHICLE" 3 "MOTORCYCLE/BICYCLE" 4 "PEDESTRIAN" 5 "FIXED OVERHEAD OBJECT" 6 "FIXED ROADSIDE OBJECT" 7 "NO OBJECT PRESENT" 8 "PEDESTRIAN STANDING OUTSIDE DANGER ZONE" 9 "PEDESTRIAN MOVING OUT OF DANGER ZONE" 10 "PEDESTRIAN MOVING INTO DANGER ZONE" 11 "CHILD CLOSE TO DANGER ZONE" 12 "CLUSTER OBJECT" ;
VAL_TABLE_ Sig0214 0 "UNKNOWN" 1 "4 WHEEL VEHICLE" 2 "LARGE VEHICLE" 3 "MOTORCYCLE/BICYCLE" 4 "PEDESTRIAN" 5 "FIXED OVERHEAD OBJECT" 6 "FIXED ROADSIDE OBJECT" 7 "NO OBJECT PRESENT" 8 "PEDESTRIAN STANDING OUTSIDE DANGER ZONE" 9 "PEDESTRIAN MOVING OUT OF DANGER ZONE" 10 "PEDESTRIAN MOVING INTO DANGER ZONE" 11 "CHILD CLOSE TO DANGER ZONE" 12 "CLUSTER OBJECT" ;
VAL_TABLE_ AAASSRP_StrgReqArbdFtrAuth 0 "None" 1 "Collision Avoidance Steeering" 2 "Traffic Jam Assist" 3 "Lane Centering and Control" 4 "Hands-On Lane Following" 5 "Steering Angle Assist" 6 "Lane Keep Assist" 7 "Lane Change on Demand" 8 "Lateral Collision Prevention" ;
VAL_TABLE_ AAASSRP_StrgReqStsAuth 0 "Unknown" 1 "Active" 2 "Inactive" ;
VAL_TABLE_ LnFllwgRrStrgInhbAuth 0 "FALSE" 1 "TRUE" ;
VAL_TABLE_ AAASSRP_StrgReqTypAuth 0 "Torque" 1 "Angle" ;
VAL_TABLE_ Sig0232 0 "Undecided" 1 "Solid" 2 "Dashed" 3 "Road Edge" 4 "Double Line" 5 "Botts Dots" 6 "Virtual" 7 "Triple Line" ;
VAL_TABLE_ Sig0231 0 "Very Low Quality" 1 "Low Quality" 2 "Prediction" 3 "High Quality" ;
VAL_TABLE_ Sig0241 0 "Undecided" 1 "Solid" 2 "Dashed" 3 "Road Edge" 4 "Double Line" 5 "Botts Dots" 6 "Virtual" 7 "Triple Line" ;
VAL_TABLE_ Sig0240 0 "Very Low Quality" 1 "Low Quality" 2 "Prediction" 3 "High Quality" ;
VAL_TABLE_ Sig0245 0 "No Object" 1 "New Object" 2 "Latent Track Not Detected this Cycle" 3 "Measured this Cycle" ;
VAL_TABLE_ Sig0255 0 "Unknown" 1 "Yaw" 2 "Horizon" 3 "Both" ;
VAL_TABLE_ Sig0263 0 "Unknown" 1 "Initializing" 2 "Inactive" 3 "Active" 4 "Programing" 5 "Reserved 1" 6 "Reserved 2" 7 "Failed" ;
VAL_TABLE_ Sig0267 0 "No Object" 1 "New Object" 2 "Latent Track Not Detected this Cycle" 3 "Measured this Cycle" ;
VAL_TABLE_ Sig0266 0 "FALSE" 1 "TRUE" ;
VAL_TABLE_ Sig0265 0 "FALSE" 1 "TRUE" ;
VAL_TABLE_ Sig0283 0 "Undecided" 1 "Solid" 2 "Dashed" 3 "Road Edge" 4 "Double Line" 5 "Botts Dots" 6 "Virtual" 7 "Triple Line" ;
VAL_TABLE_ Sig0282 0 "Very Low Quality" 1 "Low Quality" 2 "Prediction" 3 "High Quality" ;
VAL_TABLE_ Sig0292 0 "Undecided" 1 "Solid" 2 "Dashed" 3 "Road Edge" 4 "Double Line" 5 "Botts Dots" 6 "Virtual" 7 "Triple Line" ;
VAL_TABLE_ Sig0291 0 "Very Low Quality" 1 "Low Quality" 2 "Prediction" 3 "High Quality" ;
VAL_TABLE_ Sig0296 0 "No Object" 1 "New Object" 2 "Latent Track Not Detected this Cycle" 3 "Measured this Cycle" ;
VAL_TABLE_ Sig0003 0 "FALSE" 1 "TRUE" ;
VAL_TABLE_ Sig0005 0 "FALSE" 1 "TRUE" ;
VAL_TABLE_ ABSMPI1P_BrkModStsAuth 0 "Unknown" 1 "Capable" 2 "Active" 3 "Failed" ;
VAL_TABLE_ ABSMPI1P_ADIMCmdMsgStsAuth 0 "Unknown" 1 "Communication Normal" 2 "Main Communication Failed" 3 "Redundant Communication Failed" 4 "Dual Communication Failure" ;
VAL_TABLE_ ABSMPI1P_ABSStsAuth 0 "Unknown" 1 "Available" 2 "Active" 3 "Failed" ;
VAL_TABLE_ ABSMPI1P_DiagBrkPresReqStsAuth 0 "Unknown" 1 "No Dynamic Request" 2 "Primary Braking Request Honored" 3 "Secondary Braking Request Honored" 4 "Request Cancelled" ;
VAL_TABLE_ ABSMPI1P_DiagBrkPresReqAvalAuth 0 "Not Available" 1 "Available" 2 "Available PBM Only" ;
VAL_TABLE_ ABSMPI1P_BrkTrqSfcntStndstlAuth 0 "FALSE" 1 "TRUE" ;
VAL_TABLE_ ABSMPI1P_BrkSysStsAuth 0 "Unknown" 1 "Full Function" 2 "Degraded 1" 3 "Degraded 2" 4 "Degraded 3" 5 "Degraded 4" 6 "Degraded 5" ;
VAL_TABLE_ ABSMPI1P_ElecBrkDstSysStsAuth 0 "Unknown" 1 "Available" 2 "Active" 3 "Failed" ;
VAL_TABLE_ ABSMPI1P_ESCSysStsAuth 0 "Unknown" 1 "Available" 2 "Active" 3 "Failed" ;
VAL_TABLE_ ABSMPI1P_EstdSrfcFCoefTypAuth 0 "Unknown" 1 "Minimum Surface Estimate" 2 "Actual Surface Estimate" 3 "Invalid" ;
VAL_TABLE_ ABSMPI1P_PBMSbsysStsPriAuth 0 "Unknown" 1 "Full Function" 2 "Fault Tolerant" 3 "ESC Failed" 4 "ABS/ESC 3WSS" 5 "Service Brake Only" 6 "Failed" ;
VAL_TABLE_ ABSMPI1P_PBMArbtrtnStsPriAuth 0 "Unknown" 1 "No Autonomous Request" 2 "Main Autonomous Request Honored" 3 "Redundant Autonomous Request Honored" 4 "Default Brake Apply Autonomous Mode" 5 "Default Brake Apply FAXVC" 6 "Default Brake Apply FAXVC EPB Switch" 7 "PBM Diagnostic Pressure Request Honored" 8 "SBM Diagnostic Pressure Request Honored" 9 "ETRS Request Honored" 10 "Default Brake Apply No Torque" ;
VAL_TABLE_ ABSMPI1P_WhlBrkPresAuth_Inv 0 "FALSE" 1 "TRUE" ;
VAL_TABLE_ ABSMPI1P_TCSStsAuth 0 "Unknown" 1 "Available" 2 "Active" 3 "Failed" ;
VAL_TABLE_ ABSMPI1P_StndstlHldReqStsAuth 0 "Not Active" 1 "Active" 2 "Cancelled" ;
VAL_TABLE_ ABSMPI1P_SpltFCoefCtlAuth 0 "Inactive" 1 "Split Driver Side Low" 2 "Split Driver Side High" ;
VAL_TABLE_ ABSMPI1P_SBMFltDtdByPBMPriAuth 0 "FALSE" 1 "TRUE" ;
VAL_TABLE_ MnElecPrkBrkSwStsPriAuth 0 "Unknown" 1 "Not Active" 2 "Active" 3 "Apply" 4 "Release" 5 "Faulted" ;
VAL_TABLE_ ABSRPI1P_BrkModStsAuth 0 "Unknown" 1 "Capable" 2 "Active" 3 "Failed" ;
VAL_TABLE_ ABSRPI1P_ADIMCmdMsgStsAuth 0 "Unknown" 1 "Communication Normal" 2 "Main Communication Failed" 3 "Redundant Communication Failed" 4 "Dual Communication Failure" ;
VAL_TABLE_ ABSRPI1P_ABSStsAuth 0 "Unknown" 1 "Available" 2 "Active" 3 "Failed" ;
VAL_TABLE_ ABSRPI1P_BrkTrqSfcntStndstlAuth 0 "FALSE" 1 "TRUE" ;
VAL_TABLE_ ABSRPI1P_BrkSysStsAuth 0 "Unknown" 1 "Full Function" 2 "Degraded 1" 3 "Degraded 2" 4 "Degraded 3" 5 "Degraded 4" 6 "Degraded 5" ;
VAL_TABLE_ ABSRPI1P_BrkSysBrkLgtsReqdAuth 0 "FALSE" 1 "TRUE" ;
VAL_TABLE_ ABSRPI1P_CSPrdtdATRqIntvTypAuth 0 "No Intervention" 1 "Maximum Limit" 2 "Minimum Limit" 3 "Minimum and Maximum Limit" ;
VAL_TABLE_ ABSRPI1P_ChsSysATRqFncAuth 0 "None" 1 "Engine Drag Control" 2 "Traction Control" 3 "Electronic Stability Control" 4 "Active Safety Braking" 5 "Driveline Protection" 6 "Power Hop" 7 "Performance Traction Control" 8 "Hill Descent Control" 9 "Advanced Park Assist" 10 "Brake System Cruise Control" 11 "Torque Vectoring" 12 "Launch Control" 13 "Line Lock" 14 "Regenerative Torque Limitation" ;
VAL_TABLE_ ABSRPI1P_ChsSysATRqRespTypAuth 0 "Inactive" 1 "Pleasability Limited Request" 2 "Maximum Range Request" 3 "Automatic Actuator Selection" 4 "Braking Torque Request" ;
VAL_TABLE_ ABSRPI1P_ChsSysTtBrkATAuth_Inv 0 "FALSE" 1 "TRUE" ;
VAL_TABLE_ ABSRPI1P_ElcBrkDstSysStsAuth 0 "Unknown" 1 "Available" 2 "Active" 3 "Failed" ;
VAL_TABLE_ ABSRPI1P_ESCSysStsAuth 0 "Unknown" 1 "Available" 2 "Active" 3 "Failed" ;
VAL_TABLE_ ABSRPI1P_EstdSrfcFCoefTypAuth 0 "Unknown" 1 "Minimum Surface Estimate" 2 "Actual Surface Estimate" 3 "Invalid" ;
VAL_TABLE_ ABSRPI1P_SBMArbtrtnStsPriAuth 0 "Unknown" 1 "No Autonomous Request" 2 "Main Autonomous Request Honored" 3 "Redundant Autonomous Request Honored" 4 "Default Brake Apply No Torque" 5 "Default Brake Apply FAXVC" 6 "Default Brake Apply Autonomous Mode" 7 "Diagnostic Pressure Request Honored" 8 "ETRS Request Honored" ;
VAL_TABLE_ ABSRPI1P_PBMFltDtdBySBMPriAuth 0 "FALSE" 1 "TRUE" ;
VAL_TABLE_ ABSRPI1P_StndstlHldRqStsAuth 0 "Not Active" 1 "Active" 2 "Cancelled" ;
VAL_TABLE_ ABSRPI1P_SpltFCoefCtlAuth 0 "Inactive" 1 "Split Driver Side Low" 2 "Split Driver Side High" ;
VAL_TABLE_ ABSRPI1P_SBMSbsysStsPriAuth 0 "Unknown" 1 "Full Function" 2 "Fault Tolerant" 3 "RESC Failed" 4 "Service Brake Only" 5 "Failed" ;
VAL_TABLE_ ABSRPI1P_TCSStsAuth 0 "Unknown" 1 "Available" 2 "Active" 3 "Failed" ;
VAL_TABLE_ ABSRPI1P_WhlAnglrVelLFAuth_Inv 0 "FALSE" 1 "TRUE" ;
VAL_TABLE_ ABSRPI1P_WhlAnglrVelLRAuth_Inv 0 "FALSE" 1 "TRUE" ;
VAL_TABLE_ ABSRPI1P_WhlAnglrVelRFAuth_Inv 0 "FALSE" 1 "TRUE" ;
VAL_TABLE_ ABSRPI1P_WhlAnglrVelRRAuth_Inv 0 "FALSE" 1 "TRUE" ;
VAL_TABLE_ ABSRPI1P_WhlBrkPrsLFAuth_Inv 0 "FALSE" 1 "TRUE" ;
VAL_TABLE_ ABSRPI1P_WhlBrkPrsLRAuth_Inv 0 "FALSE" 1 "TRUE" ;
VAL_TABLE_ ABSRPI1P_WhlBrkPrsRFAuth_Inv 0 "FALSE" 1 "TRUE" ;
VAL_TABLE_ ABSRPI1P_WhlBrkPrsRRAuth_Inv 0 "FALSE" 1 "TRUE" ;
VAL_TABLE_ AutoLnChgCstAvlFlg5 0 "FALSE" 1 "TRUE" ;
VAL_TABLE_ AutoLnChgCstAvlFlg4 0 "FALSE" 1 "TRUE" ;
VAL_TABLE_ AutoLnChgCstAvlFlg3 0 "FALSE" 1 "TRUE" ;
VAL_TABLE_ AutoLnChgCstAvlFlg2 0 "FALSE" 1 "TRUE" ;
VAL_TABLE_ AutoLnChgCstAvlFlg1 0 "FALSE" 1 "TRUE" ;
VAL_TABLE_ AutoLnChgCstCurrSetVal 0 "Setting Unkown" 1 "Off" 2 "On" 3 "LCOD" 4 "LCOD and ALC" ;
VAL_TABLE_ AutoLnChgCstSetAval 0 "FALSE" 1 "TRUE" ;
VAL_TABLE_ AutoLnChgCstAvlFlg7 0 "FALSE" 1 "TRUE" ;
VAL_TABLE_ AutoLnChgCstAvlFlg6 0 "FALSE" 1 "TRUE" ;
VAL_TABLE_ AVMCMI1P_ADSRedntIPSPwrdOnAuth 0 "FALSE" 1 "TRUE" ;
VAL_TABLE_ AVMCMI1P_AutoCtlRqStrgModeAuth 0 "Inactive" 1 "Active" ;
VAL_TABLE_ AVMCMI1P_AutoVehOprtlStatAuth 0 "Inhibit Motion" 1 "ADSC Control (no override)" 2 "FAXVC Control" 3 "XVC Control" 4 "DVT" 5 "AVT" 6 "SVT" 7 "Operational Safety Check" ;
VAL_TABLE_ AVMCMI1P_AutoTransRngRqAuth 0 "No Action" 1 "Park" 2 "Reverse" 3 "Neutral" 4 "Drive" ;
VAL_TABLE_ AVMCMI1P_AutoCtlrEPBRqAuth 0 "No Request" 1 "Request Apply" 2 "Request Release" ;
VAL_TABLE_ AVMCMI1P_AutoCtlrBrkTqRqTypAuth 0 "No Request" 1 "Brake Torque Request" 2 "Standstill Hold Request" ;
VAL_TABLE_ AVMCMI1P_DgWhlBrkPrsRqTgtAuth 0 "Not Active" 1 "Primary Brake Request" 2 "Secondary Brake Request" ;
VAL_TABLE_ AVMCMI1P_FailOprtlPwrAvSTRqAuth 0 "No Request" 1 "XVC Self Test Request" 2 "AV Self Test Request" 3 "FAXVC Self Test Request" ;
VAL_TABLE_ AVMCMnFAXVCEqpdStsPriAuth 0 "Unknown" 1 "Not Equipped" 2 "Equipped" 3 "Error" ;
VAL_TABLE_ ALGIP_RrAxlLckFdbkAuth 0 "Open" 1 "Locked" 2 "Unknown" ;
VAL_TABLE_ ALGIP_RrAxlLckCmndOnAuth 0 "FALSE" 1 "TRUE" ;
VAL_TABLE_ ALGIP_FrtAxlLckFdbkAuth 0 "Open" 1 "Locked" 2 "Unknown" ;
VAL_TABLE_ ALGIP_FrtAxlLckCmndOnAuth 0 "FALSE" 1 "TRUE" ;
VAL_TABLE_ Sig0522 0 "FALSE" 1 "TRUE" ;
VAL_TABLE_ Sig0524 0 "FALSE" 1 "TRUE" ;
VAL_TABLE_ BGI3P_BrkPedModrTrvlAchAuth_Inv 0 "FALSE" 1 "TRUE" ;
VAL_TABLE_ BGI3P_BrkPedModrTrvlAchAuth 0 "FALSE" 1 "TRUE" ;
VAL_TABLE_ BGI3P_BrkPedInitTrvlAchAuth_Inv 0 "FALSE" 1 "TRUE" ;
VAL_TABLE_ BGI3P_BrkPedInitTrvlAchAuth 0 "FALSE" 1 "TRUE" ;
VAL_TABLE_ BGI3P_CruzSecSwStsAuth 0 "Indeterminate" 1 "No_Activation" 2 "Speed Increase High" 3 "Speed Decrease High" 4 "Gap Selected" 5 "Lane Centering Control" 6 "Lane Departure Warning / Lane Keep Assist" 7 "Short to Ground" 8 "Open/Short to Power" 9 "Between_Ranges" ;
VAL_TABLE_ BGI3P_BrkPedPstnAuth_Inv 0 "FALSE" 1 "TRUE" ;
VAL_TABLE_ CruzCtlSwBank1Sts 0 "No Activation" 1 "Cancel" 2 "Cruise On/Off" 3 "Gap" 4 "Lane Centering Control" 5 "Lane Departure Warning" 6 "Short to Ground" 7 "Open/Short to Power" 8 "Between Ranges" 9 "Indeterminate" ;
VAL_TABLE_ BGI3P_CruzSpdLmtrSwStsAuth 0 "Indeterminate" 1 "No_Activation" 2 "Resume" 3 "Set" 4 "SL/SW On/Off" 5 "Cruise On/Off" 6 "Cancel" 7 "Short to Ground" 8 "Open/Short to Power" 9 "Between_Ranges" ;
VAL_TABLE_ StrgWhlCruzCtlCfg 0 "Legacy" 1 "New" ;
VAL_TABLE_ CruzCtlSwBank2Sts 0 "No Activation" 1 "Set" 2 "Decrease High" 3 "Low/Manual" 4 "Gap 2" 5 "Resume" 6 "Increase High" 7 "Short to Ground" 8 "Open/Short to Power" 9 "Between Ranges" 10 "Indeterminate" ;
VAL_TABLE_ BSPMP_BkupSysPwrModeAuth_Inv 0 "FALSE" 1 "TRUE" ;
VAL_TABLE_ BSPMP_BkupSysPwrModeAuth 0 "Off" 1 "Accessory" 2 "Run" 3 "Start Request" 4 "Propulsion" ;
VAL_TABLE_ BSPMP_SecRunCrnkCmdActvAuth_Inv 0 "FALSE" 1 "TRUE" ;
VAL_TABLE_ BSPMP_SecRunCrnkCmdActvAuth 0 "FALSE" 1 "TRUE" ;
VAL_TABLE_ BSPMP_SecPwrModePBActvAuth_Inv 0 "FALSE" 1 "TRUE" ;
VAL_TABLE_ BSPMP_SecPwrModePBActvAuth 0 "FALSE" 1 "TRUE" ;
VAL_TABLE_ BSPMP_RmtProgmActvAuth 0 "FALSE" 1 "TRUE" ;
VAL_TABLE_ Sig0479 0 "FALSE" 1 "TRUE" ;
VAL_TABLE_ Sig0481 0 "FALSE" 1 "TRUE" ;
VAL_TABLE_ Sig0485 0 "None" 1 "Critical Voltage-related Fault" 2 "Critical Non Voltage-related Fault" 3 "Non Critical Recoverable Fault" ;
VAL_TABLE_ Sig0487 0 "FALSE" 1 "TRUE" ;
VAL_TABLE_ Sig0489 0 "FALSE" 1 "TRUE" ;
VAL_TABLE_ Sig0496 0 "Inactive" 1 "Maximum Range" ;
VAL_TABLE_ Sig0498 0 "Disable Normal Power Stage" 1 "Torque Control" 2 "Shutdown Initiated" 3 "Disable Immediate" 4 "Normal Charge with Internal Setpoint" 5 "Normal Charge with External Setpoint" ;
VAL_TABLE_ BSIS2P_BSTrqOvlyDlTrqCmdAtvAuth 0 "FALSE" 1 "TRUE" ;
VAL_TABLE_ BSIS2P_ABSFldAuth 0 "FALSE" 1 "TRUE" ;
VAL_TABLE_ BSIS2P_ABSAtvAuth 0 "FALSE" 1 "TRUE" ;
VAL_TABLE_ BrkPdlDrvAppPrsDetcdAuth_Inv 0 "FALSE" 1 "TRUE" ;
VAL_TABLE_ BrkPdlDrvAppPrsDetcdAuth 0 "FALSE" 1 "TRUE" ;
VAL_TABLE_ BSIS2P_BrkPdlDrvApplPresAuth_Inv 0 "FALSE" 1 "TRUE" ;
VAL_TABLE_ CCHI_CalcdTgtCabinHtLd_Inv 0 "FALSE" 1 "TRUE" ;
VAL_TABLE_ CCHI_MinFlwRateReq_Inv 0 "FALSE" 1 "TRUE" ;
VAL_TABLE_ CCHI_PrtyHtReq_Inv 0 "FALSE" 1 "TRUE" ;
VAL_TABLE_ CCHI_PrtyHtReq 0 "No Action" 1 "Low" 2 "Medium" 3 "High" ;
VAL_TABLE_ CCHI_MinTgtCoolTemp_Inv 0 "FALSE" 1 "TRUE" ;
VAL_TABLE_ Sig0715 0 "FALSE" 1 "TRUE" ;
VAL_TABLE_ DMS_CAN2_ClscCANHrtBtActv 0 "FALSE" 1 "TRUE" ;
VAL_TABLE_ Sig1112 0 "FALSE" 1 "TRUE" ;
VAL_TABLE_ Sig1114 0 "Not Supported" 1 "Type A" 2 "Type B" 3 "Type C" ;
VAL_TABLE_ Sig1123 0 "FALSE" 1 "TRUE" ;
VAL_TABLE_ Sig1122 0 "FALSE" 1 "TRUE" ;
VAL_TABLE_ Sig1121 0 "FALSE" 1 "TRUE" ;
VAL_TABLE_ Sig1120 0 "FALSE" 1 "TRUE" ;
VAL_TABLE_ Sig1119 0 "FALSE" 1 "TRUE" ;
VAL_TABLE_ Sig1118 0 "FALSE" 1 "TRUE" ;
VAL_TABLE_ Sig1117 0 "FALSE" 1 "TRUE" ;
VAL_TABLE_ Sig1125 0 "FALSE" 1 "TRUE" ;
VAL_TABLE_ Sig1124 0 "FALSE" 1 "TRUE" ;
VAL_TABLE_ Sig1126 0 "FALSE" 1 "TRUE" ;
VAL_TABLE_ Sig1128 0 "Not Supported" 1 "Type A" 2 "Type B" 3 "Type C" ;
VAL_TABLE_ Sig1137 0 "FALSE" 1 "TRUE" ;
VAL_TABLE_ Sig1136 0 "FALSE" 1 "TRUE" ;
VAL_TABLE_ Sig1135 0 "FALSE" 1 "TRUE" ;
VAL_TABLE_ Sig1134 0 "FALSE" 1 "TRUE" ;
VAL_TABLE_ Sig1133 0 "FALSE" 1 "TRUE" ;
VAL_TABLE_ Sig1132 0 "FALSE" 1 "TRUE" ;
VAL_TABLE_ Sig1131 0 "FALSE" 1 "TRUE" ;
VAL_TABLE_ Sig1139 0 "FALSE" 1 "TRUE" ;
VAL_TABLE_ Sig1138 0 "FALSE" 1 "TRUE" ;
VAL_TABLE_ Sig1210 0 "FALSE" 1 "TRUE" ;
VAL_TABLE_ Sig1212 0 "Not Supported" 1 "Type A" 2 "Type B" 3 "Type C" ;
VAL_TABLE_ Sig1221 0 "FALSE" 1 "TRUE" ;
VAL_TABLE_ Sig1220 0 "FALSE" 1 "TRUE" ;
VAL_TABLE_ Sig1219 0 "FALSE" 1 "TRUE" ;
VAL_TABLE_ Sig1218 0 "FALSE" 1 "TRUE" ;
VAL_TABLE_ Sig1217 0 "FALSE" 1 "TRUE" ;
VAL_TABLE_ Sig1216 0 "FALSE" 1 "TRUE" ;
VAL_TABLE_ Sig1215 0 "FALSE" 1 "TRUE" ;
VAL_TABLE_ Sig1223 0 "FALSE" 1 "TRUE" ;
VAL_TABLE_ Sig1222 0 "FALSE" 1 "TRUE" ;
VAL_TABLE_ Sig1230 0 "FALSE" 1 "TRUE" ;
VAL_TABLE_ Sig1232 0 "Not Supported" 1 "Type A" 2 "Type B" 3 "Type C" ;
VAL_TABLE_ Sig1241 0 "FALSE" 1 "TRUE" ;
VAL_TABLE_ Sig1240 0 "FALSE" 1 "TRUE" ;
VAL_TABLE_ Sig1239 0 "FALSE" 1 "TRUE" ;
VAL_TABLE_ Sig1238 0 "FALSE" 1 "TRUE" ;
VAL_TABLE_ Sig1237 0 "FALSE" 1 "TRUE" ;
VAL_TABLE_ Sig1236 0 "FALSE" 1 "TRUE" ;
VAL_TABLE_ Sig1235 0 "FALSE" 1 "TRUE" ;
VAL_TABLE_ Sig1243 0 "FALSE" 1 "TRUE" ;
VAL_TABLE_ Sig1242 0 "FALSE" 1 "TRUE" ;
VAL_TABLE_ Sig1224 0 "FALSE" 1 "TRUE" ;
VAL_TABLE_ Sig1226 0 "Not Supported" 1 "Type A" 2 "Type B" 3 "Type C" ;
VAL_TABLE_ Sig1249 0 "FALSE" 1 "TRUE" ;
VAL_TABLE_ Sig1248 0 "FALSE" 1 "TRUE" ;
VAL_TABLE_ Sig1247 0 "FALSE" 1 "TRUE" ;
VAL_TABLE_ Sig1246 0 "FALSE" 1 "TRUE" ;
VAL_TABLE_ Sig1245 0 "FALSE" 1 "TRUE" ;
VAL_TABLE_ Sig1244 0 "FALSE" 1 "TRUE" ;
VAL_TABLE_ Sig1229 0 "FALSE" 1 "TRUE" ;
VAL_TABLE_ Sig1251 0 "FALSE" 1 "TRUE" ;
VAL_TABLE_ Sig1250 0 "FALSE" 1 "TRUE" ;
VAL_TABLE_ Sig1294 0 "FALSE" 1 "TRUE" ;
VAL_TABLE_ Sig1296 0 "Not Supported" 1 "Type A" 2 "Type B" 3 "Type C" ;
VAL_TABLE_ Sig1305 0 "FALSE" 1 "TRUE" ;
VAL_TABLE_ Sig1304 0 "FALSE" 1 "TRUE" ;
VAL_TABLE_ Sig1303 0 "FALSE" 1 "TRUE" ;
VAL_TABLE_ Sig1302 0 "FALSE" 1 "TRUE" ;
VAL_TABLE_ Sig1301 0 "FALSE" 1 "TRUE" ;
VAL_TABLE_ Sig1300 0 "FALSE" 1 "TRUE" ;
VAL_TABLE_ Sig1299 0 "FALSE" 1 "TRUE" ;
VAL_TABLE_ Sig1307 0 "FALSE" 1 "TRUE" ;
VAL_TABLE_ Sig1306 0 "FALSE" 1 "TRUE" ;
VAL_TABLE_ DTCI_DMS_CnfrmdDTC 0 "FALSE" 1 "TRUE" ;
VAL_TABLE_ DTCI_DMS_DTCFaultType 0 "Not Supported" 1 "Type A" 2 "Type B" 3 "Type C" ;
VAL_TABLE_ DTCI_DMS_TstNCmpltdOpCyc 0 "FALSE" 1 "TRUE" ;
VAL_TABLE_ DTCI_DMS_TstNCmpltdLstClr 0 "FALSE" 1 "TRUE" ;
VAL_TABLE_ DTCI_DMS_TstFldOpCyc 0 "FALSE" 1 "TRUE" ;
VAL_TABLE_ DTCI_DMS_TstFldLstClr 0 "FALSE" 1 "TRUE" ;
VAL_TABLE_ DTCI_DMS_TstFld 0 "FALSE" 1 "TRUE" ;
VAL_TABLE_ DTCI_DMS_PndngDTC 0 "FALSE" 1 "TRUE" ;
VAL_TABLE_ DTCI_DMS_DTCTriggered 0 "FALSE" 1 "TRUE" ;
VAL_TABLE_ DTCI_DMS_WrnIndTrggrd 0 "FALSE" 1 "TRUE" ;
VAL_TABLE_ DTCI_DMS_WrnIndRqd 0 "FALSE" 1 "TRUE" ;
VAL_TABLE_ Sig1308 0 "FALSE" 1 "TRUE" ;
VAL_TABLE_ Sig1310 0 "Not Supported" 1 "Type A" 2 "Type B" 3 "Type C" ;
VAL_TABLE_ Sig1319 0 "FALSE" 1 "TRUE" ;
VAL_TABLE_ Sig1318 0 "FALSE" 1 "TRUE" ;
VAL_TABLE_ Sig1317 0 "FALSE" 1 "TRUE" ;
VAL_TABLE_ Sig1316 0 "FALSE" 1 "TRUE" ;
VAL_TABLE_ Sig1315 0 "FALSE" 1 "TRUE" ;
VAL_TABLE_ Sig1314 0 "FALSE" 1 "TRUE" ;
VAL_TABLE_ Sig1313 0 "FALSE" 1 "TRUE" ;
VAL_TABLE_ Sig1321 0 "FALSE" 1 "TRUE" ;
VAL_TABLE_ Sig1320 0 "FALSE" 1 "TRUE" ;
VAL_TABLE_ DTCI_ECP_E_CnfrmdDTC 0 "FALSE" 1 "TRUE" ;
VAL_TABLE_ DTCI_ECP_E_DTCFaultType 0 "Not Supported" 1 "Type A" 2 "Type B" 3 "Type C" ;
VAL_TABLE_ DTCI_ECP_E_TstNCmpltdOpCyc 0 "FALSE" 1 "TRUE" ;
VAL_TABLE_ DTCI_ECP_E_TstNCmpltdLstClr 0 "FALSE" 1 "TRUE" ;
VAL_TABLE_ DTCI_ECP_E_TstFldOpCyc 0 "FALSE" 1 "TRUE" ;
VAL_TABLE_ DTCI_ECP_E_TstFldLstClr 0 "FALSE" 1 "TRUE" ;
VAL_TABLE_ DTCI_ECP_E_TstFld 0 "FALSE" 1 "TRUE" ;
VAL_TABLE_ DTCI_ECP_E_PndngDTC 0 "FALSE" 1 "TRUE" ;
VAL_TABLE_ DTCI_ECP_E_DTCTriggered 0 "FALSE" 1 "TRUE" ;
VAL_TABLE_ DTCI_ECP_E_WrnIndTrggrd 0 "FALSE" 1 "TRUE" ;
VAL_TABLE_ DTCI_ECP_E_WrnIndRqd 0 "FALSE" 1 "TRUE" ;
VAL_TABLE_ Sig1322 0 "FALSE" 1 "TRUE" ;
VAL_TABLE_ Sig1324 0 "Not Supported" 1 "Type A" 2 "Type B" 3 "Type C" ;
VAL_TABLE_ Sig1333 0 "FALSE" 1 "TRUE" ;
VAL_TABLE_ Sig1332 0 "FALSE" 1 "TRUE" ;
VAL_TABLE_ Sig1331 0 "FALSE" 1 "TRUE" ;
VAL_TABLE_ Sig1330 0 "FALSE" 1 "TRUE" ;
VAL_TABLE_ Sig1329 0 "FALSE" 1 "TRUE" ;
VAL_TABLE_ Sig1328 0 "FALSE" 1 "TRUE" ;
VAL_TABLE_ Sig1327 0 "FALSE" 1 "TRUE" ;
VAL_TABLE_ Sig1335 0 "FALSE" 1 "TRUE" ;
VAL_TABLE_ Sig1334 0 "FALSE" 1 "TRUE" ;
VAL_TABLE_ Sig1336 0 "FALSE" 1 "TRUE" ;
VAL_TABLE_ Sig1338 0 "Not Supported" 1 "Type A" 2 "Type B" 3 "Type C" ;
VAL_TABLE_ Sig1347 0 "FALSE" 1 "TRUE" ;
VAL_TABLE_ Sig1346 0 "FALSE" 1 "TRUE" ;
VAL_TABLE_ Sig1345 0 "FALSE" 1 "TRUE" ;
VAL_TABLE_ Sig1344 0 "FALSE" 1 "TRUE" ;
VAL_TABLE_ Sig1343 0 "FALSE" 1 "TRUE" ;
VAL_TABLE_ Sig1342 0 "FALSE" 1 "TRUE" ;
VAL_TABLE_ Sig1341 0 "FALSE" 1 "TRUE" ;
VAL_TABLE_ Sig1349 0 "FALSE" 1 "TRUE" ;
VAL_TABLE_ Sig1348 0 "FALSE" 1 "TRUE" ;
VAL_TABLE_ Sig1350 0 "FALSE" 1 "TRUE" ;
VAL_TABLE_ Sig1352 0 "Not Supported" 1 "Type A" 2 "Type B" 3 "Type C" ;
VAL_TABLE_ Sig1361 0 "FALSE" 1 "TRUE" ;
VAL_TABLE_ Sig1360 0 "FALSE" 1 "TRUE" ;
VAL_TABLE_ Sig1359 0 "FALSE" 1 "TRUE" ;
VAL_TABLE_ Sig1358 0 "FALSE" 1 "TRUE" ;
VAL_TABLE_ Sig1357 0 "FALSE" 1 "TRUE" ;
VAL_TABLE_ Sig1356 0 "FALSE" 1 "TRUE" ;
VAL_TABLE_ Sig1355 0 "FALSE" 1 "TRUE" ;
VAL_TABLE_ Sig1363 0 "FALSE" 1 "TRUE" ;
VAL_TABLE_ Sig1362 0 "FALSE" 1 "TRUE" ;
VAL_TABLE_ Sig1364 0 "FALSE" 1 "TRUE" ;
VAL_TABLE_ Sig1366 0 "Not Supported" 1 "Type A" 2 "Type B" 3 "Type C" ;
VAL_TABLE_ Sig1375 0 "FALSE" 1 "TRUE" ;
VAL_TABLE_ Sig1374 0 "FALSE" 1 "TRUE" ;
VAL_TABLE_ Sig1373 0 "FALSE" 1 "TRUE" ;
VAL_TABLE_ Sig1372 0 "FALSE" 1 "TRUE" ;
VAL_TABLE_ Sig1371 0 "FALSE" 1 "TRUE" ;
VAL_TABLE_ Sig1370 0 "FALSE" 1 "TRUE" ;
VAL_TABLE_ Sig1369 0 "FALSE" 1 "TRUE" ;
VAL_TABLE_ Sig1377 0 "FALSE" 1 "TRUE" ;
VAL_TABLE_ Sig1376 0 "FALSE" 1 "TRUE" ;
VAL_TABLE_ Sig1398 0 "FALSE" 1 "TRUE" ;
VAL_TABLE_ Sig1400 0 "Not Supported" 1 "Type A" 2 "Type B" 3 "Type C" ;
VAL_TABLE_ Sig1409 0 "FALSE" 1 "TRUE" ;
VAL_TABLE_ Sig1408 0 "FALSE" 1 "TRUE" ;
VAL_TABLE_ Sig1407 0 "FALSE" 1 "TRUE" ;
VAL_TABLE_ Sig1406 0 "FALSE" 1 "TRUE" ;
VAL_TABLE_ Sig1405 0 "FALSE" 1 "TRUE" ;
VAL_TABLE_ Sig1404 0 "FALSE" 1 "TRUE" ;
VAL_TABLE_ Sig1403 0 "FALSE" 1 "TRUE" ;
VAL_TABLE_ Sig1411 0 "FALSE" 1 "TRUE" ;
VAL_TABLE_ Sig1410 0 "FALSE" 1 "TRUE" ;
VAL_TABLE_ DTCI_EPS_CnfrmdDTC 0 "FALSE" 1 "TRUE" ;
VAL_TABLE_ DTCI_EPS_DTCFaultType 0 "Not Supported" 1 "Type A" 2 "Type B" 3 "Type C" ;
VAL_TABLE_ DTCI_EPS_TstNCmpltdOpCyc 0 "FALSE" 1 "TRUE" ;
VAL_TABLE_ DTCI_EPS_TstNCmpltdLstClr 0 "FALSE" 1 "TRUE" ;
VAL_TABLE_ DTCI_EPS_TstFldOpCyc 0 "FALSE" 1 "TRUE" ;
VAL_TABLE_ DTCI_EPS_TstFldLstClr 0 "FALSE" 1 "TRUE" ;
VAL_TABLE_ DTCI_EPS_TstFld 0 "FALSE" 1 "TRUE" ;
VAL_TABLE_ DTCI_EPS_PndngDTC 0 "FALSE" 1 "TRUE" ;
VAL_TABLE_ DTCI_EPS_DTCTriggered 0 "FALSE" 1 "TRUE" ;
VAL_TABLE_ DTCI_EPS_WrnIndTrggrd 0 "FALSE" 1 "TRUE" ;
VAL_TABLE_ DTCI_EPS_WrnIndRqd 0 "FALSE" 1 "TRUE" ;
VAL_TABLE_ Sig1448 0 "FALSE" 1 "TRUE" ;
VAL_TABLE_ Sig1450 0 "Not Supported" 1 "Type A" 2 "Type B" 3 "Type C" ;
VAL_TABLE_ Sig1459 0 "FALSE" 1 "TRUE" ;
VAL_TABLE_ Sig1458 0 "FALSE" 1 "TRUE" ;
VAL_TABLE_ Sig1457 0 "FALSE" 1 "TRUE" ;
VAL_TABLE_ Sig1456 0 "FALSE" 1 "TRUE" ;
VAL_TABLE_ Sig1455 0 "FALSE" 1 "TRUE" ;
VAL_TABLE_ Sig1454 0 "FALSE" 1 "TRUE" ;
VAL_TABLE_ Sig1453 0 "FALSE" 1 "TRUE" ;
VAL_TABLE_ Sig1461 0 "FALSE" 1 "TRUE" ;
VAL_TABLE_ Sig1460 0 "FALSE" 1 "TRUE" ;
VAL_TABLE_ Sig1462 0 "FALSE" 1 "TRUE" ;
VAL_TABLE_ Sig1464 0 "Not Supported" 1 "Type A" 2 "Type B" 3 "Type C" ;
VAL_TABLE_ Sig1487 0 "FALSE" 1 "TRUE" ;
VAL_TABLE_ Sig1486 0 "FALSE" 1 "TRUE" ;
VAL_TABLE_ Sig1485 0 "FALSE" 1 "TRUE" ;
VAL_TABLE_ Sig1484 0 "FALSE" 1 "TRUE" ;
VAL_TABLE_ Sig1483 0 "FALSE" 1 "TRUE" ;
VAL_TABLE_ Sig1482 0 "FALSE" 1 "TRUE" ;
VAL_TABLE_ Sig1467 0 "FALSE" 1 "TRUE" ;
VAL_TABLE_ Sig1489 0 "FALSE" 1 "TRUE" ;
VAL_TABLE_ Sig1488 0 "FALSE" 1 "TRUE" ;
VAL_TABLE_ Sig1490 0 "FALSE" 1 "TRUE" ;
VAL_TABLE_ Sig1492 0 "Not Supported" 1 "Type A" 2 "Type B" 3 "Type C" ;
VAL_TABLE_ Sig1501 0 "FALSE" 1 "TRUE" ;
VAL_TABLE_ Sig1500 0 "FALSE" 1 "TRUE" ;
VAL_TABLE_ Sig1499 0 "FALSE" 1 "TRUE" ;
VAL_TABLE_ Sig1498 0 "FALSE" 1 "TRUE" ;
VAL_TABLE_ Sig1497 0 "FALSE" 1 "TRUE" ;
VAL_TABLE_ Sig1496 0 "FALSE" 1 "TRUE" ;
VAL_TABLE_ Sig1495 0 "FALSE" 1 "TRUE" ;
VAL_TABLE_ Sig1503 0 "FALSE" 1 "TRUE" ;
VAL_TABLE_ Sig1502 0 "FALSE" 1 "TRUE" ;
VAL_TABLE_ Sig1518 0 "FALSE" 1 "TRUE" ;
VAL_TABLE_ Sig1520 0 "Not Supported" 1 "Type A" 2 "Type B" 3 "Type C" ;
VAL_TABLE_ Sig1529 0 "FALSE" 1 "TRUE" ;
VAL_TABLE_ Sig1528 0 "FALSE" 1 "TRUE" ;
VAL_TABLE_ Sig1527 0 "FALSE" 1 "TRUE" ;
VAL_TABLE_ Sig1526 0 "FALSE" 1 "TRUE" ;
VAL_TABLE_ Sig1525 0 "FALSE" 1 "TRUE" ;
VAL_TABLE_ Sig1524 0 "FALSE" 1 "TRUE" ;
VAL_TABLE_ Sig1523 0 "FALSE" 1 "TRUE" ;
VAL_TABLE_ Sig1531 0 "FALSE" 1 "TRUE" ;
VAL_TABLE_ Sig1530 0 "FALSE" 1 "TRUE" ;
VAL_TABLE_ Sig1602 0 "FALSE" 1 "TRUE" ;
VAL_TABLE_ Sig1604 0 "Not Supported" 1 "Type A" 2 "Type B" 3 "Type C" ;
VAL_TABLE_ Sig1613 0 "FALSE" 1 "TRUE" ;
VAL_TABLE_ Sig1612 0 "FALSE" 1 "TRUE" ;
VAL_TABLE_ Sig1611 0 "FALSE" 1 "TRUE" ;
VAL_TABLE_ Sig1610 0 "FALSE" 1 "TRUE" ;
VAL_TABLE_ Sig1609 0 "FALSE" 1 "TRUE" ;
VAL_TABLE_ Sig1608 0 "FALSE" 1 "TRUE" ;
VAL_TABLE_ Sig1607 0 "FALSE" 1 "TRUE" ;
VAL_TABLE_ Sig1615 0 "FALSE" 1 "TRUE" ;
VAL_TABLE_ Sig1614 0 "FALSE" 1 "TRUE" ;
VAL_TABLE_ Sig1784 0 "FALSE" 1 "TRUE" ;
VAL_TABLE_ Sig1786 0 "Not Supported" 1 "Type A" 2 "Type B" 3 "Type C" ;
VAL_TABLE_ Sig1795 0 "FALSE" 1 "TRUE" ;
VAL_TABLE_ Sig1794 0 "FALSE" 1 "TRUE" ;
VAL_TABLE_ Sig1793 0 "FALSE" 1 "TRUE" ;
VAL_TABLE_ Sig1792 0 "FALSE" 1 "TRUE" ;
VAL_TABLE_ Sig1791 0 "FALSE" 1 "TRUE" ;
VAL_TABLE_ Sig1790 0 "FALSE" 1 "TRUE" ;
VAL_TABLE_ Sig1789 0 "FALSE" 1 "TRUE" ;
VAL_TABLE_ Sig1797 0 "FALSE" 1 "TRUE" ;
VAL_TABLE_ Sig1796 0 "FALSE" 1 "TRUE" ;
VAL_TABLE_ Sig1812 0 "FALSE" 1 "TRUE" ;
VAL_TABLE_ Sig1814 0 "Not Supported" 1 "Type A" 2 "Type B" 3 "Type C" ;
VAL_TABLE_ Sig1823 0 "FALSE" 1 "TRUE" ;
VAL_TABLE_ Sig1822 0 "FALSE" 1 "TRUE" ;
VAL_TABLE_ Sig1821 0 "FALSE" 1 "TRUE" ;
VAL_TABLE_ Sig1820 0 "FALSE" 1 "TRUE" ;
VAL_TABLE_ Sig1819 0 "FALSE" 1 "TRUE" ;
VAL_TABLE_ Sig1818 0 "FALSE" 1 "TRUE" ;
VAL_TABLE_ Sig1817 0 "FALSE" 1 "TRUE" ;
VAL_TABLE_ Sig1825 0 "FALSE" 1 "TRUE" ;
VAL_TABLE_ Sig1824 0 "FALSE" 1 "TRUE" ;
VAL_TABLE_ Sig1868 0 "FALSE" 1 "TRUE" ;
VAL_TABLE_ Sig1870 0 "Not Supported" 1 "Type A" 2 "Type B" 3 "Type C" ;
VAL_TABLE_ Sig1879 0 "FALSE" 1 "TRUE" ;
VAL_TABLE_ Sig1878 0 "FALSE" 1 "TRUE" ;
VAL_TABLE_ Sig1877 0 "FALSE" 1 "TRUE" ;
VAL_TABLE_ Sig1876 0 "FALSE" 1 "TRUE" ;
VAL_TABLE_ Sig1875 0 "FALSE" 1 "TRUE" ;
VAL_TABLE_ Sig1874 0 "FALSE" 1 "TRUE" ;
VAL_TABLE_ Sig1873 0 "FALSE" 1 "TRUE" ;
VAL_TABLE_ Sig1881 0 "FALSE" 1 "TRUE" ;
VAL_TABLE_ Sig1880 0 "FALSE" 1 "TRUE" ;
VAL_TABLE_ Sig2162 0 "FALSE" 1 "TRUE" ;
VAL_TABLE_ Sig2164 0 "Not Supported" 1 "Type A" 2 "Type B" 3 "Type C" ;
VAL_TABLE_ Sig2173 0 "FALSE" 1 "TRUE" ;
VAL_TABLE_ Sig2172 0 "FALSE" 1 "TRUE" ;
VAL_TABLE_ Sig2171 0 "FALSE" 1 "TRUE" ;
VAL_TABLE_ Sig2170 0 "FALSE" 1 "TRUE" ;
VAL_TABLE_ Sig2169 0 "FALSE" 1 "TRUE" ;
VAL_TABLE_ Sig2168 0 "FALSE" 1 "TRUE" ;
VAL_TABLE_ Sig2167 0 "FALSE" 1 "TRUE" ;
VAL_TABLE_ Sig2175 0 "FALSE" 1 "TRUE" ;
VAL_TABLE_ Sig2174 0 "FALSE" 1 "TRUE" ;
VAL_TABLE_ Sig2176 0 "FALSE" 1 "TRUE" ;
VAL_TABLE_ Sig2178 0 "Not Supported" 1 "Type A" 2 "Type B" 3 "Type C" ;
VAL_TABLE_ Sig2187 0 "FALSE" 1 "TRUE" ;
VAL_TABLE_ Sig2186 0 "FALSE" 1 "TRUE" ;
VAL_TABLE_ Sig2185 0 "FALSE" 1 "TRUE" ;
VAL_TABLE_ Sig2184 0 "FALSE" 1 "TRUE" ;
VAL_TABLE_ Sig2183 0 "FALSE" 1 "TRUE" ;
VAL_TABLE_ Sig2182 0 "FALSE" 1 "TRUE" ;
VAL_TABLE_ Sig2181 0 "FALSE" 1 "TRUE" ;
VAL_TABLE_ Sig2189 0 "FALSE" 1 "TRUE" ;
VAL_TABLE_ Sig2188 0 "FALSE" 1 "TRUE" ;
VAL_TABLE_ Sig2246 0 "FALSE" 1 "TRUE" ;
VAL_TABLE_ Sig2248 0 "Not Supported" 1 "Type A" 2 "Type B" 3 "Type C" ;
VAL_TABLE_ Sig2257 0 "FALSE" 1 "TRUE" ;
VAL_TABLE_ Sig2256 0 "FALSE" 1 "TRUE" ;
VAL_TABLE_ Sig2255 0 "FALSE" 1 "TRUE" ;
VAL_TABLE_ Sig2254 0 "FALSE" 1 "TRUE" ;
VAL_TABLE_ Sig2253 0 "FALSE" 1 "TRUE" ;
VAL_TABLE_ Sig2252 0 "FALSE" 1 "TRUE" ;
VAL_TABLE_ Sig2251 0 "FALSE" 1 "TRUE" ;
VAL_TABLE_ Sig2259 0 "FALSE" 1 "TRUE" ;
VAL_TABLE_ Sig2258 0 "FALSE" 1 "TRUE" ;
VAL_TABLE_ Sig2260 0 "FALSE" 1 "TRUE" ;
VAL_TABLE_ Sig2262 0 "Not Supported" 1 "Type A" 2 "Type B" 3 "Type C" ;
VAL_TABLE_ Sig2271 0 "FALSE" 1 "TRUE" ;
VAL_TABLE_ Sig2270 0 "FALSE" 1 "TRUE" ;
VAL_TABLE_ Sig2269 0 "FALSE" 1 "TRUE" ;
VAL_TABLE_ Sig2268 0 "FALSE" 1 "TRUE" ;
VAL_TABLE_ Sig2267 0 "FALSE" 1 "TRUE" ;
VAL_TABLE_ Sig2266 0 "FALSE" 1 "TRUE" ;
VAL_TABLE_ Sig2265 0 "FALSE" 1 "TRUE" ;
VAL_TABLE_ Sig2273 0 "FALSE" 1 "TRUE" ;
VAL_TABLE_ Sig2272 0 "FALSE" 1 "TRUE" ;
VAL_TABLE_ DTCI_VICM_CnfrmdDTC 0 "FALSE" 1 "TRUE" ;
VAL_TABLE_ DTCI_VICM_DTCFaultType 0 "Not Supported" 1 "Type A" 2 "Type B" 3 "Type C" ;
VAL_TABLE_ DTCI_VICM_TstNCmpltdOpCyc 0 "FALSE" 1 "TRUE" ;
VAL_TABLE_ DTCI_VICM_TstNCmpltdLstClr 0 "FALSE" 1 "TRUE" ;
VAL_TABLE_ DTCI_VICM_TstFldOpCyc 0 "FALSE" 1 "TRUE" ;
VAL_TABLE_ DTCI_VICM_TstFldLstClr 0 "FALSE" 1 "TRUE" ;
VAL_TABLE_ DTCI_VICM_TstFld 0 "FALSE" 1 "TRUE" ;
VAL_TABLE_ DTCI_VICM_PndngDTC 0 "FALSE" 1 "TRUE" ;
VAL_TABLE_ DTCI_VICM_DTCTriggered 0 "FALSE" 1 "TRUE" ;
VAL_TABLE_ DTCI_VICM_WrnIndTrggrd 0 "FALSE" 1 "TRUE" ;
VAL_TABLE_ DTCI_VICM_WrnIndRqd 0 "FALSE" 1 "TRUE" ;
VAL_TABLE_ Sig0722 0 "FALSE" 1 "TRUE" ;
VAL_TABLE_ Sig0721 0 "FALSE" 1 "TRUE" ;
VAL_TABLE_ Sig0716 0 "No Indication" 1 "Two Wheel Drive High Pending" 2 "Two Wheel Drive High Active" 3 "Four Wheel Drive High Auto Pending" 4 "Four Wheel Drive High Auto Active" 5 "Four Wheel Drive High Lock Pending" 6 "Four Wheel Drive High Lock Active" 7 "Four Wheel Drive Low Lock Pending" 8 "Four Wheel Drive Low Lock Active" 9 "Transfer Case Neutral Pending" 10 "Transfer Case Neutral Active" 11 "Position Undetermined Active" 12 "AWD Connected Mode Pending" 13 "AWD Connected Mode Active" 14 "Front Wheel Drive Mode Pending" 15 "Front Wheel Drive Mode Active" ;
VAL_TABLE_ DMSIP_DrvrAttnStatAuth 0 "Unknown" 1 "Attention is On Road" 2 "Attention is Off Road" 3 "Attention is Driver's Lap" 4 "Attention is Center Console / Radio" 5 "Driver\???s Eyes Fully Closed" 6 "Driver Window / Mirror" 7 "Passenger Window / Mirror" 8 "Rear View Mirror" 9 "Overhead Console" 10 "No Driver" 11 "Front IPC" ;
VAL_TABLE_ DMSDrvrAttnStatCnfdLvlAuth 0 "0" 1 "1" 2 "2" 3 "3" 4 "4" 5 "5" 6 "6" 7 "7" ;
VAL_TABLE_ DMSDrvrAttnStatAlgTypAuth 0 "Eye Gaze Used" 1 "Head Pose Used" ;
VAL_TABLE_ DMSIP_DrvrAttnStatAuth_Inv 0 "FALSE" 1 "TRUE" ;
VAL_TABLE_ DMSOpStatAuth 0 "Unknown" 1 "Initializing" 2 "Internal Fault" 3 "External Fault" 4 "Invalid Environment" 5 "Active" 6 "IR Emitter OFF" ;
VAL_TABLE_ TBI2P_TrlrBrkgManAppAtvAuth 0 "FALSE" 1 "TRUE" ;
VAL_TABLE_ BSAE44BP_AE44BrkgStsAuth 0 "Standby" 1 "Ready" 2 "Active Hold" 3 "Active Control" 4 "Finished Hold" 5 "Failed" ;
VAL_TABLE_ WRDSP_RFAuth 0 "Unknown" 1 "Not Supported" 2 "Invalid" 3 "Forward" 4 "Reverse" ;
VAL_TABLE_ WRDSP_LRAuth 0 "Unknown" 1 "Not Supported" 2 "Invalid" 3 "Forward" 4 "Reverse" ;
VAL_TABLE_ WRDSP_LFAuth 0 "Unknown" 1 "Not Supported" 2 "Invalid" 3 "Forward" 4 "Reverse" ;
VAL_TABLE_ VAP_ActlVehAccelAuth_Inv 0 "FALSE" 1 "TRUE" ;
VAL_TABLE_ SuprRmtPrkBrkResp 0 "Unavailable" 1 "Available" 2 "Active Hold" 3 "Active Control" 4 "Failed" ;
VAL_TABLE_ WRDSP_RRAuth 0 "Unknown" 1 "Not Supported" 2 "Invalid" 3 "Forward" 4 "Reverse" ;
VAL_TABLE_ Sig2467 0 "FALSE" 1 "TRUE" ;
VAL_TABLE_ EBCM_AV_CAN2_ClscCANHrtBtActv 0 "FALSE" 1 "TRUE" ;
VAL_TABLE_ EBCM_CAN2_ClscCANHrtBtActv 0 "FALSE" 1 "TRUE" ;
VAL_TABLE_ CustmStbCtlRdctReqConf 0 "No Action" 1 "No" 2 "Yes" ;
VAL_TABLE_ TrlrConnStat 0 "Not Connected" 1 "Connected" ;
VAL_TABLE_ EGI5_Eng12vStrtrMtrCmmdOn 0 "FALSE" 1 "TRUE" ;
VAL_TABLE_ Sig2502 0 "FALSE" 1 "TRUE" ;
VAL_TABLE_ ECP_E_CAN2_ClscCANHrtBtActv 0 "FALSE" 1 "TRUE" ;
VAL_TABLE_ Sig2506 0 "FALSE" 1 "TRUE" ;
VAL_TABLE_ Sig2507 0 "FALSE" 1 "TRUE" ;
VAL_TABLE_ Sig2509 0 "FALSE" 1 "TRUE" ;
VAL_TABLE_ Sig2511 0 "FALSE" 1 "TRUE" ;
VAL_TABLE_ ELSDIP_ActrStsAuth 0 "Normal" 1 "Temporary Inhibit" 2 "Temporary Limited" 3 "Permanently Failed" 4 "UnKnown" ;
VAL_TABLE_ FIMRIMABP_FIMCISAutBrkRqTypAuth 0 "None" 1 "Brake to Commanded Decel" 2 "Hold" ;
VAL_TABLE_ FIMRIMABP_BrkgReqAuth 0 "FALSE" 1 "TRUE" ;
VAL_TABLE_ RIMATRP_TrqRqstActAuth 0 "FALSE" 1 "TRUE" ;
VAL_TABLE_ FIMRIMABP_ReqActvAuth 0 "FALSE" 1 "TRUE" ;
VAL_TABLE_ FIMRIMABP_RIMAutoBrkgReqTypAuth 0 "None" 1 "Hold" ;
VAL_TABLE_ Sig2535 0 "FALSE" 1 "TRUE" ;
VAL_TABLE_ Sig2538 0 "FALSE" 1 "TRUE" ;
VAL_TABLE_ Sig2542 0 "FALSE" 1 "TRUE" ;
VAL_TABLE_ EPS_CAN2_ClscCANHrtBtActv 0 "FALSE" 1 "TRUE" ;
VAL_TABLE_ Sig2546 0 "FALSE" 1 "TRUE" ;
VAL_TABLE_ ESRSDP_ElecShftRngSecDispAuth 0 "No Display" 1 "Park Nominal" 2 "Reverse Nominal" 3 "Neutral Nominal" 4 "Drive Nominal" 5 "Low Nominal" 6 "Manual Nominal" 7 "Park Requested And In Progress" 8 "Reverse Requested And In Progress" 9 "Neutral Requested And In Progress" 10 "Drive Requested And In Progress" 11 "Manual Requested And In Progress" 12 "Park Requested And Denied" ;
VAL_TABLE_ ESVTSP_EnhdSrvsVhTpSpLimReqAuth 0 "No Action" 1 "Active" 2 "Inactive" ;
VAL_TABLE_ EHCCI_HtrCoreCoolFlwRtFdbk_Inv 0 "FALSE" 1 "TRUE" ;
VAL_TABLE_ EHCCI_HtrCoreInCoolTemp_Inv 0 "FALSE" 1 "TRUE" ;
VAL_TABLE_ EHCCI_HtrCoreOutCoolTemp_Inv 0 "FALSE" 1 "TRUE" ;
VAL_TABLE_ HtrCoreCoolMinFlwrtArbdReq_Inv 0 "FALSE" 1 "TRUE" ;
VAL_TABLE_ ELWWIP_CHMSLCmdAuth 0 "No_Action" 1 "Off" 2 "On" 3 "Emergency_Brake_Flashing" ;
VAL_TABLE_ ELWWIP_BrkLmpRtCmdAuth 0 "No_Action" 1 "Off" 2 "On" 3 "Emergency_Brake_Flashing" 4 "Police_Flashing" ;
VAL_TABLE_ ELWWIP_BrkLmpLtCmdAuth 0 "No_Action" 1 "Off" 2 "On" 3 "Emergency_Brake_Flashing" 4 "Police_Flashing" ;
VAL_TABLE_ ELWWIP_LoBmLtCmdAuth 0 "No_Request" 1 "Off" 2 "On" 3 "DRL_Intensity" 4 "Flashing" 5 "Alternate_Flashing" ;
VAL_TABLE_ ELWWIP_HiBmRtCmdAuth 0 "No_Request" 1 "Off" 2 "On" 3 "DRL_Intensity" 4 "Flashing" 5 "Alternate_Flashing" ;
VAL_TABLE_ ELWWIP_HiBmLtCmdAuth 0 "No_Request" 1 "Off" 2 "On" 3 "DRL_Intensity" 4 "Flashing" 5 "Alternate_Flashing" ;
VAL_TABLE_ ELWWIP_TrlrRvrsLmpsCmdAuth 0 "Off" 1 "On" 2 "Flashing" ;
VAL_TABLE_ ELWWIP_RvrsLmpCmdAuth 0 "Off" 1 "On" 2 "Flashing" ;
VAL_TABLE_ ELWWIP_LoBmRtCmdAuth 0 "No_Request" 1 "Off" 2 "On" 3 "DRL_Intensity" 4 "Flashing" 5 "Alternate_Flashing" ;
VAL_TABLE_ ELWWIP_WshFrtRrDrvCmdAuth 0 "No Front Rear Wash" 1 "Front Wash" 2 "Rear Wash" 3 "Front Rear Wash" ;
VAL_TABLE_ ELWWIP_WprFrtFtrReqAuth 0 "Wiper Front Stop" 1 "Wiper Front Crank Suspend" 2 "Wiper Front Depressed Park" 3 "Wiper Front Park" 4 "Wiper Front Winter Park" 5 "Wiper Front Service Park" 6 "Wiper Front Intermittent 5" 7 "Wiper Front Intermittent 4" 8 "Wiper Front Intermittent 3" 9 "Wiper Front Intermittent 2" 10 "Wiper Front Intermittent 1" 11 "Wiper Front Low Wipe" 12 "Wiper Front High Wipe" ;
VAL_TABLE_ Sig3206 0 "FALSE" 1 "TRUE" ;
VAL_TABLE_ Sig3257 0 "FALSE" 1 "TRUE" ;
VAL_TABLE_ Sig3242 0 "Derating Level 0" 1 "Derating Level 1" 2 "Derating Level 2" 3 "Derating Level 3" 4 "Derating Level 4" 5 "Derating Level 5" ;
VAL_TABLE_ Sig3241 0 "Pending" 1 "Failed" 2 "Active" 3 "Passed" ;
VAL_TABLE_ Sig3240 0 "Derating Level 0" 1 "Derating Level 1" 2 "Derating Level 2" 3 "Derating Level 3" 4 "Derating Level 4" 5 "Derating Level 5" ;
VAL_TABLE_ Sig3244 0 "Derating Level 0" 1 "Derating Level 1" 2 "Derating Level 2" 3 "Derating Level 3" 4 "Derating Level 4" 5 "Derating Level 5" ;
VAL_TABLE_ FOPMPI1P_FOPLdShdngReqAuth 0 "No Load Shedding" 1 "Load Shed Level 1" 2 "Load Shed Level 2" 3 "Load Shed Level 3" 4 "Load Shed Level 4" ;
VAL_TABLE_ Sig3243 0 "Pending" 1 "Failed" 2 "Active" 3 "Passed" ;
VAL_TABLE_ Sig3245 0 "Pending" 1 "Failed" 2 "Active" 3 "Passed" ;
VAL_TABLE_ Sig3231 0 "FALSE" 1 "TRUE" ;
VAL_TABLE_ Sig3233 0 "FALSE" 1 "TRUE" ;
VAL_TABLE_ GPSC_PPSLat_Inv 0 "FALSE" 1 "TRUE" ;
VAL_TABLE_ GPSC_PPSLong_Inv 0 "FALSE" 1 "TRUE" ;
VAL_TABLE_ HMII1P_LnFllwgChInterFltDtdAuth 0 "FALSE" 1 "TRUE" ;
VAL_TABLE_ HMII1P_IPCDispStsAuth 0 "Unknown" 1 "Normal" 2 "Fault" ;
VAL_TABLE_ HMII1P_ChmSysSOHAuth 0 "Unknown" 1 "Healthy" 2 "Faulted" ;
VAL_TABLE_ HMII1P_AutoModeSpdLimCnfrmdAuth 0 "FALSE" 1 "TRUE" ;
VAL_TABLE_ HMII1P_ACCSetTypAuth 0 "Manual" 1 "Auto" ;
VAL_TABLE_ Sig3538 0 "FALSE" 1 "TRUE" ;
VAL_TABLE_ Sig3562 0 "None" 1 "Bus Precharging" 2 "12V Gen Mode" 3 "Battery Connected" ;
VAL_TABLE_ Sig3561 0 "Request None" 1 "Normal Open" 2 "Controlled Open" 3 "Emergency Open" 4 "Request Close" ;
VAL_TABLE_ Sig3568 0 "None" 1 "Low Severity" 2 "Medium Severity" 3 "High Severity" ;
VAL_TABLE_ Sig3567 0 "Open" 1 "Precharge" 2 "Close" ;
VAL_TABLE_ Sig3566 0 "Indeterminate" 1 "False" 2 "True" ;
VAL_TABLE_ HSP_HptcStPrsntAuth 0 "FALSE" 1 "TRUE" ;
VAL_TABLE_ HSP_HptcStOprtlStsAuth 0 "Normal Operation" 1 "Unknown" 2 "Failed" ;
VAL_TABLE_ HSP_HptcStActvAuth 0 "FALSE" 1 "TRUE" ;
VAL_TABLE_ HSP_DrvAlrtTypCstCurrSetValAuth 0 "SETTING_UNKNOWN" 1 "CHIME" 2 "SEAT" ;
VAL_TABLE_ HptcStLnFllwgUnv 0 "FALSE" 1 "TRUE" ;
VAL_TABLE_ HVPPP_FrwdVsnModeCmdAuth 0 "Not Reporting Object Data" 1 "Reporting Object Data" ;
VAL_TABLE_ HVPPP_HstVehLatVelAuth_Inv 0 "FALSE" 1 "TRUE" ;
VAL_TABLE_ HVPPP_HstVehLngVelAuth_Inv 0 "FALSE" 1 "TRUE" ;
VAL_TABLE_ HVPPP_HstVehPathModeAuth 0 "Disabled" 1 "Low Speed" 2 "High Speed" ;
VAL_TABLE_ HVPPP_HstVehTrvlDirAuth 0 "Unknown" 1 "Forward or Stopped on a Forward Gear" 2 "Reversed or Stopped in a Reverse Gear" 3 "Other" ;
VAL_TABLE_ HVPPP_HstVehVelAuth_Inv 0 "FALSE" 1 "TRUE" ;
VAL_TABLE_ HVPPP_LngRngRadarModeCmdAuth 0 "Not Radiating" 1 "Not Reporting Object Data" 2 "Reporting" ;
VAL_TABLE_ HVPPP_HstVehYawRateAuth_Inv 0 "FALSE" 1 "TRUE" ;
VAL_TABLE_ HVPPP_ShrtRngRadarModeCmdAuth 0 "Not Radiating" 1 "Not Reporting Object Data" 2 "Reporting Object Data" ;
VAL_TABLE_ HVPPP_ObjsRetndRrwdSnsrsAuth 0 "Unknown" 1 "Objects Reported" 2 "No Objects Reported" ;
VAL_TABLE_ HVPPP_ObjsRetndFrwdSnsrsAuth 0 "Unknown" 1 "Objects Reported" 2 "No Objects Reported" ;
VAL_TABLE_ DrvrMonSysModeCmd 0 "Not Radiating" 1 "Not Reporting Object Data" 2 "Reporting Object Data" ;
VAL_TABLE_ LnFllwgFtrStatAuth 0 "Off" 1 "Unavailable" 2 "Disabled" 3 "Enabled" 4 "Active" 5 "Cautionary" 6 "Override" 7 "Degraded" 8 "No Return" 9 "Ended" 10 "Non-Responsive Driver" ;
VAL_TABLE_ HstVehRideHghtOfst_Inv 0 "FALSE" 1 "TRUE" ;
VAL_TABLE_ HstVehRideHghtOfstSts 0 "In Range" 1 "Out of Range" ;
VAL_TABLE_ Sig3583 0 "Unknown" 1 "Forward or Stopped on a Forward Gear" 2 "Reversed or Stopped in a Reverse Gear" 3 "Other" ;
VAL_TABLE_ Sig3581 0 "In Range" 1 "Out of Range" ;
VAL_TABLE_ Sig3582 0 "FALSE" 1 "TRUE" ;
VAL_TABLE_ Bat12VCfg 0 "PbA Only" 1 "Li Only" 2 "Dual PbA" 3 "Dual Li" 4 "Dual Mix- PbA Primary" 5 "Dual Mix- Li Primary" 6 "Reserved" 7 "Unknown Batt Type" ;
VAL_TABLE_ PTExPrtclFltrMnlRgnModeActvtd 0 "FALSE" 1 "TRUE" ;
VAL_TABLE_ IBSBatVlt_Inv 0 "FALSE" 1 "TRUE" ;
VAL_TABLE_ HptcStFldIndOn 0 "FALSE" 1 "TRUE" ;
VAL_TABLE_ StrgWhlTrqIntegSts 0 "Unknown" 1 "Redundant ASIL D" 2 "Non Redundant ASIL D" 3 "Failed" ;
VAL_TABLE_ StrgWhlHndsOffDtnStat 0 "Hands On" 1 "Hands Off" 2 "Unknown" ;
VAL_TABLE_ Sig7713 0 "NO_ACTION" 1 "ACTIVE" 2 "CANCEL_CHIME" 3 "RESERVED_1" ;
VAL_TABLE_ Sig7709 0 "SETTING_UNKNOWN" 1 "OFF" 2 "ALERT" 3 "RESERVED_3" 4 "RESERVED_4" 5 "RESERVED_5" 6 "RESERVED_6" 7 "RESERVED_7" ;
VAL_TABLE_ Sig3506 0 "SETTING_UNKNOWN" 1 "AUTOMATIC_HIGH_BEAM" 2 "GLARE_FREE_HIGH_BEAM" 3 "RESERVED_3" 4 "\?? RESERVED_4" 5 "RESERVED_5" 6 "RESERVED_6" 7 "RESERVED_7" ;
VAL_TABLE_ Sig3504 0 "FALSE" 1 "TRUE" ;
VAL_TABLE_ Sig3503 0 "FALSE" 1 "TRUE" ;
VAL_TABLE_ Sig3502 0 "FALSE" 1 "TRUE" ;
VAL_TABLE_ Sig3501 0 "FALSE" 1 "TRUE" ;
VAL_TABLE_ Sig3500 0 "FALSE" 1 "TRUE" ;
VAL_TABLE_ Sig3499 0 "FALSE" 1 "TRUE" ;
VAL_TABLE_ Sig3498 0 "FALSE" 1 "TRUE" ;
VAL_TABLE_ Sig0451 0 "FALSE" 1 "TRUE" ;
VAL_TABLE_ Sig7707 0 "FALSE" 1 "TRUE" ;
VAL_TABLE_ Sig7706 0 "FALSE" 1 "TRUE" ;
VAL_TABLE_ Sig7705 0 "FALSE" 1 "TRUE" ;
VAL_TABLE_ Sig7704 0 "FALSE" 1 "TRUE" ;
VAL_TABLE_ Sig7703 0 "FALSE" 1 "TRUE" ;
VAL_TABLE_ Sig7702 0 "FALSE" 1 "TRUE" ;
VAL_TABLE_ Sig7701 0 "FALSE" 1 "TRUE" ;
VAL_TABLE_ Sig3507 0 "FALSE" 1 "TRUE" ;
VAL_TABLE_ Sig7710 0 "FALSE" 1 "TRUE" ;
VAL_TABLE_ Sig7559 0 "UnKnown" 1 "No Sign Detected" 2 "End of Speed Limit" 3 "End of All Restrictions" 4 "Begin of Motorway" 5 "End of Motorway" 6 "Begin of Expressway" 7 "End of Expressway" 8 "Begin of Play Street Zone" 9 "End of Play Street Zone" 10 "Begin of Passing Restriction" 11 "End of Passing Restriction" 12 "No Entry" 13 "Begin of City Limits" 14 "End of City Limits" 15 "Speed Limit 5" 16 "Speed Limit 10" 17 "Speed Limit 15" 18 "Speed Limit 20" 19 "Speed Limit 25" 20 "Speed Limit 30" 21 "Speed Limit 35" 22 "Speed Limit 40" 23 "Speed Limit 45" 24 "Speed Limit 50" 25 "Speed Limit 55" 26 "Speed Limit 60" 27 "Speed Limit 65" 28 "Speed Limit 70" 29 "Speed Limit 75" 30 "Speed Limit 80" 31 "Speed Limit 85" 32 "Speed Limit 90" 33 "Speed Limit 95" 34 "Speed Limit 100" 35 "Speed Limit 105" 36 "Speed Limit 110" 37 "Speed Limit 115" 38 "Speed Limit 120" 39 "Speed Limit 125" 40 "Speed Limit 130" 41 "Speed Limit 135" 42 "Speed Limit 140" 43 "Speed Limit 145" 44 "Speed Limit 150" 45 "Speed Limit 155" 46 "Speed Limit 160" 47 "Speed Limit 165" 48 "Speed Limit 170" 49 "Speed Limit 175" 50 "Speed Limit 180" 51 "Speed Limit 185" 52 "Speed Limit 190" 53 "Speed Limit 195" 54 "Speed Limit 200" ;
VAL_TABLE_ Sig7557 0 "UnKnown" 1 "No Sign Detected" 2 "End of Speed Limit" 3 "End of All Restrictions" 4 "Begin of Motorway" 5 "End of Motorway" 6 "Begin of Expressway" 7 "End of Expressway" 8 "Begin of Play Street Zone" 9 "End of Play Street Zone" 10 "Begin of Passing Restriction" 11 "End of Passing Restriction" 12 "No Entry" 13 "Begin of City Limits" 14 "End of City Limits" 15 "Speed Limit 5" 16 "Speed Limit 10" 17 "Speed Limit 15" 18 "Speed Limit 20" 19 "Speed Limit 25" 20 "Speed Limit 30" 21 "Speed Limit 35" 22 "Speed Limit 40" 23 "Speed Limit 45" 24 "Speed Limit 50" 25 "Speed Limit 55" 26 "Speed Limit 60" 27 "Speed Limit 65" 28 "Speed Limit 70" 29 "Speed Limit 75" 30 "Speed Limit 80" 31 "Speed Limit 85" 32 "Speed Limit 90" 33 "Speed Limit 95" 34 "Speed Limit 100" 35 "Speed Limit 105" 36 "Speed Limit 110" 37 "Speed Limit 115" 38 "Speed Limit 120" 39 "Speed Limit 125" 40 "Speed Limit 130" 41 "Speed Limit 135" 42 "Speed Limit 140" 43 "Speed Limit 145" 44 "Speed Limit 150" 45 "Speed Limit 155" 46 "Speed Limit 160" 47 "Speed Limit 165" 48 "Speed Limit 170" 49 "Speed Limit 175" 50 "Speed Limit 180" 51 "Speed Limit 185" 52 "Speed Limit 190" 53 "Speed Limit 195" 54 "Speed Limit 200" ;
VAL_TABLE_ Sig7567 0 "UnKnown" 1 "No Sign Detected" 2 "Begin of Passing Restriction US" 3 "End of Passing Restriction US" 4 "Begin of Passing Restriction Canada" 5 "End of Passing Restriction Canada" 6 "Speed Limit 5" 7 "Speed Limit 10" 8 "Speed Limit 15" 9 "Speed Limit 20" 10 "Speed Limit 25" 11 "Speed Limit 30" 12 "Speed Limit 35" 13 "Speed Limit 40" 14 "Speed Limit 45" 15 "Speed Limit 50" 16 "Speed Limit 55" 17 "Speed Limit 60" 18 "Speed Limit 65" 19 "Speed Limit 70" 20 "Speed Limit 75" 21 "Speed Limit 80" 22 "Speed Limit 85" 23 "Speed Limit 90" 24 "Speed Limit 95" 25 "Speed Limit 100" 26 "Speed Limit 105" 27 "Speed Limit 110" 28 "Speed Limit 115" 29 "Speed Limit 120" 30 "Speed Limit 125" 31 "Speed Limit 130" 32 "Speed Limit 135" 33 "Speed Limit 140" 34 "Speed Limit 145" 35 "Speed Limit 150" 36 "Speed Limit 155" 37 "Speed Limit 160" 38 "Speed Limit 165" 39 "Speed Limit 170" 40 "Speed Limit 175" 41 "Speed Limit 180" 42 "Speed Limit 185" 43 "Speed Limit 190" 44 "Speed Limit 195" 45 "Speed Limit 200" ;
VAL_TABLE_ Sig7569 0 "UnKnown" 1 "No Sign Detected" 2 "Begin of Passing Restriction US" 3 "End of Passing Restriction US" 4 "Begin of Passing Restriction Canada" 5 "End of Passing Restriction Canada" 6 "Speed Limit 5" 7 "Speed Limit 10" 8 "Speed Limit 15" 9 "Speed Limit 20" 10 "Speed Limit 25" 11 "Speed Limit 30" 12 "Speed Limit 35" 13 "Speed Limit 40" 14 "Speed Limit 45" 15 "Speed Limit 50" 16 "Speed Limit 55" 17 "Speed Limit 60" 18 "Speed Limit 65" 19 "Speed Limit 70" 20 "Speed Limit 75" 21 "Speed Limit 80" 22 "Speed Limit 85" 23 "Speed Limit 90" 24 "Speed Limit 95" 25 "Speed Limit 100" 26 "Speed Limit 105" 27 "Speed Limit 110" 28 "Speed Limit 115" 29 "Speed Limit 120" 30 "Speed Limit 125" 31 "Speed Limit 130" 32 "Speed Limit 135" 33 "Speed Limit 140" 34 "Speed Limit 145" 35 "Speed Limit 150" 36 "Speed Limit 155" 37 "Speed Limit 160" 38 "Speed Limit 165" 39 "Speed Limit 170" 40 "Speed Limit 175" 41 "Speed Limit 180" 42 "Speed Limit 185" 43 "Speed Limit 190" 44 "Speed Limit 195" 45 "Speed Limit 200" ;
VAL_TABLE_ Sig7558 0 "UnKnown" 1 "None" 2 "Supp Sign Generic" 3 "Rain" 4 "Snow" 5 "Snow Rain" 6 "Rain Cloud" 7 "Fog" 8 "Time" 9 "Wet Conditions" 10 "Trailer" 11 "Tractor Passable" 12 "Arrow Left" 13 "Arrow Right" 14 "Distance Arrow" 15 "School" ;
VAL_TABLE_ Sig7556 0 "UnKnown" 1 "None" 2 "Supp Sign Generic" 3 "Rain" 4 "Snow" 5 "Snow Rain" 6 "Rain Cloud" 7 "Fog" 8 "Time" 9 "Wet Conditions" 10 "Trailer" 11 "Tractor Passable" 12 "Arrow Left" 13 "Arrow Right" 14 "Distance Arrow" 15 "School" ;
VAL_TABLE_ Sig3474 0 "FALSE" 1 "TRUE" ;
VAL_TABLE_ Sig3473 0 "FALSE" 1 "TRUE" ;
VAL_TABLE_ Sig7568 0 "None" 1 "Supp Sign Generic" 2 "School" 3 "School When Flashing" 4 "End of Speed Limit" 5 "Where Workers Present" ;
VAL_TABLE_ Sig7566 0 "None" 1 "Supp Sign Generic" 2 "School" 3 "School When Flashing" 4 "End of Speed Limit" 5 "Where Workers Present" ;
VAL_TABLE_ Sig7711 0 "FALSE" 1 "TRUE" ;
VAL_TABLE_ Sig7700 0 "FALSE" 1 "TRUE" ;
VAL_TABLE_ Sig7564 0 "FALSE" 1 "TRUE" ;
VAL_TABLE_ Sig7562 0 "FALSE" 1 "TRUE" ;
VAL_TABLE_ Sig7561 0 "FALSE" 1 "TRUE" ;
VAL_TABLE_ Sig7560 0 "FALSE" 1 "TRUE" ;
VAL_TABLE_ Sig7553 0 "FALSE" 1 "TRUE" ;
VAL_TABLE_ Sig3475 0 "FALSE" 1 "TRUE" ;
VAL_TABLE_ Sig7712 0 "FALSE" 1 "TRUE" ;
VAL_TABLE_ SBZALCAVisIndStatLt 0 "FLASHING" 1 "SOLID" 2 "OFF" ;
VAL_TABLE_ SBZALCAVisIndStatRt 0 "FLASHING" 1 "SOLID" 2 "OFF" ;
VAL_TABLE_ AutoHgBmActReq 0 "FALSE" 1 "TRUE" ;
VAL_TABLE_ LtFstAprchgVehObjDtd 0 "FALSE" 1 "TRUE" ;
VAL_TABLE_ RrCrsTrfcAlrtLftIndCtrl 0 "ON" 1 "OFF" 2 "FLASH" ;
VAL_TABLE_ RrCrsTrfcAlrtCstCrStVal 0 "SETTING_UNKNOWN" 1 "OFF" 2 "ALERT" 3 "ALERT and BRAKE" 4 "RESERVED_4" 5 "RESERVED_5" 6 "RESERVED_6" 7 "RESERVED_7" ;
VAL_TABLE_ LnChgAlrtCstCrStVal 0 "SETTING_UNKNOWN" 1 "OFF" 2 "ON" 3 "RESERVED_3" 4 "RESERVED_4" 5 "RESERVED_5" 6 "RESERVED_6" 7 "RESERVED_7" ;
VAL_TABLE_ LtSdVehObjDtd 0 "FALSE" 1 "TRUE" ;
VAL_TABLE_ SBZALCAOvrllOplSts 0 "NORMAL OPERATION" 1 "NEEDS SERVICE" 2 "TEMPORARY UNAVAILABLE" ;
VAL_TABLE_ RCTBAD_BrkgReqd 0 "FALSE" 1 "TRUE" ;
VAL_TABLE_ RCTBAD_BrkgReqTyp 0 "None" 1 "Hold" ;
VAL_TABLE_ RtFstAprchgVehObjDtd 0 "FALSE" 1 "TRUE" ;
VAL_TABLE_ RtSdVehObjDtd 0 "FALSE" 1 "TRUE" ;
VAL_TABLE_ RrCrsTrfcAlrtRgIndCtrl 0 "ON" 1 "OFF" 2 "FLASH" ;
VAL_TABLE_ E44OG1_Hght1 0 "Unknown" 1 "Traversable" 2 "High Object" 3 "Low Object" ;
VAL_TABLE_ E44OG1_Cnfd1 0 "Highly Speculative" 1 "Speculative" 2 "Confident" 3 "Highly Confident" ;
VAL_TABLE_ E44OG1_Typ1 0 "NoObject" 1 "Straight_0Corner" 2 "Straight_1Corner" 3 "Straight_2Corners" 4 "Point" 5 "Curbstone" 6 "Blind Area" ;
VAL_TABLE_ E44OG2_Hght2 0 "Unknown" 1 "Traversable" 2 "High Object" 3 "Low Object" ;
VAL_TABLE_ E44OG2_Cnfd2 0 "Highly Speculative" 1 "Speculative" 2 "Confident" 3 "Highly Confident" ;
VAL_TABLE_ E44OG2_Typ2 0 "NoObject" 1 "Straight_0Corner" 2 "Straight_1Corner" 3 "Straight_2Corners" 4 "Point" 5 "Curbstone" 6 "Blind Area" ;
VAL_TABLE_ E44OG3_Hght3 0 "Unknown" 1 "Traversable" 2 "High Object" 3 "Low Object" ;
VAL_TABLE_ E44OG3_Cnfd3 0 "Highly Speculative" 1 "Speculative" 2 "Confident" 3 "Highly Confident" ;
VAL_TABLE_ E44OG3_Typ3 0 "NoObject" 1 "Straight_0Corner" 2 "Straight_1Corner" 3 "Straight_2Corners" 4 "Point" 5 "Curbstone" 6 "Blind Area" ;
VAL_TABLE_ Sig4007 0 "FALSE" 1 "TRUE" ;
VAL_TABLE_ LnFllwgFtrStat 0 "Off" 1 "Unavailable" 2 "Disabled" 3 "Enabled" 4 "Active" 5 "Cautionary" 6 "Override" 7 "Degraded" 8 "No Return" 9 "Ended" 10 "Non-Responsive Driver" ;
VAL_TABLE_ PrkAsstCustSeltn 0 "Off" 1 "On" 2 "Failed" ;
VAL_TABLE_ E44OprtlSts 0 "Unavailable" 1 "Available" 2 "Failed" ;
VAL_TABLE_ PrkAsstONOFFCstCrStVal 0 "SETTING_UNKNOWN" 1 "OFF" 2 "ALERT" 3 "ALERT_BRAKE" 4 "RESERVED_4" 5 "RESERVED_5" 6 "RESERVED_6" 7 "RESERVED_7" ;
VAL_TABLE_ ElecPSOvrlyTrqDlvd_Inv 0 "FALSE" 1 "TRUE" ;
VAL_TABLE_ ElecPSTrqOvrlySts 0 "Unknown" 1 "Temporarily Inhibited" 2 "Inactive" 3 "Active" 4 "Temporarily Limited" 5 "Failed" ;
VAL_TABLE_ StrgEstdRckF_Inv 0 "FALSE" 1 "TRUE" ;
VAL_TABLE_ Sig7811 0 "FALSE" 1 "TRUE" ;
VAL_TABLE_ Sig7810 0 "FALSE" 1 "TRUE" ;
VAL_TABLE_ Sig7813 0 "FALSE" 1 "TRUE" ;
VAL_TABLE_ Sig0417 0 "NO INDICATION" 1 "FAILURE INDICATION" 2 "TOURIST MODE SETTING CHANGED" 3 "TOURIST MODE REMINDER" ;
VAL_TABLE_ Sig4160 0 "SETTING_UNKNOWN" 1 "LEFT_HAND_DRIVE" 2 "RIGHT_HAND_DRIVE" 3 "AUTOMATIC_WITH_GPS" 4 "RESERVED_4" 5 "RESERVED_5" 6 "RESERVED_6" 7 "RESERVED_7" ;
VAL_TABLE_ Sig0415 0 "SETTING_UNKNOWN" 1 "OFF" 2 "CORNER_AND_CURVE_LIGHTING" 3 "INTELLIGENT_LIGHT_DISTRIBUTION" 4 "INTELLIGENT_LIGHT_DISTRIBUTION_GPS_ASSISTANCE" 5 "RESERVED_5" 6 "RESERVED_6" 7 "RESERVED_7" ;
VAL_TABLE_ Sig0109 0 "FALSE" 1 "TRUE" ;
VAL_TABLE_ AFLServHdlmpsIndOn 0 "FALSE" 1 "TRUE" ;
VAL_TABLE_ Sig0108 0 "FALSE" 1 "TRUE" ;
VAL_TABLE_ Sig0107 0 "FALSE" 1 "TRUE" ;
VAL_TABLE_ Sig0106 0 "FALSE" 1 "TRUE" ;
VAL_TABLE_ Sig0105 0 "FALSE" 1 "TRUE" ;
VAL_TABLE_ Sig0104 0 "FALSE" 1 "TRUE" ;
VAL_TABLE_ Sig0103 0 "FALSE" 1 "TRUE" ;
VAL_TABLE_ Sig0413 0 "FALSE" 1 "TRUE" ;
VAL_TABLE_ Sig0412 0 "FALSE" 1 "TRUE" ;
VAL_TABLE_ Sig0411 0 "FALSE" 1 "TRUE" ;
VAL_TABLE_ Sig0410 0 "FALSE" 1 "TRUE" ;
VAL_TABLE_ Sig0409 0 "FALSE" 1 "TRUE" ;
VAL_TABLE_ Sig0408 0 "FALSE" 1 "TRUE" ;
VAL_TABLE_ Sig0407 0 "FALSE" 1 "TRUE" ;
VAL_TABLE_ Sig0110 0 "FALSE" 1 "TRUE" ;
VAL_TABLE_ Sig4157 0 "FALSE" 1 "TRUE" ;
VAL_TABLE_ Sig4156 0 "FALSE" 1 "TRUE" ;
VAL_TABLE_ Sig4155 0 "FALSE" 1 "TRUE" ;
VAL_TABLE_ Sig4154 0 "FALSE" 1 "TRUE" ;
VAL_TABLE_ Sig4153 0 "FALSE" 1 "TRUE" ;
VAL_TABLE_ Sig4152 0 "FALSE" 1 "TRUE" ;
VAL_TABLE_ AdvdFrtLgtSysHiBmIndOnReqd 0 "FALSE" 1 "TRUE" ;
VAL_TABLE_ Sig0416 0 "FALSE" 1 "TRUE" ;
VAL_TABLE_ Sig4161 0 "FALSE" 1 "TRUE" ;
VAL_TABLE_ Sig4158 0 "FALSE" 1 "TRUE" ;
VAL_TABLE_ AE44CtrlTctlFdbk 0 "FALSE" 1 "TRUE" ;
VAL_TABLE_ AE44CR_SptFndChmEvntStat 0 "NO_ACTION" 1 "ACTIVE" 2 "CANCEL_CHIME" ;
VAL_TABLE_ AE44CR_FaildChmEvntStat 0 "NO_ACTION" 1 "ACTIVE" 2 "CANCEL_CHIME" ;
VAL_TABLE_ AE44CR_CncldChmEvntStat 0 "NO_ACTION" 1 "ACTIVE" 2 "CANCEL_CHIME" ;
VAL_TABLE_ AE44CR_CmpltChmEvntStat 0 "NO_ACTION" 1 "ACTIVE" 2 "CANCEL_CHIME" ;
VAL_TABLE_ AE44CR_StopChmEvntStat 0 "NO_ACTION" 1 "ACTIVE" 2 "CANCEL_CHIME" ;
VAL_TABLE_ AE44WI_FcsReq 0 "NO_REQUEST" 1 "FOCUS_REQUEST_IPC" 2 "FOCUS_REQUEST_CSM" ;
VAL_TABLE_ AE44WI_AutoStrgIconReq 0 "NO_ICON" 1 "ACTIVE" 2 "DEACTIVATED" ;
VAL_TABLE_ AE44WI_WrnIndReq 0 "OFF" 1 "SEARCHING_PARALLEL_RIGHT" 2 "SEARCHING_PARALLEL_LEFT" 3 "SEARCHING_CROSS_RIGHT" 4 "SEARCHING_CROSS_LEFT" 5 "SPOT_FOUND" 6 "SPOT_FOUND_PARALLEL_LEFT" 7 "SPOT_FOUND_CROSS_LEFT" 8 "SPOT_FOUND_PARALLEL_RIGHT" 9 "SPOT_FOUND_CROSS_RIGHT" 10 "MOVE_AHEAD" 11 "MOVE_AHEAD_PARALLEL_LEFT" 12 "MOVE_AHEAD_CROSS_LEFT" 13 "MOVE_AHEAD_PARALLEL_RIGHT" 14 "MOVE_AHEAD_CROSS_RIGHT" 15 "STOP_AND_R_PARALLEL_LEFT" 16 "STOP_AND_R_CROSS_BACK_LEFT" 17 "STOP_AND_R_CROSS_FRONT_LEFT" 18 "STOP_AND_R_PARALLEL_RIGHT" 19 "STOP_AND_R_CROSS_BACK_RIGHT" 20 "STOP_AND_R_CROSS_FRONT_RIGHT" 21 "SEARCH_SPEED_WARNING" 22 "SEARCH_DEACTIVATED" 23 "EXIT_PARK_TO_LEFT" 24 "EXIT_PARK_TO_RIGHT" 25 "SELECT_DRIVE_GEAR" 26 "AUTO_STEERING_ACTIVE" 27 "AUTO_PARKING_ACTIVE" 28 "DRIVE_BACKWARD" 29 "BACKWARD_MOVE" 30 "DRIVE_FORWARD" 31 "FORWARD_MOVE" 32 "STOP" 33 "SHIFTING" 34 "POSITION_REACHED" 35 "TAKE_CONTROL" 36 "PARKING_COMPLETE" 37 "EXIT_PARK_COMPLETE" 38 "DEACTIVATED" 39 "CANCELED_GENERAL" 40 "CANCELED_MOVES" 41 "CANCELED_SPEED" 42 "CANCELED_INTERFERENCE" 43 "CANCELED_EXIT_PARK" 44 "STOPPING" 45 "AUTO_PARKING_COMPLETE" 46 "RELEASE_BRAKE" 47 "IN_VEHICLE_OR_REMOTE" 48 "REMOTE_STAY_ALERT" 49 "REMOTE_CONNECTING" 50 "REMOTE_CANNOT_CONNECT" 51 "REMOTE_NO_DEVICE" 52 "REMOTE_SHIFT_TO_PARK" 53 "REMOTE_RETRY" 54 "REMOTE_CANCELED_RANGE" 55 "REMOTE_CANCELED_SUPERVISION" 56 "REMOTE_CANCELED_CONNECTION" 57 "REMOTE_PAUSED_RANGE" 58 "REMOTE_PAUSED_SUPERVISION" 59 "REMOTE_PAUSED_CONNECTION" ;
VAL_TABLE_ AE44LftSftBtnRqst 0 "HIDDEN" 1 "DISABLED" 2 "ENABLED" 3 "HIGHLIGHTED" ;
VAL_TABLE_ AE44ExtPrkSftBtnRqst 0 "HIDDEN" 1 "DISABLED" 2 "ENABLED" 3 "HIGHLIGHTED" ;
VAL_TABLE_ AE44CrssFrntInSftBtnRqst 0 "HIDDEN" 1 "DISABLED" 2 "ENABLED" 3 "HIGHLIGHTED" ;
VAL_TABLE_ AE44CrssBckInSftBtnRqst 0 "HIDDEN" 1 "DISABLED" 2 "ENABLED" 3 "HIGHLIGHTED" ;
VAL_TABLE_ AE44VMR_SloDnIndOn 0 "FALSE" 1 "TRUE" ;
VAL_TABLE_ AE44VMR_NAvalIndOn 0 "FALSE" 1 "TRUE" ;
VAL_TABLE_ AE44SrchSftBtnRqst 0 "HIDDEN" 1 "DISABLED" 2 "ENABLED" 3 "HIGHLIGHTED" ;
VAL_TABLE_ AE44RghtSftBtnRqst 0 "HIDDEN" 1 "DISABLED" 2 "ENABLED" 3 "HIGHLIGHTED" ;
VAL_TABLE_ AE44PrllPrkSftBtnRqst 0 "HIDDEN" 1 "DISABLED" 2 "ENABLED" 3 "HIGHLIGHTED" ;
VAL_TABLE_ HVBI_BatPackPrcdVltg_Inv 0 "FALSE" 1 "TRUE" ;
VAL_TABLE_ HVBI_BatPackPrcdVltg_DuD 0 "FALSE" 1 "TRUE" ;
VAL_TABLE_ HiVltgBatPrcdCurr_DuD 0 "FALSE" 1 "TRUE" ;
VAL_TABLE_ HiVltgBatPrcdCurr_Inv 0 "FALSE" 1 "TRUE" ;
VAL_TABLE_ HVBSOC_BatSOC_Inv 0 "FALSE" 1 "TRUE" ;
VAL_TABLE_ HiVltgBatMaxTemp_Inv 0 "FALSE" 1 "TRUE" ;
VAL_TABLE_ HiVltgBatMaxTemp_DuD 0 "FALSE" 1 "TRUE" ;
VAL_TABLE_ HiVltgBatMinTemp_Inv 0 "FALSE" 1 "TRUE" ;
VAL_TABLE_ HiVltgBatMinTemp_DuD 0 "FALSE" 1 "TRUE" ;
VAL_TABLE_ Sig2661 0 "FALSE" 1 "TRUE" ;
VAL_TABLE_ Sig4453 0 "FALSE" 1 "TRUE" ;
VAL_TABLE_ Sig4449 0 "FALSE" 1 "TRUE" ;
VAL_TABLE_ Sig3606 0 "Indeterminate" 1 "False" 2 "True" ;
VAL_TABLE_ Sig3546 0 "Indeterminate" 1 "False" 2 "True" ;
VAL_TABLE_ Sig3545 0 "Indeterminate" 1 "False" 2 "True" ;
VAL_TABLE_ Sig0521 0 "P0_Powertrain Codes SAE Controlled" 1 "P1_Powertrain Codes MFG Controlled" 2 "P2_Powertrain Codes Reserved" 3 "P3_Powertrain Codes Reserved" 4 "C0_Chassis Codes SAE Controlled" 5 "C1_Chassis Codes MFG Controlled" 6 "C2_Chassis Codes Reserved" 7 "C3_Chassis Codes Reserved" 8 "B0_Body Codes SAE Controlled" 9 "B1_Body Codes MFG Controlled" 10 "B2_Body Codes Reserved" 11 "B3_Body Codes Reserved" 12 "U0_Network Codes SAE Controlled" 13 "U1_Network Codes MFG Controlled" 14 "U2_Network Codes Reserved" 15 "U3_Network Codes Reserved" ;
VAL_TABLE_ Sig0526 0 "FALSE" 1 "TRUE" ;
VAL_TABLE_ Sig4451 0 "FALSE" 1 "TRUE" ;
VAL_TABLE_ Sig4450 0 "FALSE" 1 "TRUE" ;
VAL_TABLE_ Sig4919 0 "NONE" 1 "SETPOINT1" 2 "SETPOINT2" 3 "SETPOINT3" 4 "SETPOINT4" ;
VAL_TABLE_ HiVltgBatOutOfEngyIndReq 0 "No Action" 1 "Charge Soon" 2 "Charge Now" 3 "Out of Energy" 4 "Start Engine" ;
VAL_TABLE_ PrplDispEngTrq_Inv 0 "FALSE" 1 "TRUE" ;
VAL_TABLE_ PrplDispEngTrq_DuD 0 "FALSE" 1 "TRUE" ;
VAL_TABLE_ HiVltgThrmlTotPwrUsd_Inv 0 "FALSE" 1 "TRUE" ;
VAL_TABLE_ ChrgSysShfToPrkReqd 0 "FALSE" 1 "TRUE" ;
VAL_TABLE_ JmpStrtEnbld 0 "FALSE" 1 "TRUE" ;
VAL_TABLE_ HiVltgBatGridCnctd 0 "FALSE" 1 "TRUE" ;
VAL_TABLE_ CoolFanFrtEndOutEnbl 0 "FALSE" 1 "TRUE" ;
VAL_TABLE_ HiVltgBatCoolTempSnsrVal_Inv 0 "FALSE" 1 "TRUE" ;
VAL_TABLE_ ChrgSysAudblIndReq 0 "No Action" 1 "Off" 2 "Charge Cord Sound 1" 3 "Charge Cord Sound 2" 4 "Charge Cord Sound 3" 5 "Charge Cord Sound 4" 6 "Charge Cord Sound 5" 7 "Theft" ;
VAL_TABLE_ PwrElecCoolPmpSpdActlDgFltActv 0 "FALSE" 1 "TRUE" ;
VAL_TABLE_ HiVltgBatThrmlMode 0 "Not Active" 1 "Active Cool" 2 "Active Heat" ;
VAL_TABLE_ GPSV_PPSCalcdSpd_Inv 0 "FALSE" 1 "TRUE" ;
VAL_TABLE_ GPSV_PPSElvtn_Inv 0 "FALSE" 1 "TRUE" ;
VAL_TABLE_ GPSQM_PPSPstnDilutnPrcsn_Inv 0 "FALSE" 1 "TRUE" ;
VAL_TABLE_ GPSV_PPSHdg_Inv 0 "FALSE" 1 "TRUE" ;
VAL_TABLE_ GPSQM_PPSAbsVelErrEst_Inv 0 "FALSE" 1 "TRUE" ;
VAL_TABLE_ GPST_PPSTmOfDy_Inv 0 "FALSE" 1 "TRUE" ;
VAL_TABLE_ JmpStrtReqd 0 "FALSE" 1 "TRUE" ;
VAL_TABLE_ HillDscntCtlModeSwActv 0 "FALSE" 1 "TRUE" ;
VAL_TABLE_ HillDscntCtlModeSwActv_Inv 0 "FALSE" 1 "TRUE" ;
VAL_TABLE_ WndPstnStsRF 0 "Denormalized" 1 "Fully Closed" 2 "Less Than Position A" 3 "Position A" 4 "Greater Than A but less than Position C" 5 "Position C" 6 "Greater than Position C but less than Fully open" 7 "Fully Open" ;
VAL_TABLE_ WndPstnStsLF 0 "Denormalized" 1 "Fully Closed" 2 "Less Than Position A" 3 "Position A" 4 "Greater Than A but less than Position C" 5 "Position C" 6 "Greater than Position C but less than Fully open" 7 "Fully Open" ;
VAL_TABLE_ PrkLmpsAct 0 "FALSE" 1 "TRUE" ;
VAL_TABLE_ FgLmpFrtRtCmd 0 "FALSE" 1 "TRUE" ;
VAL_TABLE_ FgLmpFrtLftCmd 0 "FALSE" 1 "TRUE" ;
VAL_TABLE_ LogisticModeStatus 0 "Off" 1 "Plant" 2 "Transport Mode" 3 "Storage Mode" ;
VAL_TABLE_ AutoBmSlctAllwd 0 "FALSE" 1 "TRUE" ;
VAL_TABLE_ AutoBmSlctAllwd_Inv 0 "FALSE" 1 "TRUE" ;
VAL_TABLE_ GPSQM_PPS2DAbsPstnErrEst_Inv 0 "FALSE" 1 "TRUE" ;
VAL_TABLE_ ValetModeActive 0 "FALSE" 1 "TRUE" ;
VAL_TABLE_ GPSQM_PPS3DAbsPstnErrEst_Inv 0 "FALSE" 1 "TRUE" ;
VAL_TABLE_ EE46etptPrty 0 "Low Priority" 1 "Medium Priority" 2 "High Priority" ;
VAL_TABLE_ FrntPCMRspTypCstChgSetReq 0 "NO_ACTION" 1 "OFF" 2 "ALERT" 3 "ALERT_AND_BRAKE" 4 "ALERT_AND_BRAKE_AND_STEER" 5 "RESERVED_5" 6 "RESERVED_6" 7 "RESERVED_7" ;
VAL_TABLE_ Sig0414 0 "NO_ACTION" 1 "OFF" 2 "CORNER_AND_CURVE_LIGHTING" 3 "INTELLIGENT_LIGHT_DISTRIBUTION" 4 "INTELLIGENT_LIGHT_DISTRIBUTION_GPS_ASSISTANCE" 5 "RESERVED_5" 6 "RESERVED_6" 7 "RESERVED_7" ;
VAL_TABLE_ Sig3505 0 "NO_ACTION" 1 "AUTOMATIC_HIGH_BEAM" 2 "GLARE_FREE_HIGH_BEAM" 3 "RESERVED_3" 4 "RESERVED_4" 5 "RESERVED_5" 6 "RESERVED_6" 7 "RESERVED_7" ;
VAL_TABLE_ FrwdImpMtgnOpSlctCstChgSetReq 0 "NO_ACTION" 1 "OFF" 2 "ALERT" 3 "ALERT_BRAKE" 4 "ALERT_BRAKE_STEER" 5 "RESERVED_5" 6 "RESERVED_6" 7 "RESERVED_7" ;
VAL_TABLE_ Sig7708 0 "NO_ACTION" 1 "OFF" 2 "ALERT" 3 "RESERVED_3" 4 "RESERVED_4" 5 "RESERVED_5" 6 "RESERVED_6" 7 "RESERVED_7" ;
VAL_TABLE_ Sig4159 0 "NO_ACTION" 1 "LEFT_HAND_DRIVE" 2 "RIGHT_HAND_DRIVE" 3 "AUTOMATIC_WITH_GPS" 4 "RESERVED_4" 5 "RESERVED_5" 6 "RESERVED_6" 7 "RESERVED_7" ;
VAL_TABLE_ GoNotfrCstChgSetReq 0 "NO_ACTION" 1 "OFF" 2 "ON" 3 "RESERVED_3" 4 "RESERVED_4" 5 "RESERVED_5" 6 "RESERVED_6" 7 "RESERVED_7" ;
VAL_TABLE_ Sig2570 0 "No Action" 1 "Off" 2 "On" ;
VAL_TABLE_ DispMeasSysExtnd 0 "US" 1 "IMPERIAL" 2 "Metric KM/L" 3 "Metric L/100KM" ;
VAL_TABLE_ CoDrvDrAjrStat 0 "FALSE" 1 "TRUE" ;
VAL_TABLE_ CoDrvDrAjrStat_Inv 0 "FALSE" 1 "TRUE" ;
VAL_TABLE_ AutoVehHldSwActv 0 "FALSE" 1 "TRUE" ;
VAL_TABLE_ AutoVehHldSwActv_Inv 0 "FALSE" 1 "TRUE" ;
VAL_TABLE_ LRDrAjrStat_Inv 0 "FALSE" 1 "TRUE" ;
VAL_TABLE_ LDWCtrlIndStat 0 "OFF" 1 "ON" 2 "FAULT" 3 "UNKNOWN" ;
VAL_TABLE_ HtdStrgWhlInd 0 "Off" 1 "Low" 2 "Med" 3 "High" ;
VAL_TABLE_ HtdStrgWhlCmd 0 "Off" 1 "Low" 2 "Med" 3 "High" ;
VAL_TABLE_ AE44CrssBckInSftBtnStat 0 "NOT_PRESSED" 1 "PRESSED" ;
VAL_TABLE_ RRDrAjrStat 0 "FALSE" 1 "TRUE" ;
VAL_TABLE_ RRDrAjrStat_Inv 0 "FALSE" 1 "TRUE" ;
VAL_TABLE_ Sig4423 0 "No Action" 1 "Increase" 2 "Decrease" 3 "Set to default" ;
VAL_TABLE_ Sig4421 0 "No Action" 1 "Increase" 2 "Decrease" 3 "Set to default" ;
VAL_TABLE_ LRDrAjrStat 0 "FALSE" 1 "TRUE" ;
VAL_TABLE_ AE44RghtSftBtnStatIPC 0 "NOT_PRESSED" 1 "PRESSED" ;
VAL_TABLE_ AE44RghtSftBtnStat 0 "NOT_PRESSED" 1 "PRESSED" ;
VAL_TABLE_ AE44PrllPrkSftBtnStat 0 "NOT_PRESSED" 1 "PRESSED" ;
VAL_TABLE_ AE44LftSftBtnStatIPC 0 "NOT_PRESSED" 1 "PRESSED" ;
VAL_TABLE_ AE44LftSftBtnStat 0 "NOT_PRESSED" 1 "PRESSED" ;
VAL_TABLE_ AE44FcStatIPC 0 "NO_FOCUS" 1 "FOCUS" ;
VAL_TABLE_ AE44FcStatCSM 0 "NO_FOCUS" 1 "FOCUS" ;
VAL_TABLE_ AE44ExtPrkSftBtnStat 0 "NOT_PRESSED" 1 "PRESSED" ;
VAL_TABLE_ DM5Denied 0 "FALSE" 1 "TRUE" ;
VAL_TABLE_ DM4Denied 0 "FALSE" 1 "TRUE" ;
VAL_TABLE_ DM3Denied 0 "FALSE" 1 "TRUE" ;
VAL_TABLE_ DM2Denied 0 "FALSE" 1 "TRUE" ;
VAL_TABLE_ DM1Denied 0 "FALSE" 1 "TRUE" ;
VAL_TABLE_ CrshEvntEnbld 0 "FALSE" 1 "TRUE" ;
VAL_TABLE_ ClsnEvntDatRcrdgTrgrd 0 "FALSE" 1 "TRUE" ;
VAL_TABLE_ AE44SrchSftBtnStat 0 "NOT_PRESSED" 1 "PRESSED" ;
VAL_TABLE_ Sig3484 0 "FALSE" 1 "TRUE" ;
VAL_TABLE_ FlToPsSwAtv 0 "FALSE" 1 "TRUE" ;
VAL_TABLE_ DispMeasSys 0 "Metric" 1 "English" ;
VAL_TABLE_ DM8Denied 0 "FALSE" 1 "TRUE" ;
VAL_TABLE_ DM7Denied 0 "FALSE" 1 "TRUE" ;
VAL_TABLE_ DM6Denied 0 "FALSE" 1 "TRUE" ;
VAL_TABLE_ RstrCstDfltReq 0 "FALSE" 1 "TRUE" ;
VAL_TABLE_ LowBmAct 0 "FALSE" 1 "TRUE" ;
VAL_TABLE_ LDWCSwCktShrtGndDiagFltActv 0 "FALSE" 1 "TRUE" ;
VAL_TABLE_ LDWCSwCktShrtBatOpnDiagFltActv 0 "FALSE" 1 "TRUE" ;
VAL_TABLE_ HtdWhlTempAmbtAirEstdOrgn 0 "Inside" 1 "Outside" ;
VAL_TABLE_ HtdStrgWhlEnbl 0 "FALSE" 1 "TRUE" ;
VAL_TABLE_ HtdStrgWhlCtlSrc 0 "Local_Switch_Control" 1 "Remote_Switch_Control" ;
VAL_TABLE_ HighBmAct 0 "FALSE" 1 "TRUE" ;
VAL_TABLE_ SBZAlrtCstCrStVal 0 "SETTING_UNKNOWN" 1 "OFF" 2 "ON" 3 "RESERVED_3" 4 "RESERVED_4" 5 "RESERVED_5" 6 "RESERVED_6" 7 "RESERVED_7" ;
VAL_TABLE_ WlcmLgtsActv 0 "FALSE" 1 "TRUE" ;
VAL_TABLE_ Sig7578 0 "12 Hour Mode" 1 "24 Hour Mode" ;
VAL_TABLE_ TargaTopAjrStat 0 "FALSE" 1 "TRUE" ;
VAL_TABLE_ Sig7570 0 "TSM Warning Off" 1 "TSM Warning On" ;
VAL_TABLE_ Sig7565 0 "FALSE" 1 "TRUE" ;
VAL_TABLE_ Sig7563 0 "FALSE" 1 "TRUE" ;
VAL_TABLE_ Sig7555 0 "FALSE" 1 "TRUE" ;
VAL_TABLE_ AE44LtSftBtnSts 0 "Not Pressed" 1 "Pressed" ;
VAL_TABLE_ AE44ExtPrkSftBtnSts 0 "Not Pressed" 1 "Pressed" ;
VAL_TABLE_ AE44CrssFrntInSftBtnStat 0 "Not Pressed" 1 "Pressed" ;
VAL_TABLE_ AE44CrsBkInSftBtnSts 0 "Not Pressed" 1 "Pressed" ;
VAL_TABLE_ Sig0604 0 "Unknown" 1 "Healthy" 2 "Faulted" ;
VAL_TABLE_ SuprRmtPrkDctvSoftBtnSts 0 "Not Pressed" 1 "Pressed" ;
VAL_TABLE_ AE44SrchingSftBtnSts 0 "Not Pressed" 1 "Pressed" ;
VAL_TABLE_ AE44RtSftBtnStsIPC 0 "Not Pressed" 1 "Pressed" ;
VAL_TABLE_ AE44RtSftBtnSts 0 "Not Pressed" 1 "Pressed" ;
VAL_TABLE_ AE44ParallelPrkSftBtnSts 0 "Not Pressed" 1 "Pressed" ;
VAL_TABLE_ AE44LtSftBtnStsIPC 0 "Not Pressed" 1 "Pressed" ;
VAL_TABLE_ SRPUnableCnctExtSftBtnSts 0 "Not Pressed" 1 "Pressed" ;
VAL_TABLE_ SRPUnableCnctTryAgnSftBtnSts 0 "Not Pressed" 1 "Pressed" ;
VAL_TABLE_ SRPSptSeltnRmtSftBtnSts 0 "Not Pressed" 1 "Pressed" ;
VAL_TABLE_ SRPSptSeltnKeepLkSftBtnSts 0 "Not Pressed" 1 "Pressed" ;
VAL_TABLE_ SRPSptSeltnAcceptSftBtnSts 0 "Not Pressed" 1 "Pressed" ;
VAL_TABLE_ Sig0076 0 "UNKNOWN" 1 "<= 5 KM/H [MPH]" 2 "7 KM/H [MPH]" 3 "10 KM/H [MPH]" 4 "15 KM/H [MPH]" 5 "20 KM/H [MPH]" 6 "25 KM/H [MPH]" 7 "30 KM/H [MPH]" 8 "35 KM/H [MPH]" 9 "40 KM/H [MPH]" 10 "45 KM/H [MPH]" 11 "50 KM/H [MPH]" 12 "55 KM/H [MPH]" 13 "60 KM/H" 14 "MPH]65 KM/H [MPH]" 15 "70 KM/H [MPH]" 16 "75 KM/H [MPH]" 17 "80 KM/H [MPH]" 18 "85 KM/H [MPH]" 19 "90 KM/H [MPH]" 20 "95 KM/H [MPH]" 21 "100 KM/H [MPH]" 22 "105 KM/H [MPH]" 23 "110 KM/H [MPH]" 24 "115 KM/H [MPH]" 25 "120 KM/H[MPH]" 26 "130 KM/H [MPH]" 27 "140 KM/H [MPH]" 28 "150 KM/H [MPH]" 29 "160 KM/H [MPH]" 30 "UNLIMITED" 31 "NOT AVAILABLE" ;
VAL_TABLE_ Sig0074 0 "AD" 1 "AT" 2 "BE" 3 "CZ" 4 "DK" 5 "EE" 6 "FR" 7 "DE" 8 "GR" 9 "HU" 10 "IE" 11 "IT" 12 "BY" 13 "BG" 14 "CY" 15 "MT" 16 "HR" 17 "TR" 18 "RS" 19 "ME" 20 "LV" 21 "LT" 22 "LU" 23 "NL" 24 "NO" 25 "PL" 26 "PT" 27 "UK" 28 "SK" 29 "SI" 30 "ES" 31 "SE" 32 "CH" 33 "RO" 34 "RU" 35 "UA" 36 "BA" 37 "AL" 38 "MD" 39 "IS" 40 "MK" 41 "US" 42 "ZA" 43 "AU" 44 "NZ" 45 "KR" 46 "CN" ;
VAL_TABLE_ InfoSysStat 0 "Sleep" 1 "AnimationInit" 2 "HMI_Init" 3 "HMI_Inactive" 4 "Start" 5 "Run" 6 "Propulsion" 7 "Accessory" 8 "LocalInfotainment" 9 "LocalPhone" 10 "LocalValet" 11 "LocalEject" 12 "ValetMode" 13 "TheftLocked" 14 "NoCalibration" 15 "NoVIN" 16 "RemoteReflashProgramming" 17 "OffMode" 18 "VirtualSwitchDisplay" 19 "NoInVehicleInfotainment" ;
VAL_TABLE_ Sig0077 0 "NO PASSING RESTRICTIONS" 1 "GENERAL NO OVERTAKE" 2 "FLUCTUATING (E.G. LED SIGNS)" 3 "CONDITIONAL PASSENGER CAR WITH TRAILER" 4 "CONDITIONAL TRACTORS ARE ALLOWED TO OVERTAKE" 5 "CONDITIONAL WHEN WET" 6 "CONDITIONAL WHEN SNOW" 7 "UNKNOWN CONDITION" ;
VAL_TABLE_ CTGI2P_CnvtTopStsAuth_Inv 0 "FALSE" 1 "TRUE" ;
VAL_TABLE_ CTGI2P_CnvtTopStsAuth_DuD 0 "FALSE" 1 "TRUE" ;
VAL_TABLE_ CTGI2P_CnvtTopStsAuth 0 "Indeterminate" 1 "Fully Closed" 2 "Fully Open" 3 "Closing" 4 "Opening" 5 "Halted" ;
VAL_TABLE_ TDAP_DrvrIdfrAuth 0 "Driver 1" 1 "Driver 2" 2 "Driver 3" 3 "Driver 4" 4 "Driver 5" 5 "Driver 6" 6 "Driver 7" 7 "Unknown" ;
VAL_TABLE_ Sig0075 0 "LANE DEPENDENT" 1 "ONLY BY FOG" 2 "ONLY BY NIGHT" 3 "ONLY BY DAY" 4 "BY TIME OF DAY" 5 "ONLY BY RAIN" 6 "ONLY BY SNOW" 7 "UNKNOWN" ;
VAL_TABLE_ Sig0073 0 "ROAD IS NOT CONTROLLED ACCESS ROAD" 1 "ROAD IS CONTROLLED ACCESS ROAD" ;
VAL_TABLE_ Sig0072 0 "NOT VALID" 1 "VALID" ;
VAL_TABLE_ TrnSwAct 0 "NO_ACTIVATION" 1 "LEFT" 2 "RIGHT" ;
VAL_TABLE_ FrtStrgeCmptAjr 0 "FALSE" 1 "TRUE" ;
VAL_TABLE_ FrtStrgeCmptAjr_Inv 0 "FALSE" 1 "TRUE" ;
VAL_TABLE_ AE44SftBtnSeltdStatRw 0 "Not_Pressed" 1 "Pressed" 2 "Unknown" 3 "Failed" ;
VAL_TABLE_ PrkAsstTrHtchPsntCstChgSetReq 0 "NO_ACTION" 1 "OFF_NOT_ATTACHED" 2 "ON_ATTACHED" 3 "RESERVED_3" 4 "RESERVED_4" 5 "RESERVED_5" 6 "RESERVED_6" 7 "RESERVED_7" ;
VAL_TABLE_ PrkAsstOnOffCstChgSetReq 0 "No_Action" 1 "Off" 2 "Alert" 3 "Alert_Brake" ;
VAL_TABLE_ SuprRmtPrkFcsStsVCU 0 "No Focus" 1 "Focus" ;
VAL_TABLE_ RPSU_Mth 0 "Unknown" 1 "January" 2 "February" 3 "March" 4 "April" 5 "May" 6 "June" 7 "July" 8 "August" 9 "September" 10 "October" 11 "November" 12 "December" ;
VAL_TABLE_ RPSU_Sts 0 "Unknown" 1 "Inactive" 2 "Scheduled" ;
VAL_TABLE_ ONPC_DprtrDyOfWkReq 0 "Unknown" 1 "Sunday" 2 "Monday" 3 "Tuesday" 4 "Wednesday" 5 "Thursday" 6 "Friday" 7 "Saturday" ;
VAL_TABLE_ ONPC_Req 0 "No Action" 1 "Charge Now" 2 "Charge Later" ;
VAL_TABLE_ LnchCtlEngRPMReq 0 "No Action" 1 "800" 2 "900" 3 "1000" 4 "1100" 5 "1200" 6 "1300" 7 "1400" 8 "1500" 9 "1600" 10 "1700" 11 "1800" 12 "1900" 13 "2000" 14 "2100" 15 "2200" 16 "2300" 17 "2400" 18 "2500" 19 "2600" 20 "2700" 21 "2800" 22 "2900" 23 "3000" 24 "3100" 25 "3200" 26 "3300" 27 "3400" 28 "3500" 29 "3600" 30 "3700" 31 "3800" 32 "3900" 33 "4000" 34 "FlexibleRPM 1" 35 "FlexibleRPM 2" 36 "FlexibleRPM 3" 37 "FlexibleRPM 4" 38 "FlexibleRPM 5" ;
VAL_TABLE_ LBCCDRR_PstnNumReq 0 "No Action" 1 "Position Number 1" 2 "Position Number 2" 3 "Position Number 3" 4 "Position Number 4" ;
VAL_TABLE_ LBCCDRR_ClrStrdPstnReq 0 "No Action" 1 "Request to Clear Position" 2 "Confirmation to Clear Position" ;
VAL_TABLE_ LnchCtlWhlSlReq 0 "No Action" 1 "Five Percent" 2 "Five And A Half Percent" 3 "Six Percent" 4 "Six And A Half Percent" 5 "Seven Percent" 6 "Seven And A Half Percent" 7 "Eight Percent" 8 "Eight And A Half Percent" 9 "Nine Percent" 10 "Nine And A Half Percent" 11 "Ten Percent" 12 "Ten And A Half Percent" 13 "Eleven Percent" 14 "Eleven And a Half Percent" 15 "Twelve Percent" 16 "Twelve And A Half Percent" 17 "Thirteen Percent" 18 "Thirteen And A Half Percent" 19 "Fourteen Percent" 20 "Fourteen And A Half Percent" 21 "Fifteen Percent" ;
VAL_TABLE_ Sig4819 0 "No Action" 1 "RPM 1100" 2 "RPM 1200" 3 "RPM 1300" 4 "RPM 1400" 5 "RPM 1500" 6 "RPM 1600" 7 "RPM 1700" 8 "RPM 1800" 9 "RPM 1900" 10 "RPM 2000" 11 "RPM 2100" 12 "RPM 2200" 13 "RPM 2300" 14 "RPM 2400" 15 "RPM 2500" ;
VAL_TABLE_ Sig4614 0 "No Action" 1 "Min 10" 2 "Min 30" 3 "Min 90" 4 "Min 120" 5 "Min 150" 6 "Min 180" 7 "Min 210" 8 "Min 240" 9 "Min 270" 10 "Min 200" 11 "Min 330" 12 "Min 360" 13 "Min 390" 14 "Min 420" 15 "Min 450" ;
VAL_TABLE_ AutoLnChgCstChgSetReq 0 "No Action" 1 "Off" 2 "On" 3 "LCOD" 4 "LCOD and ALC" ;
VAL_TABLE_ Sig4842 0 "No Action" 1 "RPM 1700" 2 "RPM 1800" 3 "RPM 1900" 4 "RPM 2000" 5 "RPM 2100" 6 "RPM 2200" 7 "RPM 2300" 8 "RPM 2400" 9 "RPM 2500" 10 "RPM 2600" 11 "RPM 2700" 12 "RPM 2800" 13 "RPM 2900" 14 "RPM 3000" 15 "RPM 3100" ;
VAL_TABLE_ Sig4867 0 "No Action" 1 "RPM 900" 2 "RPM 1000" 3 "RPM 1100" 4 "RPM 1200" 5 "RPM 1300" 6 "RPM 1400" 7 "RPM 1500" ;
VAL_TABLE_ LocBsdChrgPstnMdfnReq 0 "No Action" 1 "Store Position 1" 2 "Store Position 2" 3 "Store Position 3" 4 "Store Position 4" ;
VAL_TABLE_ BrkPadLifeSysDrvrReq 0 "No Action" 1 "Disable" 2 "Enable" 3 "Reset Front" 4 "Reset Rear" ;
VAL_TABLE_ PrkAsstStat 0 "OFF" 1 "STANDBY" 2 "DISABLED" 3 "FAILED" 4 "FRONT_REAR_ACTIVE" 5 "REAR_ACTIVE" 6 "FRONT_ACTIVE" 7 "UNKNOWN" ;
VAL_TABLE_ Sig4889 0 "No Action" 1 "RPM 5" 2 "RPM 10" 3 "RPM 25" 4 "RPM 50" 5 "RPM 100" 6 "RPM 250" 7 "RPM 500" ;
VAL_TABLE_ ChrgDatReq 0 "No Action" 1 "Wakeup Init All" 2 "Reinit All" 3 "Reinit Partial" ;
VAL_TABLE_ ChrgCordThftAlrtCstSetReq 0 "No Action" 1 "Off" 2 "On" ;
VAL_TABLE_ LnchCtlModeReq 0 "No Action" 1 "Automatic" 2 "Custom" 3 "Line Lock" ;
VAL_TABLE_ HillDscntCtlCurrStatReq 0 "No Action" 1 "Disable" 2 "Enable" ;
VAL_TABLE_ ChrgSysAudblIndCstSetReq 0 "No Action" 1 "Off" 2 "On" ;
VAL_TABLE_ ChrgPwrLossAlrtCstSetReq 0 "No Action" 1 "Off" 2 "On" ;
VAL_TABLE_ Sig4693 0 "No Action" 1 "Standard" 2 "Remote" ;
VAL_TABLE_ Sig4631 0 "No Action" 1 "Preset" 2 "Variable" ;
VAL_TABLE_ LocBsdChrgCstSetReq 0 "No Action" 1 "Off" 2 "On" ;
VAL_TABLE_ Sig3636 0 "FALSE" 1 "TRUE" ;
VAL_TABLE_ HiVltgBatStopChrgReq 0 "FALSE" 1 "TRUE" ;
VAL_TABLE_ Sig3585 0 "FALSE" 1 "TRUE" ;
VAL_TABLE_ Sig2638 0 "FALSE" 1 "TRUE" ;
VAL_TABLE_ DrvrSeltdTrlrPrsnt 0 "Trailer Present" 1 "No Trailer" ;
VAL_TABLE_ Sig0628 0 "FALSE" 1 "TRUE" ;
VAL_TABLE_ Sig7788 0 "No Request" 1 "Reset Request Active" ;
VAL_TABLE_ TripBEleclEngyEconRstReqd 0 "FALSE" 1 "TRUE" ;
VAL_TABLE_ TripAEleclEngyEconRstReqd 0 "FALSE" 1 "TRUE" ;
VAL_TABLE_ StlthModeActv 0 "FALSE" 1 "TRUE" ;
VAL_TABLE_ LnchCtlRelLineLckReqd 0 "FALSE" 1 "TRUE" ;
VAL_TABLE_ LifetmEleclEngyEconRstReqd 0 "FALSE" 1 "TRUE" ;
VAL_TABLE_ HzrdReqActv 0 "FALSE" 1 "TRUE" ;
VAL_TABLE_ OvrrdNextPlndCbnPrcndtngReq 0 "No Action" 1 "Off" 2 "On" ;
VAL_TABLE_ TrlrProfDrvrReqdSeltn 0 "No Action" 1 "Default Profile" 2 "Profile1" 3 "Profile2" 4 "Profile3" 5 "Profile4" 6 "Profile5" 7 "Profile6" 8 "Profile7" 9 "Profile8" 10 "Profile9" 11 "Profile10" 12 "Profile11" 13 "Profile12" 14 "Profile13" 15 "Profile14" 16 "Profile15" 17 "Profile16" 18 "Profile17" 19 "Profile18" 20 "Profile19" 21 "Profile20" ;
VAL_TABLE_ UIDInStatusSD 0 "Not Present" 1 "Present" ;
VAL_TABLE_ UTCDay_Inv 0 "FALSE" 1 "TRUE" ;
VAL_TABLE_ UTCHrs_Inv 0 "FALSE" 1 "TRUE" ;
VAL_TABLE_ UTCMth_Inv 0 "FALSE" 1 "TRUE" ;
VAL_TABLE_ UTCMth 0 "Unknown" 1 "January" 2 "February" 3 "March" 4 "April" 5 "May" 6 "June" 7 "July" 8 "August" 9 "September" 10 "October" 11 "November" 12 "December" ;
VAL_TABLE_ UTCMin_Inv 0 "FALSE" 1 "TRUE" ;
VAL_TABLE_ UTCSec_Inv 0 "FALSE" 1 "TRUE" ;
VAL_TABLE_ UTCYr_Inv 0 "FALSE" 1 "TRUE" ;
VAL_TABLE_ HtrCoreInltClntTmpCalc_Inv 0 "FALSE" 1 "TRUE" ;
VAL_TABLE_ ClmCtlCustSetChgd 0 "FALSE" 1 "TRUE" ;
VAL_TABLE_ ClmCtlCmfSetRchd 0 "FALSE" 1 "TRUE" ;
VAL_TABLE_ ClmCtlCustSeltn 0 "Off" 1 "Remote Start" 2 "Auto" 3 "Manual" ;
VAL_TABLE_ RVCOprtgMd 0 "Plant Assembly Mode" 1 "Remote Startup Mode" 2 "Ignition Startup Mode" 3 "Charge Recovery Mode" 4 "Normal Mode" 5 "Fuel Economy Mode" 6 "LI Safe Mode" 7 "LI Warming Mode" 8 "LI Cooling Mode" 9 "SOC Reconfirmation" 10 "RVC Inactive" ;
VAL_TABLE_ ExtEnvCondChgDtd 0 "FALSE" 1 "TRUE" ;
VAL_TABLE_ Sig4991 0 "FALSE" 1 "TRUE" ;
VAL_TABLE_ Sig4993 0 "FALSE" 1 "TRUE" ;
VAL_TABLE_ DrvModeConfDrvrResp 0 "No Indication" 1 "Baja ESC Confirm" 2 "Baja ESC Cancel" 3 "Terrain ESC Confirm" 4 "Terrain ESC Cancel" 5 "Response 5" 6 "Response 6" 7 "Response 7" 8 "Response 8" 9 "Response 9" 10 "Response 10" 11 "Response 11" 12 "Response 12" 13 "Response 13" 14 "Response 14" 15 "Response 15" ;
VAL_TABLE_ Sig6842 0 "FALSE" 1 "TRUE" ;
VAL_TABLE_ eLSDActrDelTrq_Inv 0 "FALSE" 1 "TRUE" ;
VAL_TABLE_ eLSDActrThrCapUsd_Inv 0 "FALSE" 1 "TRUE" ;
VAL_TABLE_ Sig8080 0 "FALSE" 1 "TRUE" ;
VAL_TABLE_ BrkSysRdGrdAccel_Inv 0 "FALSE" 1 "TRUE" ;
VAL_TABLE_ MaxPwrModeReqd 0 "FALSE" 1 "TRUE" ;
VAL_TABLE_ MaxPwrModeOvrrd 0 "FALSE" 1 "TRUE" ;
VAL_TABLE_ RrVirtBmpBrkgSts 0 "Not Active" 1 "Active" 2 "Failed" ;
VAL_TABLE_ BrkPulsSts 0 "Not Active" 1 "In Progress" 2 "Pulse Failed" 3 "Pulse Complete" ;
VAL_TABLE_ WhlSlpSt 0 "No Slip Detected" 1 "Negative Slip Detected" 2 "Positive Slip Detected" 3 "Slip Detection Fault" ;
VAL_TABLE_ BrkSysStatCrwlModeOvrrd 0 "No Override" 1 "Override to Not Crawl" 2 "Override to Crawl" ;
VAL_TABLE_ BrkSysHillRollCtrlStat 0 "Inactive" 1 "Control Target Vehicle Speed" 2 "Reserved_2" 3 "Reserved_3" ;
VAL_TABLE_ BrkSysHillStrtAsstStat 0 "Inactive" 1 "Brake Pressure Hold" 2 "Normal Pressure Decay" 3 "Drive-off Pressure Decay" 4 "Reserved_4" 5 "Reserved_5" 6 "Reserved_6" 7 "Reserved_7" ;
VAL_TABLE_ TrlrBrkDtd 0 "FALSE" 1 "TRUE" ;
VAL_TABLE_ EngDrgCtlFaild 0 "FALSE" 1 "TRUE" ;
VAL_TABLE_ EngDrgCtlActv 0 "FALSE" 1 "TRUE" ;
VAL_TABLE_ BrkSysHillRollCtrlAvl 0 "FALSE" 1 "TRUE" ;
VAL_TABLE_ RdWhlAng_Inv 0 "FALSE" 1 "TRUE" ;
VAL_TABLE_ VehPtchAng_Inv 0 "FALSE" 1 "TRUE" ;
VAL_TABLE_ VehRollAng_Inv 0 "FALSE" 1 "TRUE" ;
VAL_TABLE_ BSTGR_ReqdGr 0 "No Action" 1 "First Gear" 2 "Second Gear" 3 "Third Gear" 4 "Fourth Gear" 5 "Fifth Gear" 6 "Sixth Gear" 7 "Seventh Gear" 8 "Eighth Gear" 9 "Ninth Gear" 10 "Tenth Gear" ;
VAL_TABLE_ BSTGR_ReqTyp 0 "No Action" 1 "Max Gear Request" 2 "Min Gear Request" 3 "Hold Gear" ;
VAL_TABLE_ RrCrsTrfcBrkgSysSts 0 "Not Active" 1 "Active" 2 "Failed" ;
VAL_TABLE_ BSCERDTC_SysDes 0 "P0-Powertrain Codes SAE Controlled" 1 "P1-Powertrain Codes MFG Controlled" 2 "P2-Powertrain Codes Reserved" 3 "P3-Powertrain Codes Reserved" 4 "C0-Chassis Codes SAE Controlled" 5 "C1-Chassis Codes MFG Controlled" 6 "C2-Chassis Codes Reserved" 7 "C3-Chassis Codes Reserved" 8 "B0-Body Codes SAE Controlled" 9 "B1-Body Codes MFG Controlled" 10 "B2-Body Codes Reserved" 11 "B3-Body Codes Reserved" 12 "U0-Network Codes SAE Controlled" 13 "U1-Network Codes MFG Controlled" 14 "U2- Network Codes Reserved" 15 "U3-Network Codes Reserved" ;
VAL_TABLE_ EngMntPrfMdRq 0 "No Action" 1 "Eco Mode" 2 "Sport Mode" 3 "Ice Mode" 4 "Performance Mode 4" 5 "Performance Mode 5" 6 "Performance Mode 6" 7 "Performance Mode 7" ;
VAL_TABLE_ ACCPrfMdRq 0 "No Action" 1 "NORMAL" 2 "SPORTY" 3 "COMFORTABLE" 4 "ECO" 5 "Performance Mode 5" 6 "Performance Mode 6" 7 "Performance Mode 7" ;
VAL_TABLE_ TireRRLoTracIndOn 0 "FALSE" 1 "TRUE" ;
VAL_TABLE_ TireRFLoTracIndOn 0 "FALSE" 1 "TRUE" ;
VAL_TABLE_ TireLRLoTracIndOn 0 "FALSE" 1 "TRUE" ;
VAL_TABLE_ TireLFLoTracIndOn 0 "FALSE" 1 "TRUE" ;
VAL_TABLE_ RrStrPrfMdRq 0 "No Action" 1 "Normal" 2 "Sport" 3 "Comfort" 4 "Track" 5 "Tow/Haul" 6 "Offroad" 7 "Terrain" ;
VAL_TABLE_ ExhSndPrfMdRq 0 "No Action" 1 "Tour" 2 "Sport" 3 "Track" 4 "Stealth" 5 "Performance Mode 5" 6 "Performance Mode 6" 7 "Performance Mode 7" ;
VAL_TABLE_ WthrSnwModeBrkPedVisDispVal 0 "Setting_Unknown" 1 "Custom_Mode_1" 2 "Custom_Mode_2" 3 "Custom_Mode_3" 4 "Custom_Mode_4" 5 "Custom_Mode_5" 6 "Custom_Mode_6" 7 "Custom_Mode_7" ;
VAL_TABLE_ WthrSnwModeActvAeroVisDispVal 0 "Setting_Unknown" 1 "Custom_Mode_1" 2 "Custom_Mode_2" 3 "Custom_Mode_3" 4 "Custom_Mode_4" 5 "Custom_Mode_5" 6 "Custom_Mode_6" 7 "Custom_Mode_7" ;
VAL_TABLE_ StrPrfMdRq 0 "No Action" 1 "Normal" 2 "Sport" 3 "Comfort" 4 "Track" 5 "Tow/Haul" 6 "Offroad" 7 "Terrain" ;
VAL_TABLE_ WthrSnwModePwrtrnVisDispVal 0 "Setting_Unknown" 1 "Custom_Mode_1" 2 "Custom_Mode_2" 3 "Custom_Mode_3" 4 "Custom_Mode_4" 5 "Custom_Mode_5" 6 "Custom_Mode_6" 7 "Custom_Mode_7" ;
VAL_TABLE_ WthrSnwModeESCVisDispVal 0 "Setting_Unknown" 1 "Custom_Mode_1" 2 "Custom_Mode_2" 3 "Custom_Mode_3" 4 "Custom_Mode_4" 5 "Custom_Mode_5" 6 "Custom_Mode_6" 7 "Custom_Mode_7" ;
VAL_TABLE_ WthrSnwModeDrvlineVisDispVal 0 "Setting_Unknown" 1 "Custom_Mode_1" 2 "Custom_Mode_2" 3 "Custom_Mode_3" 4 "Custom_Mode_4" 5 "Custom_Mode_5" 6 "Custom_Mode_6" 7 "Custom_Mode_7" ;
VAL_TABLE_ WthrSnwModeSndVisDispVal 0 "Setting_Unknown" 1 "Custom_Mode_1" 2 "Custom_Mode_2" 3 "Custom_Mode_3" 4 "Custom_Mode_4" 5 "Custom_Mode_5" 6 "Custom_Mode_6" 7 "Custom_Mode_7" ;
VAL_TABLE_ WthrSnwModeRideHghtVisDispVal 0 "Setting_Unknown" 1 "Custom_Mode_1" 2 "Custom_Mode_2" 3 "Custom_Mode_3" 4 "Custom_Mode_4" 5 "Custom_Mode_5" 6 "Custom_Mode_6" 7 "Custom_Mode_7" ;
VAL_TABLE_ DrvModeConfIndReq 0 "No Indication" 1 "Baja ESC Reduced" 2 "Terrain ESC Off" 3 "Max Power" 4 "Confirmation 4" 5 "Confirmation 5" 6 "Confirmation 6" 7 "Confirmation 7" ;
VAL_TABLE_ ESCPrs 0 "FALSE" 1 "TRUE" ;
VAL_TABLE_ BrkSysCtlEmsnsRltdMalfActv 0 "FALSE" 1 "TRUE" ;
VAL_TABLE_ WthrSnwModeSpnsnVisDispVal 0 "Setting_Unknown" 1 "Custom_Mode_1" 2 "Custom_Mode_2" 3 "Custom_Mode_3" 4 "Custom_Mode_4" 5 "Custom_Mode_5" 6 "Custom_Mode_6" 7 "Custom_Mode_7" ;
VAL_TABLE_ BrkFldLvlSt 0 "Normal" 1 "Low" 2 "Unknown" ;
VAL_TABLE_ PIMRI_EBCM_PrmntDTCInd 0 "FALSE" 1 "TRUE" ;
VAL_TABLE_ PIMRI_EBCM_FltsPrsntInd 0 "FALSE" 1 "TRUE" ;
VAL_TABLE_ MaxPwrModeDndIndOn 0 "FALSE" 1 "TRUE" ;
VAL_TABLE_ Sig4246 0 "Uninitialized" 1 "Healthy" 2 "Recoverable" 3 "Degraded" 4 "Failed" ;
VAL_TABLE_ Sig4244 0 "Normal" 1 "Medium" 2 "High" 3 "Overtemp" ;
VAL_TABLE_ Sig4248 0 "Uninitialized" 1 "Healthy" 2 "Recoverable" 3 "Degraded" 4 "Failed" ;
VAL_TABLE_ Sig4247 0 "Uninitialized" 1 "Healthy" 2 "Recoverable" 3 "Degraded" 4 "Failed" ;
VAL_TABLE_ Sig4249 0 "Uninitialized" 1 "Healthy" 2 "Recoverable" 3 "Degraded" 4 "Failed" ;
VAL_TABLE_ Sig0677 0 "FALSE" 1 "TRUE" ;
VAL_TABLE_ Sig0679 0 "FALSE" 1 "TRUE" ;
VAL_TABLE_ Sig0681 0 "FALSE" 1 "TRUE" ;
VAL_TABLE_ Sig0685 0 "FALSE" 1 "TRUE" ;
VAL_TABLE_ Sig0687 0 "FALSE" 1 "TRUE" ;
VAL_TABLE_ Sig2629 0 "FALSE" 1 "TRUE" ;
VAL_TABLE_ EngPrdctStdyStTrq_Inv 0 "FALSE" 1 "TRUE" ;
VAL_TABLE_ Sig0606 0 "Level 0" 1 "Level 1" 2 "Level 2" 3 "Level 3" 4 "Level 4" 5 "Level 5" 6 "Level 6" 7 "Level 7" ;
VAL_TABLE_ Sig2624 0 "Not Limited" 1 "Rate Limited" 2 "Value Limited Low" 3 "Value Limited High" 4 "Unused and Reserved 1" 5 "Unused and Reserved 2" 6 "Unused and Reserved 3" 7 "Unused and Reserved 4" ;
VAL_TABLE_ Sig0607 0 "Normal Stability" 1 "Torque High Pulsation" 2 "Torque Decrease Pending" 3 "Torque Increase Pending" 4 "Unused and Reserved 1" 5 "Unused and Reserved 2" 6 "Unused and Reserved 3" 7 "Unused and Reserved 4" ;
VAL_TABLE_ Sig2657 0 "No Request" 1 "Request Honored" 2 "Lost Arbitration" 3 "Serial Data Failure Temporary" 4 "Serial Data Failure Permanent" 5 "Control System Failure Temporary" 6 "Control System Failure Permanent" ;
VAL_TABLE_ Sig2656 0 "Not Limited" 1 "Rate Limited" 2 "Value Limited Low" 3 "Value Limited High" 4 "Unused and Reserved 1" 5 "Unused and Reserved 2" 6 "Unused and Reserved 3" 7 "Unused and Reserved 4" ;
VAL_TABLE_ Sig2625 0 "No Request" 1 "Request Honored" 2 "Lost Arbitration" 3 "Serial Data Failure Temporary" 4 "Serial Data Failure Permanent" 5 "Control System Failure Temporary" 6 "Control System Failure Permanent" ;
VAL_TABLE_ Sig7777 0 "FALSE" 1 "TRUE" ;
VAL_TABLE_ Sig7778 0 "FALSE" 1 "TRUE" ;
VAL_TABLE_ Sig2622 0 "FALSE" 1 "TRUE" ;
VAL_TABLE_ Sig2609 0 "FALSE" 1 "TRUE" ;
VAL_TABLE_ Sig0474 0 "FALSE" 1 "TRUE" ;
VAL_TABLE_ Sig0683 0 "FALSE" 1 "TRUE" ;
VAL_TABLE_ Sig2613 0 "FALSE" 1 "TRUE" ;
VAL_TABLE_ Sig2611 0 "All Cylinders Active" 1 "Deactivation In Progress" 2 "Half of Total Cylinders Active" 3 "Reactivation In Progress" ;
VAL_TABLE_ Sig2522 0 "None" 1 "First Gear" 2 "Second Gear" 3 "Third Gear" 4 "Fourth Gear" 5 "Fifth Gear" 6 "Sixth Gear" 7 "Seventh Gear" 8 "Eighth Gear" 9 "Ninth Gear" 10 "Tenth Gear" 11 "Unused" 12 "Unused" 13 "Unused" 14 "Unused" 15 "Unused" ;
VAL_TABLE_ Sig2521 0 "FALSE" 1 "TRUE" ;
VAL_TABLE_ Sig2520 0 "None" 1 "First Gear" 2 "Second Gear" 3 "Third Gear" 4 "Fourth Gear" 5 "Fifth Gear" 6 "Sixth Gear" 7 "Seventh Gear" 8 "Eighth Gear" 9 "Ninth Gear" 10 "Tenth Gear" 11 "Unused" 12 "Unused" 13 "Unused" 14 "Unused" 15 "Unused" ;
VAL_TABLE_ Sig2523 0 "Shift Down" 1 "Shift Up" 2 "No Shift" ;
VAL_TABLE_ EASSI_StrtStpSt 0 "Engine Off" 1 "Engine Running" 2 "Engine Starting" 3 "Engine Stopping" ;
VAL_TABLE_ EASSI_StlDtd 0 "FALSE" 1 "TRUE" ;
VAL_TABLE_ EASSI_FlRqOn 0 "FALSE" 1 "TRUE" ;
VAL_TABLE_ Sig2466 0 "FALSE" 1 "TRUE" ;
VAL_TABLE_ Sig2465 0 "FALSE" 1 "TRUE" ;
VAL_TABLE_ Sig2464 0 "FALSE" 1 "TRUE" ;
VAL_TABLE_ Sig2463 0 "No Start" 1 "Type A" 2 "Type B" 3 "Type C" 4 "Type D" 5 "Type E" 6 "Type F" 7 "Type G" ;
VAL_TABLE_ Sig2554 0 "No Action" 1 "Max Gear Request" 2 "Min Gear Request" 3 "Hold Gear" ;
VAL_TABLE_ Sig2562 0 "Full Torque Capacity" 1 "Reduced Capacity 1" ;
VAL_TABLE_ Sig2561 0 "Full Torque Capacity" 1 "Reduced Capacity 1" ;
VAL_TABLE_ Sig2555 0 "No Action" 1 "First Gear" 2 "Second Gear" 3 "Third Gear" 4 "Fourth Gear" 5 "Fifth Gear" 6 "Sixth Gear" 7 "Seventh Gear" 8 "Eighth Gear" 9 "Ninth Gear" 10 "Tenth Gear" ;
VAL_TABLE_ Sig7805 0 "Motor Disabled Mode" 1 "Conventional Generation Mode" 2 "Hybrid Optimization Mode" ;
VAL_TABLE_ Sig2608 0 "Inactive" 1 "Engaged" 2 "Resume" 3 "Accel" 4 "Coast" 5 "Tap" ;
VAL_TABLE_ EngAtStpNtPrbl 0 "FALSE" 1 "TRUE" ;
VAL_TABLE_ Sig0470 0 "FALSE" 1 "TRUE" ;
VAL_TABLE_ Sig2589 0 "Inactive" 1 "Active Not Absorbing Torque" 2 "Active Absorbing Torque" ;
VAL_TABLE_ Sig2571 0 "No Action" 1 "Off" 2 "On" ;
VAL_TABLE_ CltTpTrvAchv 0 "FALSE" 1 "TRUE" ;
VAL_TABLE_ CltTpTrvAchv_Inv 0 "FALSE" 1 "TRUE" ;
VAL_TABLE_ Sig8060 0 "Inactive" 1 "Active" ;
VAL_TABLE_ Sig7665 0 "FALSE" 1 "TRUE" ;
VAL_TABLE_ Sig5015 0 "FALSE" 1 "TRUE" ;
VAL_TABLE_ GlwPlgCrnkDlyActv 0 "FALSE" 1 "TRUE" ;
VAL_TABLE_ Sig2662 0 "FALSE" 1 "TRUE" ;
VAL_TABLE_ Sig2632 0 "FALSE" 1 "TRUE" ;
VAL_TABLE_ Sig2616 0 "FALSE" 1 "TRUE" ;
VAL_TABLE_ Sig2603 0 "Inactive" 1 "Active" ;
VAL_TABLE_ Sig2559 0 "No Indication" 1 "Complete" 2 "Phase 1" 3 "Phase 2" 4 "Phase 3" 5 "Skip Phase 2" ;
VAL_TABLE_ Sig0665 0 "FALSE" 1 "TRUE" ;
VAL_TABLE_ Sig4473 0 "FALSE" 1 "TRUE" ;
VAL_TABLE_ Sig4472 0 "FALSE" 1 "TRUE" ;
VAL_TABLE_ Sig4471 0 "Relay Off" 1 "Relay On" ;
VAL_TABLE_ Sig2591 0 "FALSE" 1 "TRUE" ;
VAL_TABLE_ Sig4475 0 "FALSE" 1 "TRUE" ;
VAL_TABLE_ Sig2615 0 "FALSE" 1 "TRUE" ;
VAL_TABLE_ Sig6780 0 "FALSE" 1 "TRUE" ;
VAL_TABLE_ PwrtrnAutoVehHldEnbld 0 "FALSE" 1 "TRUE" ;
VAL_TABLE_ PwrtrnAutoVehHldActv 0 "FALSE" 1 "TRUE" ;
VAL_TABLE_ Sig3620 0 "FALSE" 1 "TRUE" ;
VAL_TABLE_ Sig2592 0 "FALSE" 1 "TRUE" ;
VAL_TABLE_ Sig2614 0 "None" 1 "Shift Out of High Range" 2 "Shift Out of Low Range" 3 "Shift Out of Neutral Range" ;
VAL_TABLE_ Sig2548 0 "All cylinders" 1 "Half Cylinders" ;
VAL_TABLE_ BarPrsAbs_Inv 0 "FALSE" 1 "TRUE" ;
VAL_TABLE_ Sig2642 0 "FALSE" 1 "TRUE" ;
VAL_TABLE_ Sig2557 0 "No Indication" 1 "Complete" 2 "Phase 1" 3 "Phase 2" 4 "Phase 3" 5 "Skip Phase 2" ;
VAL_TABLE_ Sig2440 0 "North America" 1 "Europe" ;
VAL_TABLE_ Sig2444 0 "No Indication" 1 "Warning Level 1" 2 "Warning Level 2" 3 "Warning Level 3" 4 "Warning Level 4" 5 "Warning Level 5" 6 "Warning Level 6" 7 "Warning Level 7" ;
VAL_TABLE_ Sig2627 0 "FALSE" 1 "TRUE" ;
VAL_TABLE_ Sig5019 0 "FALSE" 1 "TRUE" ;
VAL_TABLE_ Sig5018 0 "FALSE" 1 "TRUE" ;
VAL_TABLE_ Sig2576 0 "FALSE" 1 "TRUE" ;
VAL_TABLE_ Sig2575 0 "FALSE" 1 "TRUE" ;
VAL_TABLE_ Sig2574 0 "FALSE" 1 "TRUE" ;
VAL_TABLE_ Sig2573 0 "FALSE" 1 "TRUE" ;
VAL_TABLE_ Sig2572 0 "FALSE" 1 "TRUE" ;
VAL_TABLE_ Sig0599 0 "None" 1 "Level1" 2 "Level2" 3 "Level3" ;
VAL_TABLE_ Sig2579 0 "FALSE" 1 "TRUE" ;
VAL_TABLE_ Sig2578 0 "FALSE" 1 "TRUE" ;
VAL_TABLE_ Sig2577 0 "FALSE" 1 "TRUE" ;
VAL_TABLE_ DrvrTkModeCmnd 0 "FALSE" 1 "TRUE" ;
VAL_TABLE_ DrvrSprtModeCmnd 0 "FALSE" 1 "TRUE" ;
VAL_TABLE_ DrvrMtnModeCmnd 0 "FALSE" 1 "TRUE" ;
VAL_TABLE_ DrvrHldModeCmnd 0 "FALSE" 1 "TRUE" ;
VAL_TABLE_ DrvrExhBrkModeCmnd 0 "FALSE" 1 "TRUE" ;
VAL_TABLE_ DrvrEconModeCmnd 0 "FALSE" 1 "TRUE" ;
VAL_TABLE_ DrvrCrwlModeCmnd 0 "FALSE" 1 "TRUE" ;
VAL_TABLE_ DrvrChrgPlusModeCmnd 0 "FALSE" 1 "TRUE" ;
VAL_TABLE_ GrdBrkgDsblModeCmnd 0 "FALSE" 1 "TRUE" ;
VAL_TABLE_ DrvrWntrModeCmnd 0 "FALSE" 1 "TRUE" ;
VAL_TABLE_ DrvrTowHaulModeCmnd 0 "FALSE" 1 "TRUE" ;
VAL_TABLE_ PrplSysPriAxlTrqReqStsChsSys 0 "No Request" 1 "Request Honored" 2 "Lost Arbitration" 3 "Serial Data Failure Temporary" 4 "Serial Data Failure Permanent" 5 "Control System Failure Temporary" 6 "Control System Failure Permanent" ;
VAL_TABLE_ FourCrnrLvlgTopSpdLimRespTyp 0 "Inactive" 1 "Faulted" 2 "Safety_woBrake" 3 "Safety_wBrake" 4 "OBD" 5 "nonOBD" 6 "Legislated" ;
VAL_TABLE_ AccKdwnDtctd 0 "FALSE" 1 "TRUE" ;
VAL_TABLE_ VhSpdCntlSystmTyp 0 "No Vehicle Speed Control" 1 "Conventional Cruise Control" 2 "Adaptive Cruise Control" ;
VAL_TABLE_ DrvrSeltdSpdLmtrIndReq 0 "No Action" 1 "Driver Selected Speed Limiter Telltale Off" 2 "Driver Selected Speed Limiter Unavailable Telltale On" 3 "Driver Selected Speed Limiter White Telltale On" 4 "Driver Selected Speed Limiter Green Telltale On" ;
VAL_TABLE_ EngNEmsnsRltMlfnAct 0 "FALSE" 1 "TRUE" ;
VAL_TABLE_ DrSlctdSpdLmtrEnbld 0 "FALSE" 1 "TRUE" ;
VAL_TABLE_ DrSlctdSpdLmtrActv 0 "FALSE" 1 "TRUE" ;
VAL_TABLE_ VhGrdSnsrBsd_Inv 0 "FALSE" 1 "TRUE" ;
VAL_TABLE_ TrnsOvrllEstTrqRt_Inv 0 "FALSE" 1 "TRUE" ;
VAL_TABLE_ TrnsOilTmp_Inv 0 "FALSE" 1 "TRUE" ;
VAL_TABLE_ TrnsOlTmpSnsPrs 0 "FALSE" 1 "TRUE" ;
VAL_TABLE_ Sig7786 0 "FALSE" 1 "TRUE" ;
VAL_TABLE_ Sig7800 0 "Normal" 1 "Countermeasures Active" 2 "Driver Intervention Requested" ;
VAL_TABLE_ RegVltgCtlPwrtrnOvrrdInhbd 0 "FALSE" 1 "TRUE" ;
VAL_TABLE_ GenStptDtCycPtOvrAct 0 "FALSE" 1 "TRUE" ;
VAL_TABLE_ ElecShfLckdBcklPsngrStBltIndOn 0 "FALSE" 1 "TRUE" ;
VAL_TABLE_ ElecShfLckdBcklDrvrStBltIndOn 0 "FALSE" 1 "TRUE" ;
VAL_TABLE_ DCCnvStblznErrIndOn 0 "FALSE" 1 "TRUE" ;
VAL_TABLE_ RegVltgCtlEngyRcvryActv 0 "FALSE" 1 "TRUE" ;
VAL_TABLE_ NoKeyDtdElecShfDndIndOn 0 "FALSE" 1 "TRUE" ;
VAL_TABLE_ ElecShfUnlckdBrkToShfIndOn 0 "FALSE" 1 "TRUE" ;
VAL_TABLE_ ElecShfPriTransCtlrMalfIndOn 0 "FALSE" 1 "TRUE" ;
VAL_TABLE_ ElecShfPriShfToDrvTryAgnIndOn 0 "FALSE" 1 "TRUE" ;
VAL_TABLE_ ElecShfPriRdcSpdForReqdShfIndOn 0 "FALSE" 1 "TRUE" ;
VAL_TABLE_ AirCndOffIO 0 "FALSE" 1 "TRUE" ;
VAL_TABLE_ EngCmptHotWrnIndReq 0 "Off" 1 "Service" 2 "Hot Idle" 3 "Hot" ;
VAL_TABLE_ ElecShftPrTwoGrsSelIndRq 0 "OFF" 1 "PARK" 2 "NEUTRAL" 3 "DRIVE" ;
VAL_TABLE_ ElecShftPrLtdPrfMdIO 0 "FALSE" 1 "TRUE" ;
VAL_TABLE_ ElecShftPrHldShftLevEngRngIO 0 "FALSE" 1 "TRUE" ;
VAL_TABLE_ ElecShftPrDrPrkIntShftAtmpIO 0 "FALSE" 1 "TRUE" ;
VAL_TABLE_ ElecShftPrDrIntShftAtmpIO 0 "FALSE" 1 "TRUE" ;
VAL_TABLE_ ElecShftPrDrExitIO 0 "FALSE" 1 "TRUE" ;
VAL_TABLE_ ElecShftPrDrDoorStIndIO 0 "FALSE" 1 "TRUE" ;
VAL_TABLE_ ElecShftPrAtPrkIO 0 "FALSE" 1 "TRUE" ;
VAL_TABLE_ ElecShfPriTrnVehOffForPrkIndOn 0 "FALSE" 1 "TRUE" ;
VAL_TABLE_ ElecShftrLckdHldBrkToOvrrdIndOn 0 "FALSE" 1 "TRUE" ;
VAL_TABLE_ ElecShftPrTrnMlfIO 0 "FALSE" 1 "TRUE" ;
VAL_TABLE_ ElecShftPrRngInvRqIO 0 "FALSE" 1 "TRUE" ;
VAL_TABLE_ ElecShftPrPrkInvRqIO 0 "FALSE" 1 "TRUE" ;
VAL_TABLE_ ECERDTC_ECP_E_SysDes 0 "P0_Powertrain Codes SAE Controlled" 1 "P1_Powertrain Codes MFG Controlled" 2 "P2_Powertrain Codes Reserved" 3 "P3_Powertrain Codes Reserved" 4 "C0_Chassis Codes SAE Controlled" 5 "C1_Chassis Codes MFG Controlled" 6 "C2_Chassis Codes Reserved" 7 "C3_Chassis Codes Reserved" 8 "B0_Body Codes SAE Controlled" 9 "B1_Body Codes MFG Controlled" 10 "B2_Body Codes Reserved" 11 "B3_Body Codes Reserved" 12 "U0_Network Codes SAE Controlled" 13 "U1_Network Codes MFG Controlled" 14 "U2_Network Codes Reserved" 15 "U3_Network Codes Reserved" ;
VAL_TABLE_ ElecAllWhlDrvESCTTFlshgActv 0 "FALSE" 1 "TRUE" ;
VAL_TABLE_ ElecCtlPrcsrEmsRltMlfAtv_ECP_E 0 "FALSE" 1 "TRUE" ;
VAL_TABLE_ DrvMtrInvrtMaxTemp_Inv 0 "FALSE" 1 "TRUE" ;
VAL_TABLE_ HybChrgModeStat 0 "Charge Depleting" 1 "Charge Sustaining" ;
VAL_TABLE_ HiVltgActvDischrgCmnd 0 "FALSE" 1 "TRUE" ;
VAL_TABLE_ ElecDischrgActr2DischrgSts 0 "Inactive" 1 "Operational" 2 "Unavilable" ;
VAL_TABLE_ Sig3621 0 "FALSE" 1 "TRUE" ;
VAL_TABLE_ ElecMtrATrqAchvd_Inv 0 "FALSE" 1 "TRUE" ;
VAL_TABLE_ ElecMtrASttrTemp_Inv 0 "FALSE" 1 "TRUE" ;
VAL_TABLE_ ElecDischrgActr4DischrgSts 0 "Inactive" 1 "Operational" 2 "Unavailable" ;
VAL_TABLE_ PIMRI_ECP_S2_PrmntDTCInd 0 "FALSE" 1 "TRUE" ;
VAL_TABLE_ PIMRI_ECP_S2_FltsPrsntInd 0 "FALSE" 1 "TRUE" ;
VAL_TABLE_ DMCM3EmsRltMlfAtv 0 "FALSE" 1 "TRUE" ;
VAL_TABLE_ DMCM3ERDTC_SysDes 0 "P0-Powertrain Codes SAE Controlled" 1 "P1-Powertrain Codes MFG Controlled" 2 "P2-Powertrain Codes Reserved" 3 "P3-Powertrain Codes Reserved" 4 "C0-Chassis Codes SAE Controlled" 5 "C1-Chassis Codes MFG Controlled" 6 "C2-Chassis Codes Reserved" 7 "C3-Chassis Codes Reserved" 8 "B0-Body Codes SAE Controlled" 9 "B1-Body Codes MFG Controlled" 10 "B2-Body Codes Reserved" 11 "B3-Body Codes Reserved" 12 "U0-Network Codes SAE Controlled" 13 "U1-Network Codes MFG Controlled" 14 "U2- Network Codes Reserved" 15 "U3-Network Codes Reserved" ;
VAL_TABLE_ Sig0503 0 "FALSE" 1 "TRUE" ;
VAL_TABLE_ Sig0505 0 "FALSE" 1 "TRUE" ;
VAL_TABLE_ Sig0508 0 "FALSE" 1 "TRUE" ;
VAL_TABLE_ Sig0510 0 "FALSE" 1 "TRUE" ;
VAL_TABLE_ Sig0506 0 "Power Stage Inactive" 1 "Power Stage Active" ;
VAL_TABLE_ Sig0501 0 "Disable Normal Power Stage" 1 "Torque Control" 2 "Shutdown Initiated" 3 "Disable Immediate" 4 "Normal Charge with Internal Setpoint" 5 "Normal Charge with External Setpoint" ;
VAL_TABLE_ Sig0512 0 "FALSE" 1 "TRUE" ;
VAL_TABLE_ Sig2505 0 "P0_Powertrain Codes SAE Controlled" 1 "P1_Powertrain Codes MFG Controlled" 2 "P2_Powertrain Codes Reserved" 3 "P3_Powertrain Codes Reserved" 4 "C0_Chassis Codes SAE Controlled" 5 "C1_Chassis Codes MFG Controlled" 6 "C2_Chassis Codes Reserved" 7 "C3_Chassis Codes Reserved" 8 "B0_Body Codes SAE Controlled" 9 "B1_Body Codes MFG Controlled" 10 "B2_Body Codes Reserved" 11 "B3_Body Codes Reserved" 12 "U0_Network Codes SAE Controlled" 13 "U1_Network Codes MFG Controlled" 14 "U2_Network Codes Reserved" 15 "U3_Network Codes Reserved" ;
VAL_TABLE_ Sig2566 0 "FALSE" 1 "TRUE" ;
VAL_TABLE_ Sig4456 0 "FALSE" 1 "TRUE" ;
VAL_TABLE_ Sig4455 0 "FALSE" 1 "TRUE" ;
VAL_TABLE_ ElecDischrgActr3DischrgSts 0 "Inactive" 1 "Operational" 2 "Unavailable" ;
VAL_TABLE_ ECPSERDTC_SysDes 0 "P0-Powertrain Codes SAE Controlled" 1 "P1-Powertrain Codes MFG Controlled" 2 "P2-Powertrain Codes Reserved" 3 "P3-Powertrain Codes Reserved" 4 "C0-Chassis Codes SAE Controlled" 5 "C1-Chassis Codes MFG Controlled" 6 "C2-Chassis Codes Reserved" 7 "C3-Chassis Codes Reserved" 8 "B0-Body Codes SAE Controlled" 9 "B1-Body Codes MFG Controlled" 10 "B2-Body Codes Reserved" 11 "B3-Body Codes Reserved" 12 "U0-Network Codes SAE Controlled" 13 "U1-Network Codes MFG Controlled" 14 "U2- Network Codes Reserved" 15 "U3-Network Codes Reserved" ;
VAL_TABLE_ DrvMtrInvrt2MaxTemp_Inv 0 "FALSE" 1 "TRUE" ;
VAL_TABLE_ ECPSEmsRltMlfAtv 0 "FALSE" 1 "TRUE" ;
VAL_TABLE_ PIMRI_ECP_S_PrmntDTCInd 0 "FALSE" 1 "TRUE" ;
VAL_TABLE_ PIMRI_ECP_S_FltsPrsntInd 0 "FALSE" 1 "TRUE" ;
VAL_TABLE_ DMCM2EmsRltMlfAtv 0 "FALSE" 1 "TRUE" ;
VAL_TABLE_ DMCM2ERDTC_SysDes 0 "P0-Powertrain Codes SAE Controlled" 1 "P1-Powertrain Codes MFG Controlled" 2 "P2-Powertrain Codes Reserved" 3 "P3-Powertrain Codes Reserved" 4 "C0-Chassis Codes SAE Controlled" 5 "C1-Chassis Codes MFG Controlled" 6 "C2-Chassis Codes Reserved" 7 "C3-Chassis Codes Reserved" 8 "B0-Body Codes SAE Controlled" 9 "B1-Body Codes MFG Controlled" 10 "B2-Body Codes Reserved" 11 "B3-Body Codes Reserved" 12 "U0-Network Codes SAE Controlled" 13 "U1-Network Codes MFG Controlled" 14 "U2- Network Codes Reserved" 15 "U3-Network Codes Reserved" ;
VAL_TABLE_ ElecMtrARotrTemp_Inv 0 "FALSE" 1 "TRUE" ;
VAL_TABLE_ Sig2564 0 "No Indication" 1 "Limited" 2 "Faulted" ;
VAL_TABLE_ Sig2563 0 "Normal" 1 "Temporarily Unavailable" 2 "Unavailable" ;
VAL_TABLE_ HtdStrgWhlDrvOutStsGtd 0 "Off-Normal Operation" 1 "On-Normal Operation-Temp Status Indeterminate" 2 "On-Normal Operation-Temp Status Increasing" 3 "On-Normal Operation-Temp Reached" 4 "On-Degraded Operation-Temp not Reached" 5 "On-Faulted Operation-Power Limited" 6 "Off-Faulted Operation-Output Control Fault not Present" 7 "Off-Faulted Operation-Output Control Fault Present" ;
VAL_TABLE_ HtdStrgWhlDrvOutStsGtd_Inv 0 "FALSE" 1 "TRUE" ;
VAL_TABLE_ LnCntrWrnIndRqst 0 "No Indication" 1 "Can not See Lanes" 2 "Tight Curve" 3 "Freeway Ends" 4 "Construction" 5 "Excessive Speed" 6 "Vehicles Too Close" 7 "Canceled Take Steering" 8 "Can not See Eyes" 9 "Due to Weather" 10 "Take Steering" 11 "Take Vehicle Control" 12 "Service Driver Assist System" 13 "Lane Following Locked Out" 14 "TJA Max Speed Reached" 15 "TJA Available" 16 "TJA Active" ;
VAL_TABLE_ LnFllwgHzrdLgtsReq 0 "No Request" 1 "Active Override Allowed" 2 "Active Override Not Allowed" ;
VAL_TABLE_ LnCntrEsclnSts 0 "None" 1 "Driver Not Looking to Roadway" 2 "Limited Condition" 3 "System Faulted" ;
VAL_TABLE_ HtdStrgWhlStkSwGtd 0 "FALSE" 1 "TRUE" ;
VAL_TABLE_ HtdStrgWhlStkSwGtd_Inv 0 "FALSE" 1 "TRUE" ;
VAL_TABLE_ HtdStrgWhlExtrnFltPrsntGtd 0 "FALSE" 1 "TRUE" ;
VAL_TABLE_ HtdStrgWhlExtrnFltPrsntGtd_Inv 0 "FALSE" 1 "TRUE" ;
VAL_TABLE_ CIBAutoBrkRelIndOn 0 "FALSE" 1 "TRUE" ;
VAL_TABLE_ RIMIntCllnChmEvStat 0 "NO_ACTION" 1 "ACTIVE" 2 "CANCEL_CHIM" ;
VAL_TABLE_ RIMBrkPlsChEvStat 0 "NO_ACTION" 1 "ACTIVE" 2 "CANCEL_CHIM" ;
VAL_TABLE_ ManHtdStrgWhlReqdGtd 0 "FALSE" 1 "TRUE" ;
VAL_TABLE_ ManHtdStrgWhlReqdGtd_Inv 0 "FALSE" 1 "TRUE" ;
VAL_TABLE_ RIM_BrkPrfllReq 0 "FALSE" 1 "TRUE" ;
VAL_TABLE_ RIMUnIndOn 0 "FALSE" 1 "TRUE" ;
VAL_TABLE_ RIMONIndOn 0 "FALSE" 1 "TRUE" ;
VAL_TABLE_ RIMOFFIndOn 0 "FALSE" 1 "TRUE" ;
VAL_TABLE_ LnCntrMisuseCond 0 "FALSE" 1 "TRUE" ;
VAL_TABLE_ LnCntrDrvAwrIndOn 0 "FALSE" 1 "TRUE" ;
VAL_TABLE_ HtdStrgWhlSwActvGtd 0 "FALSE" 1 "TRUE" ;
VAL_TABLE_ FIM_CIS_BrkPrfllReq 0 "FALSE" 1 "TRUE" ;
VAL_TABLE_ SuprRmtPrkSptSeltnRmtReq 0 "Hidden" 1 "Disabled" 2 "Enabled" 3 "Highlighted" ;
VAL_TABLE_ SuprRmtPrkSptSeltnKeepLkReq 0 "Hidden" 1 "Disabled" 2 "Enabled" 3 "Highlighted" ;
VAL_TABLE_ SuprRmtPrkSptSeltnAcceptReq 0 "Hidden" 1 "Disabled" 2 "Enabled" 3 "Highlighted" ;
VAL_TABLE_ TnDrvRIMOFFUnvIndOn 0 "FALSE" 1 "TRUE" ;
VAL_TABLE_ RrVirtBmpAutoBrkRelIndOn 0 "FALSE" 1 "TRUE" ;
VAL_TABLE_ RIM_BrkPulsReq 0 "FALSE" 1 "TRUE" ;
VAL_TABLE_ SuprRmtPrkUnabletoCnctTryAgnReq 0 "Hidden" 1 "Disabled" 2 "Enabled" 3 "Highlighted" ;
VAL_TABLE_ SuprRmtPrkUnabletoCnctExtReq 0 "Hidden" 1 "Disabled" 2 "Enabled" 3 "Highlighted" ;
VAL_TABLE_ LnChgDmndMomtryLnChgDsbl 0 "FALSE" 1 "TRUE" ;
VAL_TABLE_ LnChgDmndLnChgReq 0 "No_Activation" 1 "Left" 2 "Right" ;
VAL_TABLE_ LnCntrArrwBlck1Act 0 "FALSE" 1 "TRUE" ;
VAL_TABLE_ LnCntrSpchPrmtReq 0 "No Prompt" 1 "Take Steering" 2 "Take Vehicle Control" ;
VAL_TABLE_ LnCntrCnvMsgIndRqst 0 "No Indication" 1 "Behind Slow Vehicle" 2 "Being Passed on Left" 3 "Being Passed on Right" 4 "Tailgater Detected" 5 "Left Blind Spot Occupied" 6 "Right Blind Spot Occupied" 7 "Heavy Traffic" 8 "Merging Vehicle" 9 "Slow Moving Traffic in Left Lane" 10 "Slow Moving Traffic Ahead" 11 "Slow Moving Traffic in Right Lane" 12 "Major Road Interchange Ahead" 13 "Road Exit Detected Ahead" 14 "Exit Only Lane Ahead" 15 "Lane Ending Ahead" 16 "Road Detour Detected" 17 "Take Time to Look at Road" 18 "Show Fuel Level" 19 "Show Fuel Range Normal" 20 "Show Fuel Range Low" 21 "Take Steering Active With Muting" ;
VAL_TABLE_ RIMObjAtchdIndOn 0 "FALSE" 1 "TRUE" ;
VAL_TABLE_ RIMElecPrkBrkRelIndOn 0 "FALSE" 1 "TRUE" ;
VAL_TABLE_ LnCntrArrwBlck5Act 0 "FALSE" 1 "TRUE" ;
VAL_TABLE_ LnCntrArrwBlck4Act 0 "FALSE" 1 "TRUE" ;
VAL_TABLE_ LnCntrArrwBlck3Act 0 "FALSE" 1 "TRUE" ;
VAL_TABLE_ LnCntrArrwBlck2Act 0 "FALSE" 1 "TRUE" ;
VAL_TABLE_ FCAR_FCAImntCruzCtlCnclReqd 0 "FALSE" 1 "TRUE" ;
VAL_TABLE_ LKALnMrkgIndLt 0 "Off" 1 "White" 2 "Green" 3 "Amber" 4 "Amber Flashing" ;
VAL_TABLE_ GoNotfrCstCrStVal 0 "SETTING_UNKNOWN" 1 "OFF" 2 "ON" 3 "RESERVED_3" 4 "RESERVED_4" 5 "RESERVED_5" 6 "RESERVED_6" 7 "RESERVED_7" ;
VAL_TABLE_ FrwdVhImAlrtIndRqst 0 "OFF" 1 "ON" 2 "0.5_Hz" 3 "1_Hz" 4 "2_Hz" 5 "4_Hz" 6 "RESERVED_1" 7 "RESERVED_2" ;
VAL_TABLE_ LnDtWrnCntrlVsAlrtCmdGnc 0 "OFF" 1 "NOT READY TO ASSIST" 2 "READY TO ASSIST" 3 "ALERT" 4 "INTERVENTION" ;
VAL_TABLE_ LnDtWrnCntrlFtrSt 0 "OFF" 1 "STANDBY" 2 "READY TO ASSIST" 3 "FAILED" 4 "ALERT AND CONTROL" ;
VAL_TABLE_ LKALnMrkgIndRt 0 "Off" 1 "White" 2 "Green" 3 "Amber" 4 "Amber Flashing" ;
VAL_TABLE_ LDWCtrlHndOff1ChmEvntStat 0 "NO_ACTION" 1 "ACTIVE" 2 "CANCEL_CHIME" ;
VAL_TABLE_ FrwdCllsnAlrtImAlrtDrIntAlrtChmE 0 "NO_ACTION" 1 "ACTIVE" 2 "CANCEL_CHIME" ;
VAL_TABLE_ FrntPCMChmEvntStat 0 "NO_ACTION" 1 "ACTIVE" 2 "CANCEL_CHIME" ;
VAL_TABLE_ LDWCtrlRtHndSdChmEvntStat 0 "NO_ACTION" 1 "ACTIVE" 2 "CANCEL_CHIME" ;
VAL_TABLE_ LDWCtrlLtHndSdChmEvntStat 0 "NO_ACTION" 1 "ACTIVE" 2 "CANCEL_CHIME" ;
VAL_TABLE_ LDWCtrlHndOff3ChmEvntStat 0 "NO_ACTION" 1 "ACTIVE" 2 "CANCEL_CHIME" ;
VAL_TABLE_ LDWCtrlHndOff2ChmEvntStat 0 "NO_ACTION" 1 "ACTIVE" 2 "CANCEL_CHIME" ;
VAL_TABLE_ LDWCtrlAudAttnReqd 0 "FALSE" 1 "TRUE" ;
VAL_TABLE_ GoNotfrCstStAvl 0 "FALSE" 1 "TRUE" ;
VAL_TABLE_ FrwdVhHdwyAlrtIndOn 0 "FALSE" 1 "TRUE" ;
VAL_TABLE_ FCA_BrkPrfllReq 0 "FALSE" 1 "TRUE" ;
VAL_TABLE_ AdptCrsCntrlEngd 0 "FALSE" 1 "TRUE" ;
VAL_TABLE_ ACCTrlrGapSetIndOn 0 "FALSE" 1 "TRUE" ;
VAL_TABLE_ FllwgTmDsplyMd 0 "NO DISPLAY" 1 "DEFAULT" 2 "NORMAL" 3 "LESS THAN MINIMUM" 4 "GREATER THAN MAXIMUM" ;
VAL_TABLE_ FrwdHdwyVisIndCtl 0 "FCA" 1 "ACC" 2 "None" ;
VAL_TABLE_ FCA_ACCGapSetIndOn 0 "FALSE" 1 "TRUE" ;
VAL_TABLE_ FCAACCGapSeltn 0 "Far" 1 "Medium" 2 "Near" 3 "Off" 4 "Unknown" ;
VAL_TABLE_ LAOA_LatAsstHoLFOptAval 0 "FALSE" 1 "TRUE" ;
VAL_TABLE_ AdpAndCnvntlCruzCtlIndReq 0 "No Action" 1 "Cruise Control and Adaptive Cruise Control Telltale Off" 2 "Cruise Control Unavailable Telltale On" 3 "Cruise Control White Telltale On" 4 "Cruise Control Green Telltale On" 5 "Cruise Control Blue Telltale On" 6 "Adaptive Cruise Control Unavailable Telltale On" 7 "Adaptive Cruise Control White Telltale On" 8 "Adaptive Cruise Control Green Telltale On" 9 "Adaptive Cruise Control Blue Telltale On" ;
VAL_TABLE_ LtAstStsIndRq 0 "No Indication" 1 "Off" 2 "LDW" 3 "LKA" 4 "HoLF" ;
VAL_TABLE_ FCAGpSet 0 "FAR" 1 "MEDIUM" 2 "NEAR" 3 "OFF" 4 "UNKNOWN" 5 "FAULTED" ;
VAL_TABLE_ LAOA_LatAsstOffOptAval 0 "FALSE" 1 "TRUE" ;
VAL_TABLE_ LAOA_LatAsstLKAOptAval 0 "FALSE" 1 "TRUE" ;
VAL_TABLE_ LAOA_LatAsstLDWOptAval 0 "FALSE" 1 "TRUE" ;
VAL_TABLE_ PdWrnIndRqst 0 "OFF" 1 "PEDESTRIAN ADVISORY" 2 "PEDESTRIAN ALERT" 3 "RESERVED" ;
VAL_TABLE_ LnDprtrWrnCtlSdThrtRtMirIndReq 0 "Off" 1 "Solid" 2 "Flashing" 3 "No Action" ;
VAL_TABLE_ LnDprtrWrnCtlSdThrtLtMirIndReq 0 "Off" 1 "Solid" 2 "Flashing" 3 "No Action" ;
VAL_TABLE_ ACCHdwySttng 0 "FAR" 1 "MEDIUM" 2 "NEAR" ;
VAL_TABLE_ FrtPedtrnBrkgWrnIndOn 0 "FALSE" 1 "TRUE" ;
VAL_TABLE_ ACCTmpUnvIndOn 0 "FALSE" 1 "TRUE" ;
VAL_TABLE_ ACCSysSlctdMdDspIndOn 0 "FALSE" 1 "TRUE" ;
VAL_TABLE_ ACCShftToPrkBfrExIndOn 0 "FALSE" 1 "TRUE" ;
VAL_TABLE_ ACCRtSpdAdVsIndOn 0 "FALSE" 1 "TRUE" ;
VAL_TABLE_ ACCHdwySttngIndOn 0 "FALSE" 1 "TRUE" ;
VAL_TABLE_ ACCDsngIndOn 0 "FALSE" 1 "TRUE" ;
VAL_TABLE_ SrvDvrAsstSystVslMsgRqstOn 0 "FALSE" 1 "TRUE" ;
VAL_TABLE_ LnKpAsstUnAvIndOn 0 "FALSE" 1 "TRUE" ;
VAL_TABLE_ LnDprtrWrngUnAvIndOn 0 "FALSE" 1 "TRUE" ;
VAL_TABLE_ FrwdClsnSysIndOn 0 "FALSE" 1 "TRUE" ;
VAL_TABLE_ FrwdCllsnSysUnIndOn 0 "FALSE" 1 "TRUE" ;
VAL_TABLE_ FrwdCllsnSysRdIndOn 0 "FALSE" 1 "TRUE" ;
VAL_TABLE_ FrwdCllsnSysOffIndOn 0 "FALSE" 1 "TRUE" ;
VAL_TABLE_ FrwdCllsnAlrtOffIndOn 0 "FALSE" 1 "TRUE" ;
VAL_TABLE_ TnDrvGapAdjUnvIndOn 0 "FALSE" 1 "TRUE" ;
VAL_TABLE_ TeenDrvrLnDprtrWrnOffUnvIndOn 0 "FALSE" 1 "TRUE" ;
VAL_TABLE_ SrvFrwdCllsnSysIndOn 0 "FALSE" 1 "TRUE" ;
VAL_TABLE_ HstVehTrlrDtd 0 "Unknown" 1 "Trailer Not Detected" 2 "Trailer Detected" 3 "Unsupported Trailer Detected" ;
VAL_TABLE_ Sig6920 0 "FALSE" 1 "TRUE" ;
VAL_TABLE_ Sig6921 0 "FALSE" 1 "TRUE" ;
VAL_TABLE_ Sig6924 0 "FALSE" 1 "TRUE" ;
VAL_TABLE_ Sig6923 0 "FALSE" 1 "TRUE" ;
VAL_TABLE_ Sig6928 0 "FALSE" 1 "TRUE" ;
VAL_TABLE_ Sig6927 0 "FALSE" 1 "TRUE" ;
VAL_TABLE_ Sig6931 0 "FALSE" 1 "TRUE" ;
VAL_TABLE_ Sig6930 0 "FALSE" 1 "TRUE" ;
VAL_TABLE_ Sig6934 0 "FALSE" 1 "TRUE" ;
VAL_TABLE_ Sig6933 0 "FALSE" 1 "TRUE" ;
VAL_TABLE_ LSCMB_BrkPrfllReq 0 "FALSE" 1 "TRUE" ;
VAL_TABLE_ Sig4119 0 "FALSE" 1 "TRUE" ;
VAL_TABLE_ FOPPriGridVltgOvrrdPrty 0 "None" 1 "Low" 2 "Medium" 3 "High" ;
VAL_TABLE_ Sig3234 0 "Not Commanded" 1 "Commanded Open" 2 "Commanded Closed" ;
VAL_TABLE_ FOPGridIsltnSwStat 0 "Indeterminate" 1 "Closed" 2 "Open" 3 "Reserved" ;
VAL_TABLE_ Sig3237 0 "FALSE" 1 "TRUE" ;
VAL_TABLE_ Sig3236 0 "FALSE" 1 "TRUE" ;
VAL_TABLE_ EE46ecGridVltgOvrrdActv 0 "FALSE" 1 "TRUE" ;
VAL_TABLE_ LIB1PackIntrnlVltg_Inv 0 "FALSE" 1 "TRUE" ;
VAL_TABLE_ LIB1CellMaxVltg_Inv 0 "FALSE" 1 "TRUE" ;
VAL_TABLE_ LIB1CellMaxVltg_DuD 0 "FALSE" 1 "TRUE" ;
VAL_TABLE_ LIB1CellMinVltg_Inv 0 "FALSE" 1 "TRUE" ;
VAL_TABLE_ LIB1SOH_Inv 0 "FALSE" 1 "TRUE" ;
VAL_TABLE_ Sig4000 0 "FALSE" 1 "TRUE" ;
VAL_TABLE_ Sig4002 0 "FALSE" 1 "TRUE" ;
VAL_TABLE_ Sig4006 0 "FALSE" 1 "TRUE" ;
VAL_TABLE_ Sig4004 0 "FALSE" 1 "TRUE" ;
VAL_TABLE_ LIB1CntctrSlfTstRslts 0 "All results passed" 1 "Contactor stuck open" 2 "Contactor stuck closed" ;
VAL_TABLE_ LIB1CntctrSlfTstRslts_Inv 0 "FALSE" 1 "TRUE" ;
VAL_TABLE_ LIB1EOLFlt 0 "No Fault Detected" 1 "End of Life" 2 "Reserved1" 3 "Reserved2" ;
VAL_TABLE_ LIB1EOLFlt_Inv 0 "FALSE" 1 "TRUE" ;
VAL_TABLE_ LIB1TempFlt_Inv 0 "FALSE" 1 "TRUE" ;
VAL_TABLE_ LIB1TempFlt_DuD 0 "FALSE" 1 "TRUE" ;
VAL_TABLE_ LIB1TempFlt 0 "No Fault" 1 "Low Severity" 2 "Medium Severity" 3 "High Severity" ;
VAL_TABLE_ LIB1CurrFlt 0 "FALSE" 1 "TRUE" ;
VAL_TABLE_ LIB1CurrFlt_Inv 0 "FALSE" 1 "TRUE" ;
VAL_TABLE_ Sig3997 0 "FALSE" 1 "TRUE" ;
VAL_TABLE_ Sig3998 0 "FALSE" 1 "TRUE" ;
VAL_TABLE_ LIB1SOCReconfRdnes_Inv 0 "FALSE" 1 "TRUE" ;
VAL_TABLE_ LIB1SOCReconfRdnes_DuD 0 "FALSE" 1 "TRUE" ;
VAL_TABLE_ LIB1SOCReconfRdnes 0 "None" 1 "Pre-Alert" 2 "Override Status" 3 "Priority Status" ;
VAL_TABLE_ Sig4422 0 "No Action" 1 "Min" 2 "Default-2" 3 "Default-1" 4 "Default" 5 "Default+1" 6 "Default+2" 7 "Max" ;
VAL_TABLE_ Sig4420 0 "No Action" 1 "Min" 2 "Default-2" 3 "Default-1" 4 "Default" 5 "Default+1" 6 "Default+2" 7 "Max" ;
VAL_TABLE_ NghtVsnSysStat 0 "UNKNOWN" 1 "INITIALIZING" 2 "INACTIVE" 3 "ACTIVE" 4 "NEEDS SERVICE" 5 "NOT DARK" 6 "TEMPORARILY UNAVAILABLE" 7 "NEEDS HEADLIGHTS" ;
VAL_TABLE_ Sig4418 0 "FALSE" 1 "TRUE" ;
VAL_TABLE_ Sig4419 0 "Normal" 1 "Limited" 2 "Unavailable" 3 "Invalid" ;
VAL_TABLE_ NtVsnAnmlWrnIndReq 0 "Unknown" 1 "Off" 2 "Advisory" 3 "Alert" ;
VAL_TABLE_ NghtVsnPdWrnIndRqst 0 "Unknown" 1 "Off" 2 "Pedestrian Advisory" 3 "Pedestrian Alert" ;
VAL_TABLE_ Sig3405 0 "No Action" 1 "No Indication" 2 "For 4WD Low Shift Transmission To Neutral" 3 "To Exit 4WD Low Shift Transmission to Neutral" 4 "For 4WD Low Reduce Speed" 5 "To Exit 4WD Low Reduce Speed" 6 "Reminder Vehicle Still In 4WD Low" 7 "4WD Shift in Progress" 8 "4WD Shift Not Allowed Engine Warming Up" 9 "4WD Shift Not Allowed Mismatched Tire" 10 "4WD Shift Not Allowed In Park" 11 "Apply Brake For 4WD Shift" 12 "No 4WD Shifts Allowed" 13 "Reduce Speed For 4WD Shift" 14 "Turn off Engine for 4WD Shift" 15 "For 4WD Shift Transmission Neutral" ;
VAL_TABLE_ SecAxlThrmCapPrtRqAct 0 "FALSE" 1 "TRUE" ;
VAL_TABLE_ Sig7793 0 "FALSE" 1 "TRUE" ;
VAL_TABLE_ Sig7795 0 "FALSE" 1 "TRUE" ;
VAL_TABLE_ Sig7773 0 "FALSE" 1 "TRUE" ;
VAL_TABLE_ Sig7792 0 "FALSE" 1 "TRUE" ;
VAL_TABLE_ AtTrnsGrSftDrct 0 "No Shift in Progress" 1 "Upshift in Progress" 2 "Downshift in Progress" ;
VAL_TABLE_ Sig0589 0 "FALSE" 1 "TRUE" ;
VAL_TABLE_ Sig0588 0 "FALSE" 1 "TRUE" ;
VAL_TABLE_ Sig0587 0 "FALSE" 1 "TRUE" ;
VAL_TABLE_ Sig0586 0 "FALSE" 1 "TRUE" ;
VAL_TABLE_ Sig0585 0 "FALSE" 1 "TRUE" ;
VAL_TABLE_ Sig0584 0 "FALSE" 1 "TRUE" ;
VAL_TABLE_ Sig0583 0 "FALSE" 1 "TRUE" ;
VAL_TABLE_ Sig0582 0 "FALSE" 1 "TRUE" ;
VAL_TABLE_ Sig0597 0 "FALSE" 1 "TRUE" ;
VAL_TABLE_ Sig0596 0 "FALSE" 1 "TRUE" ;
VAL_TABLE_ Sig0595 0 "FALSE" 1 "TRUE" ;
VAL_TABLE_ Sig0594 0 "FALSE" 1 "TRUE" ;
VAL_TABLE_ Sig0593 0 "FALSE" 1 "TRUE" ;
VAL_TABLE_ Sig0592 0 "FALSE" 1 "TRUE" ;
VAL_TABLE_ Sig0591 0 "FALSE" 1 "TRUE" ;
VAL_TABLE_ Sig0590 0 "FALSE" 1 "TRUE" ;
VAL_TABLE_ Sig7621 0 "FALSE" 1 "TRUE" ;
VAL_TABLE_ Sig7801 0 "Unlocked" 1 "Transitioning" 2 "Controlled Slip" 3 "Locked" 4 "Not Supported" ;
VAL_TABLE_ Sig7802 0 "FALSE" 1 "TRUE" ;
VAL_TABLE_ Sig7628 0 "FALSE" 1 "TRUE" ;
VAL_TABLE_ Sig7775 0 "FALSE" 1 "TRUE" ;
VAL_TABLE_ Sig7784 0 "FALSE" 1 "TRUE" ;
VAL_TABLE_ TrnsTUTDMdSt 0 "No Activation" 1 "Driver Shift Control Active" 2 "Electronic Range Select Active" ;
VAL_TABLE_ Sig2416 0 "Unknown" 1 "First Gear" 2 "Second Gear" 3 "Third Gear" 4 "Fourth Gear" 5 "Fifth Gear" 6 "Sixth Gear" 7 "Seventh Gear" 8 "Eighth Gear" 9 "Ninth Gear" 10 "Tenth Gear" ;
VAL_TABLE_ DrvShftCntrlReqDndIO 0 "FALSE" 1 "TRUE" ;
VAL_TABLE_ Sig7796 0 "No Range Inhibit Active" 1 "Transmission Inhibit Active" 2 "Transmission Range Re-Selection Req" 3 "Driveline Not Engaged" 4 "Diagnostic Inhibit Active" ;
VAL_TABLE_ Sig2421 0 "Normal Stability" 1 "Level 1" 2 "Level 2" 3 "Level 3" ;
VAL_TABLE_ Sig7783 0 "Disengaged" 1 "Engaging" 2 "Engaged" 3 "Disengaging" 4 "Controlled Slip" 5 "Reserved" 6 "Reserved" 7 "Not Supported" ;
VAL_TABLE_ Sig7643 0 "No Override" 1 "Override To Not Economy" 2 "Override To Economy" 3 "No Action" ;
VAL_TABLE_ Sig7642 0 "No Override" 1 "Override to Not Crawl" 2 "Override to Crawl" ;
VAL_TABLE_ Sig7630 0 "Not Ready" 1 "Ready to Increase Fraction" 2 "Ready to Reduce Fraction" 3 "Force Maximum Fraction" ;
VAL_TABLE_ Sig3595 0 "No Activation" 1 "Increment Switch Active" 2 "Decrement Switch Active" 3 "Increment and Decrement Switches Active" ;
VAL_TABLE_ Sig7647 0 "No Override" 1 "Override To Not Track" 2 "Override To Track" 3 "No Action" ;
VAL_TABLE_ Sig7646 0 "No Override" 1 "Override To Not Sport" 2 "Override To Sport" 3 "No Action" ;
VAL_TABLE_ Sig7645 0 "No Override" 1 "To Not Grade Braking Disable" 2 "To Grade Braking Disable" 3 "No Action" ;
VAL_TABLE_ Sig7644 0 "No Override" 1 "Override To Not Exhaust Brake" 2 "Override To Exhaust Brake" 3 "No Action" ;
VAL_TABLE_ Sig7782 0 "No Override" 1 "Engine On" 2 "Engine Off" ;
VAL_TABLE_ Sig7774 0 "Not Ready" 1 "Ready for All Cylinders" 2 "Ready for Half of TotalCylinders" ;
VAL_TABLE_ Sig7649 0 "No Override" 1 "Override To Not Winter" 2 "Override To Winter" 3 "No Action" ;
VAL_TABLE_ Sig7648 0 "No Override" 1 "Override To Not Tow Haul" 2 "Override To Tow Haul" 3 "No Action" ;
VAL_TABLE_ Sig0436 0 "FALSE" 1 "TRUE" ;
VAL_TABLE_ Sig7797 0 "FALSE" 1 "TRUE" ;
VAL_TABLE_ Sig7781 0 "FALSE" 1 "TRUE" ;
VAL_TABLE_ Sig7779 0 "FALSE" 1 "TRUE" ;
VAL_TABLE_ Sig7641 0 "FALSE" 1 "TRUE" ;
VAL_TABLE_ Sig7640 0 "FALSE" 1 "TRUE" ;
VAL_TABLE_ Sig2588 0 "FALSE" 1 "TRUE" ;
VAL_TABLE_ DCTLnchCtlAllwd 0 "FALSE" 1 "TRUE" ;
VAL_TABLE_ Sig7520 0 "No Action" 1 "No Indication" 2 "Warm" 3 "Increase Speed or Apply Brake" 4 "Ready for Drive Away" 5 "Please Wait" 6 "Apply and Hold Brake" 7 "Cool Down" 8 "Creep Disabled" ;
VAL_TABLE_ Sig7529 0 "P0-Powertrain Codes SAE Controlled" 1 "P1-Powertrain Codes MFG Controlled" 2 "P2-Powertrain Codes Reserved" 3 "P3-Powertrain Codes Reserved" 4 "C0-Chassis Codes SAE Controlled" 5 "C1-Chassis Codes MFG Controlled" 6 "C2-Chassis Codes Reserved" 7 "C3-Chassis Codes Reserved" 8 "B0-Body Codes SAE Controlled" 9 "B1-Body Codes MFG Controlled" 10 "B2-Body Codes Reserved" 11 "B3-Body Codes Reserved" 12 "U0-Network Codes SAE Controlled" 13 "U1-Network Codes MFG Controlled" 14 "U2-Network Codes Reserved" 15 "U3-Network Codes Reserved" ;
VAL_TABLE_ Sig7639 0 "No Request" 1 "Default Gear Active" 2 "Hot Modes Active" 3 "Binary Pump Failed" 4 "Engine Speed Limit Active" ;
VAL_TABLE_ Sig3509 0 "FALSE" 1 "TRUE" ;
VAL_TABLE_ Sig7798 0 "No Override Mode" 1 "Performance Mode" 2 "Lift-Foot Cornering Mode" 3 "Automatic Grade Braking Mode" ;
VAL_TABLE_ Sig7650 0 "Unknown" 1 "Low Efficiency" 2 "High Efficiency" 3 "Operation Degraded" 4 "Reliability Degraded" 5 "Reserved" 6 "Reserved" ;
VAL_TABLE_ Sig7790 0 "FALSE" 1 "TRUE" ;
VAL_TABLE_ Sig7787 0 "FALSE" 1 "TRUE" ;
VAL_TABLE_ Sig7776 0 "FALSE" 1 "TRUE" ;
VAL_TABLE_ Sig4462 0 "FALSE" 1 "TRUE" ;
VAL_TABLE_ Sig4461 0 "FALSE" 1 "TRUE" ;
VAL_TABLE_ APMLoVltgEnblCmd 0 "Off" 1 "NormalOp" 2 "Precharge" 3 "Preflux" 4 "KeyCrank" 5 "JumpStartInProgress" 6 "JumpStartComplete" 7 "BatteryMaint1" 8 "BatteryMaint2" 9 "BatteryMaint3" 10 "BatteryMaint4" 11 "DevCntrlOn" 12 "DevCntrlOff" 13 "12VGenMode" ;
VAL_TABLE_ VICMERDTC_SysDes 0 "P0-Powertrain Codes SAE Controlled" 1 "P1-Powertrain Codes MFG Controlled" 2 "P2-Powertrain Codes Reserved" 3 "P3-Powertrain Codes Reserved" 4 "C0-Chassis Codes SAE Controlled" 5 "C1-Chassis Codes MFG Controlled" 6 "C2-Chassis Codes Reserved" 7 "C3-Chassis Codes Reserved" 8 "B0-Body Codes SAE Controlled" 9 "B1-Body Codes MFG Controlled" 10 "B2-Body Codes Reserved" 11 "B3-Body Codes Reserved" 12 "U0-Network Codes SAE Controlled" 13 "U1-Network Codes MFG Controlled" 14 "U2- Network Codes Reserved" 15 "U3-Network Codes Reserved" ;
VAL_TABLE_ VICMEmsRltMlfAtv 0 "FALSE" 1 "TRUE" ;
VAL_TABLE_ PIMRI_VICM_PrmntDTCInd 0 "FALSE" 1 "TRUE" ;
VAL_TABLE_ PIMRI_VICM_FltsPrsntInd 0 "FALSE" 1 "TRUE" ;
VAL_TABLE_ SuprCruzSbscrptnActv 0 "FALSE" 1 "TRUE" ;
VAL_TABLE_ AutoVehMdCmdMdReqd 0 "Normal" 1 "Powertrain Sport" 2 "Chassis Sport" 3 "Eco" 4 "Mountain" 5 "Hold" 6 "Snow Ice" 7 "Start Stop" 8 "Tow Haul" 9 "Grade Braking Disable" 10 "Speed Matching" 11 "Track" 12 "Exhaust Brake" 13 "Normal AWD" 14 "Reserved 1" 15 "Reserved 2" 16 "Reserved 3" 17 "Reserved 4" 18 "Reserved 5" 19 "Reserved 6" 20 "Reserved 7" 21 "Reserved 8" 22 "Reserved 9" 23 "Reserved 10" 24 "Reserved 11" 25 "Reserved 12" 26 "Reserved 13" 27 "Reserved 14" 28 "Reserved 15" 29 "Reserved 16" 30 "No Mode Change Requested" 31 "Critically Disabled" ;
VAL_TABLE_ BrkSysAirDflctrCoolReq 0 "No Action" 1 "Max Cooling" 2 "Reserved 1" 3 "Reserved 2" ;
VAL_TABLE_ ActvAerodynsPerfModeReq 0 "No Action" 1 "Normal" 2 "Sport" 3 "Track" 4 "Show" 5 "Top Speed" 6 "Performance Mode 6" 7 "Performance Mode 7" ;
VAL_TABLE_ TrcCntrlSysPr 0 "FALSE" 1 "TRUE" ;
VAL_TABLE_ CustmStbCtlRdctReqIndOn 0 "FALSE" 1 "TRUE" ;
VAL_TABLE_ ABSPr 0 "FALSE" 1 "TRUE" ;
VAL_TABLE_ VehMassEstSts 0 "Undetermined" 1 "Degraded" 2 "Normal" ;
VAL_TABLE_ EngOilTmp_Inv 0 "FALSE" 1 "TRUE" ;
VAL_TABLE_ Sig7579 0 "FALSE" 1 "TRUE" ;
VAL_TABLE_ Sig3481 0 "No Indication" 1 "Range" 2 "Low Fuel and Range" ;
VAL_TABLE_ Sig2442 0 "No Indication" 1 "Warning Level 1" 2 "Warning Level 2" 3 "Warning Level 3" 4 "Warning Level 4" 5 "Warning Level 5" 6 "Warning Level 6" 7 "Warning Level 7" 8 "Warning Level 8" 9 "Warning Level 9" 10 "Warning Level 10" 11 "Warning Level 11" 12 "Warning Level 12" 13 "Warning Level 13" 14 "Warning Level 14" 15 "Warning Level 15" ;
VAL_TABLE_ Sig2441 0 "No Indication" 1 "Warning Level 1" 2 "Warning Level 2" 3 "Warning Level 3" 4 "Warning Level 4" 5 "Warning Level 5" 6 "Warning Level 6" 7 "Warning Level 7" 8 "Warning Level 8" 9 "Warning Level 9" 10 "Warning Level 10" 11 "Warning Level 11" 12 "Warning Level 12" 13 "Warning Level 13" 14 "Warning Level 14" 15 "Warning Level 15" ;
VAL_TABLE_ Sig2447 0 "No Indication" 1 "Warning Level 1" 2 "Warning Level 2" 3 "Warning Level 3" 4 "Warning Level 4" 5 "Warning Level 5" 6 "Warning Level 6" 7 "Warning Level 7" 8 "Warning Level 8" 9 "Warning Level 9" 10 "Warning Level 10" 11 "Warning Level 11" 12 "Warning Level 12" 13 "Warning Level 13" 14 "Warning Level 14" 15 "Warning Level 15" ;
VAL_TABLE_ Sig2443 0 "No Indication" 1 "Warning Level 1" 2 "Warning Level 2" 3 "Warning Level 3" 4 "Warning Level 4" 5 "Warning Level 5" 6 "Warning Level 6" 7 "Warning Level 7" 8 "Warning Level 8" 9 "Warning Level 9" 10 "Warning Level 10" 11 "Warning Level 11" 12 "Warning Level 12" 13 "Warning Level 13" 14 "Warning Level 14" 15 "Warning Level 15" ;
VAL_TABLE_ Sig2451 0 "FALSE" 1 "TRUE" ;
VAL_TABLE_ Sig2452 0 "No Indication" 1 "Warning Level 1" 2 "Warning Level 2" 3 "Warning Level 3" 4 "Warning Level 4" 5 "Warning Level 5" 6 "Warning Level 6" 7 "Warning Level 7" 8 "Warning Level 8" 9 "Warning Level 9" 10 "Warning Level 10" 11 "Warning Level 11" 12 "Warning Level 12" 13 "Warning Level 13" 14 "Warning Level 14" 15 "Warning Level 15" ;
VAL_TABLE_ Sig0309 0 "FALSE" 1 "TRUE" ;
VAL_TABLE_ Sig0308 0 "FALSE" 1 "TRUE" ;
VAL_TABLE_ Sig0307 0 "FALSE" 1 "TRUE" ;
VAL_TABLE_ Sig0306 0 "FALSE" 1 "TRUE" ;
VAL_TABLE_ Sig0305 0 "FALSE" 1 "TRUE" ;
VAL_TABLE_ Sig0626 0 "FALSE" 1 "TRUE" ;
VAL_TABLE_ Sig0614 0 "FALSE" 1 "TRUE" ;
VAL_TABLE_ Sig0434 0 "FALSE" 1 "TRUE" ;
VAL_TABLE_ Sig0312 0 "FALSE" 1 "TRUE" ;
VAL_TABLE_ Sig0311 0 "FALSE" 1 "TRUE" ;
VAL_TABLE_ Sig0310 0 "FALSE" 1 "TRUE" ;
VAL_TABLE_ Sig4815 0 "Setting Unknown" 1 "RPM 1100" 2 "RPM 1200" 3 "RPM 1300" 4 "RPM 1400" 5 "RPM 1500" 6 "RPM 1600" 7 "RPM 1700" 8 "RPM 1800" 9 "RPM 1900" 10 "RPM 2000" 11 "RPM 2100" 12 "RPM 2200" 13 "RPM 2300" 14 "RPM 2400" 15 "RPM 2500" ;
VAL_TABLE_ Sig4610 0 "Setting Unknown" 1 "Min 10" 2 "Min 30" 3 "Min 90" 4 "Min 120" 5 "Min 150" 6 "Min 180" 7 "Min 210" 8 "Min 240" 9 "Min 270" 10 "Min 300" 11 "Min 330" 12 "Min 360" 13 "Min 390" 14 "Min 420" 15 "Min 450" ;
VAL_TABLE_ Sig4250 0 "No Indication" 1 "Indication 1" 2 "Indication 2" 3 "Indication 3" ;
VAL_TABLE_ Sig2586 0 "OK" 1 "Replace Air Filter Soon" 2 "Replace Air Filter Now" 3 "Fault Present" 4 "Disabled" 5 "No Action" ;
VAL_TABLE_ Sig4838 0 "Setting Unknown" 1 "RPM 1700" 2 "RPM 1800" 3 "RPM 1900" 4 "RPM 2000" 5 "RPM 2100" 6 "RPM 2200" 7 "RPM 2300" 8 "RPM 2400" 9 "RPM 2500" 10 "RPM 2600" 11 "RPM 2700" 12 "RPM 2800" 13 "RPM 2900" 14 "RPM 3000" 15 "RPM 3100" ;
VAL_TABLE_ Sig4885 0 "Setting Unknown" 1 "RPM 5" 2 "RPM 10" 3 "RPM 25" 4 "RPM 50" 5 "RPM 100" 6 "RPM 250" 7 "RPM 500" ;
VAL_TABLE_ Sig4863 0 "Setting Unknown" 1 "RPM 900" 2 "RPM 1000" 3 "RPM 1100" 4 "RPM 1200" 5 "RPM 1300" 6 "RPM 1400" 7 "RPM 1500" ;
VAL_TABLE_ Sig2621 0 "FALSE" 1 "TRUE" ;
VAL_TABLE_ Sig2620 0 "FALSE" 1 "TRUE" ;
VAL_TABLE_ Sig4689 0 "Setting Unknown" 1 "Standard" 2 "Remote" ;
VAL_TABLE_ Sig4638 0 "No Indication" 1 "Continuous Indication" 2 "Slow Flashing Indication" 3 "Fast Flashing Indication" ;
VAL_TABLE_ Sig4627 0 "Setting Unknown" 1 "Preset" 2 "Variable" ;
VAL_TABLE_ Sig2671 0 "FALSE" 1 "TRUE" ;
VAL_TABLE_ Sig2668 0 "FALSE" 1 "TRUE" ;
VAL_TABLE_ Sig2667 0 "FALSE" 1 "TRUE" ;
VAL_TABLE_ Sig2644 0 "FALSE" 1 "TRUE" ;
VAL_TABLE_ Sig2641 0 "FALSE" 1 "TRUE" ;
VAL_TABLE_ Sig2639 0 "FALSE" 1 "TRUE" ;
VAL_TABLE_ Sig2637 0 "FALSE" 1 "TRUE" ;
VAL_TABLE_ Sig2636 0 "FALSE" 1 "TRUE" ;
VAL_TABLE_ Sig4675 0 "FALSE" 1 "TRUE" ;
VAL_TABLE_ Sig4636 0 "FALSE" 1 "TRUE" ;
VAL_TABLE_ Sig4629 0 "FALSE" 1 "TRUE" ;
VAL_TABLE_ Sig4612 0 "FALSE" 1 "TRUE" ;
VAL_TABLE_ Sig4539 0 "FALSE" 1 "TRUE" ;
VAL_TABLE_ Sig4496 0 "FALSE" 1 "TRUE" ;
VAL_TABLE_ Sig4481 0 "FALSE" 1 "TRUE" ;
VAL_TABLE_ Sig4479 0 "FALSE" 1 "TRUE" ;
VAL_TABLE_ Sig4840 0 "FALSE" 1 "TRUE" ;
VAL_TABLE_ Sig4817 0 "FALSE" 1 "TRUE" ;
VAL_TABLE_ Sig4798 0 "FALSE" 1 "TRUE" ;
VAL_TABLE_ Sig4730 0 "FALSE" 1 "TRUE" ;
VAL_TABLE_ Sig4728 0 "FALSE" 1 "TRUE" ;
VAL_TABLE_ Sig4726 0 "FALSE" 1 "TRUE" ;
VAL_TABLE_ Sig4712 0 "FALSE" 1 "TRUE" ;
VAL_TABLE_ Sig4691 0 "FALSE" 1 "TRUE" ;
VAL_TABLE_ Sig7799 0 "FALSE" 1 "TRUE" ;
VAL_TABLE_ Sig6769 0 "FALSE" 1 "TRUE" ;
VAL_TABLE_ Sig4906 0 "FALSE" 1 "TRUE" ;
VAL_TABLE_ Sig4893 0 "FALSE" 1 "TRUE" ;
VAL_TABLE_ Sig4887 0 "FALSE" 1 "TRUE" ;
VAL_TABLE_ Sig4865 0 "FALSE" 1 "TRUE" ;
VAL_TABLE_ Sig4846 0 "FALSE" 1 "TRUE" ;
VAL_TABLE_ TrcCntrlSysEnbld 0 "FALSE" 1 "TRUE" ;
VAL_TABLE_ EnhdDrvrSeltdMdSwChsUseReq 0 "FALSE" 1 "TRUE" ;
VAL_TABLE_ AutoVehMdCmdMdFtrEnbld 0 "FALSE" 1 "TRUE" ;
VAL_TABLE_ ThrPstn_Inv 0 "FALSE" 1 "TRUE" ;
VAL_TABLE_ EngIntAirTmp_Inv 0 "FALSE" 1 "TRUE" ;
VAL_TABLE_ EngIntAirTmp_DuD 0 "FALSE" 1 "TRUE" ;
VAL_TABLE_ HybStatElecVehModeOvrrd 0 "Undetermined" 1 "No Override" 2 "Too Cold" 3 "Battery Low" 4 "Speed too High" 5 "Generic Override" 6 "Grade too High" 7 "Accelerator Pedal Threshold Exceeded" ;
VAL_TABLE_ EngCntrlDtrmdTrfCRng 0 "High" 1 "Low" 2 "Unused and Reserved" 3 "Neutral" ;
VAL_TABLE_ EngCntrlDtrmdTrfCRng_Inv 0 "FALSE" 1 "TRUE" ;
VAL_TABLE_ PTHiElecLdReqd 0 "FALSE" 1 "TRUE" ;
VAL_TABLE_ ACCmCltEngd 0 "FALSE" 1 "TRUE" ;
VAL_TABLE_ HybStatShtlModeOvrrd 0 "Undetermined" 1 "No Override" 2 "Too Cold" 3 "Battery Low" 4 "Speed too High" 5 "Generic Override" 6 "Grade too High" 7 "Accelerator Pedal Threshold Exceeded" ;
VAL_TABLE_ ArbdEngTemp_Inv 0 "FALSE" 1 "TRUE" ;
VAL_TABLE_ EngInltSpcfcHmdty_Inv 0 "FALSE" 1 "TRUE" ;
VAL_TABLE_ EngInltSpcfcHmdty_DuD 0 "FALSE" 1 "TRUE" ;
VAL_TABLE_ SmrtCoolFan2FltActv 0 "FALSE" 1 "TRUE" ;
VAL_TABLE_ SmrtCoolFan1FltActv 0 "FALSE" 1 "TRUE" ;
VAL_TABLE_ EngCstFlCtOffAct 0 "FALSE" 1 "TRUE" ;
VAL_TABLE_ CSTATRS_ReqSts 0 "No Request" 1 "Request Honored" 2 "Lost Arbitration" 3 "Serial Data Failure Temporary" 4 "Serial Data Failure Permanent" 5 "Control System Failure Temporary" 6 "Control System Failure Permanent" ;
VAL_TABLE_ OTARC_RejCrdntnECP_X1 0 "FALSE" 1 "TRUE" ;
VAL_TABLE_ OTARC_RejCrdntnECP_S 0 "FALSE" 1 "TRUE" ;
VAL_TABLE_ OTARC_RejCrdntnECP_MC 0 "FALSE" 1 "TRUE" ;
VAL_TABLE_ OTARC_RejCrdntnECM 0 "FALSE" 1 "TRUE" ;
VAL_TABLE_ OTARC_RejCrdntnEBCM 0 "FALSE" 1 "TRUE" ;
VAL_TABLE_ OTARC_RejCrdntnBSM_MH 0 "FALSE" 1 "TRUE" ;
VAL_TABLE_ OTARC_RejCrdntnBSM 0 "FALSE" 1 "TRUE" ;
VAL_TABLE_ OTARC_RejCrdntnBCM 0 "FALSE" 1 "TRUE" ;
VAL_TABLE_ OTARC_RejCrdntnECU_19 0 "FALSE" 1 "TRUE" ;
VAL_TABLE_ OTARC_RejCrdntnECU_18 0 "FALSE" 1 "TRUE" ;
VAL_TABLE_ OTARC_RejCrdntnECU_17 0 "FALSE" 1 "TRUE" ;
VAL_TABLE_ OTARC_RejCrdntnECU_16 0 "FALSE" 1 "TRUE" ;
VAL_TABLE_ OTARC_RejCrdntnECU_15 0 "FALSE" 1 "TRUE" ;
VAL_TABLE_ OTARC_RejCrdntnSBM 0 "FALSE" 1 "TRUE" ;
VAL_TABLE_ OTARC_RejCrdntnCGM 0 "FALSE" 1 "TRUE" ;
VAL_TABLE_ OTARC_RejCrdntnECP_X2 0 "FALSE" 1 "TRUE" ;
VAL_TABLE_ OTARC_RejCrdntnECU_27 0 "FALSE" 1 "TRUE" ;
VAL_TABLE_ OTARC_RejCrdntnECU_26 0 "FALSE" 1 "TRUE" ;
VAL_TABLE_ OTARC_RejCrdntnECU_25 0 "FALSE" 1 "TRUE" ;
VAL_TABLE_ OTARC_RejCrdntnECU_24 0 "FALSE" 1 "TRUE" ;
VAL_TABLE_ OTARC_RejCrdntnECU_23 0 "FALSE" 1 "TRUE" ;
VAL_TABLE_ OTARC_RejCrdntnECU_22 0 "FALSE" 1 "TRUE" ;
VAL_TABLE_ OTARC_RejCrdntnECU_21 0 "FALSE" 1 "TRUE" ;
VAL_TABLE_ OTARC_RejCrdntnECU_20 0 "FALSE" 1 "TRUE" ;
VAL_TABLE_ OTARC_RejCrdntnTCM 0 "FALSE" 1 "TRUE" ;
VAL_TABLE_ OTARC_RejCrdntnICCM 0 "FALSE" 1 "TRUE" ;
VAL_TABLE_ OTARC_RejCrdntnFICM 0 "FALSE" 1 "TRUE" ;
VAL_TABLE_ OTARC_RejCrdntnECU_32 0 "FALSE" 1 "TRUE" ;
VAL_TABLE_ OTARC_RejCrdntnECU_31 0 "FALSE" 1 "TRUE" ;
VAL_TABLE_ OTARC_RejCrdntnECU_30 0 "FALSE" 1 "TRUE" ;
VAL_TABLE_ OTARC_RejCrdntnECU_29 0 "FALSE" 1 "TRUE" ;
VAL_TABLE_ OTARC_RejCrdntnECU_28 0 "FALSE" 1 "TRUE" ;
VAL_TABLE_ DTCClrInhbd 0 "FALSE" 1 "TRUE" ;
VAL_TABLE_ PwrtrnShfLvrLckReqd 0 "FALSE" 1 "TRUE" ;
VAL_TABLE_ DrvMode8Ovrrdn 0 "FALSE" 1 "TRUE" ;
VAL_TABLE_ DrvMode7Ovrrdn 0 "FALSE" 1 "TRUE" ;
VAL_TABLE_ DrvMode6Ovrrdn 0 "FALSE" 1 "TRUE" ;
VAL_TABLE_ DrvMode5Ovrrdn 0 "FALSE" 1 "TRUE" ;
VAL_TABLE_ DrvMode4Ovrrdn 0 "FALSE" 1 "TRUE" ;
VAL_TABLE_ DrvMode3Ovrrdn 0 "FALSE" 1 "TRUE" ;
VAL_TABLE_ DrvMode2Ovrrdn 0 "FALSE" 1 "TRUE" ;
VAL_TABLE_ DrvMode1Ovrrdn 0 "FALSE" 1 "TRUE" ;
VAL_TABLE_ GenFld 0 "FALSE" 1 "TRUE" ;
VAL_TABLE_ ACCompCmnd 0 "Off" 1 "On" ;
VAL_TABLE_ ACCompCmnd_Inv 0 "FALSE" 1 "TRUE" ;
VAL_TABLE_ LIB1CurrRwVal_Inv 0 "FALSE" 1 "TRUE" ;
VAL_TABLE_ LIB1CurrRwVal_DuD 0 "FALSE" 1 "TRUE" ;
VAL_TABLE_ LIB1CurrRwValMult_Inv 0 "FALSE" 1 "TRUE" ;
VAL_TABLE_ LIB1CurrRwValMult_DuD 0 "FALSE" 1 "TRUE" ;
VAL_TABLE_ LIB1CurrRwValMult 0 "Multiplier factor 1" 1 "Multiplier factor 8" 2 "Multiplier factor 64" 3 "Multiplier factor 256" ;
VAL_TABLE_ LIB1VltgUpprLim_Inv 0 "FALSE" 1 "TRUE" ;
VAL_TABLE_ LIB1VltgUpprLim_DuD 0 "FALSE" 1 "TRUE" ;
VAL_TABLE_ LIB1CntctrOpnPrwrn 0 "FALSE" 1 "TRUE" ;
VAL_TABLE_ LIB1CntctrOpnPrwrn_Inv 0 "FALSE" 1 "TRUE" ;
VAL_TABLE_ LIB1CntctrSts_Inv 0 "FALSE" 1 "TRUE" ;
VAL_TABLE_ LIB1CntctrSts_DuD 0 "FALSE" 1 "TRUE" ;
VAL_TABLE_ LIB1CntctrSts 0 "Closed" 1 "Open" ;
VAL_TABLE_ PrplDispBatPwr_Inv 0 "FALSE" 1 "TRUE" ;
VAL_TABLE_ PrplDispBatPwr_DuD 0 "FALSE" 1 "TRUE" ;
VAL_TABLE_ PrplDispEngPwr_Inv 0 "FALSE" 1 "TRUE" ;
VAL_TABLE_ PrplDispEngPwr_DuD 0 "FALSE" 1 "TRUE" ;
VAL_TABLE_ BatPrplDispTrqLvlPct_DuD 0 "FALSE" 1 "TRUE" ;
VAL_TABLE_ PrplDispBatTrq_Inv 0 "FALSE" 1 "TRUE" ;
VAL_TABLE_ PrplDispBatTrq_DuD 0 "FALSE" 1 "TRUE" ;
VAL_TABLE_ CustNonUsblSOC_Inv 0 "FALSE" 1 "TRUE" ;
VAL_TABLE_ CustNonUsblSOC_DuD 0 "FALSE" 1 "TRUE" ;
VAL_TABLE_ CustUsblSOC_Inv 0 "FALSE" 1 "TRUE" ;
VAL_TABLE_ CustUsblSOC_DuD 0 "FALSE" 1 "TRUE" ;
VAL_TABLE_ BatPrplDispPwrLvlPct_DuD 0 "FALSE" 1 "TRUE" ;
VAL_TABLE_ ElecMtrATach_Inv 0 "FALSE" 1 "TRUE" ;
VAL_TABLE_ ElecMtrATach_DuD 0 "FALSE" 1 "TRUE" ;
VAL_TABLE_ HiVltgBatAvgTemp_DuD 0 "FALSE" 1 "TRUE" ;
VAL_TABLE_ HiVltgBatAvgTemp_Inv 0 "FALSE" 1 "TRUE" ;
VAL_TABLE_ EngPrplDispPwrLvlPct_DuD 0 "FALSE" 1 "TRUE" ;
VAL_TABLE_ EngRnngDueToVehSpdIndOn 0 "FALSE" 1 "TRUE" ;
VAL_TABLE_ ElecAllWhlDrvIndOn 0 "FALSE" 1 "TRUE" ;
VAL_TABLE_ DischrgPwrLtdIndOn 0 "FALSE" 1 "TRUE" ;
VAL_TABLE_ DischrgPwrLtdDispPctVsbl 0 "FALSE" 1 "TRUE" ;
VAL_TABLE_ HiVltgBatLmtnDueToTempInd 0 "Normal" 1 "Cold" 2 "Hot" ;
VAL_TABLE_ HybModeDisp 0 "No Action" 1 "Battery Power" 2 "Engine Power" 3 "Hybrid Power" 4 "Charging with Engine Off" 5 "Charging with Engine On" 6 "Neutral Engine On" 7 "Neutral Engine Off" 8 "Engine Charging" 9 "Engine Power Rear with Battery Front" 10 "Engine Power Rear with Front Wheel Regen" 11 "Undetermined" 12 "Default and Accessory" 13 "Engine Idle" 14 "Reserved 1" 15 "Reserved 2" 16 "Reserved 3" ;
VAL_TABLE_ HTD1_FuelAvdd_DuD 0 "FALSE" 1 "TRUE" ;
VAL_TABLE_ InstnsFuelEconHybOvrrdReq 0 "No Action" 1 "Min Fuel Economy" 2 "Max Fuel Economy" 3 "Auto Stop" 4 "EV" ;
VAL_TABLE_ HybModeDispVehCfg 0 "No Action" 1 "Not in Motion" 2 "FWD" 3 "RWD" 4 "4WD" ;
VAL_TABLE_ HiVltgChrgrSysSts 0 "Default" 1 "Idle" 2 "Initializing" 3 "Active" 4 "Complete" 5 "Aborted" 6 "Utility Override Active" 7 "Utility Override Reduced Power" 8 "Pause Due to Update" 9 "Connection Unpowered" 10 "Unconnected" 11 "Offboard Energy Transfer Active" ;
VAL_TABLE_ HybShfToPrkIndOn 0 "FALSE" 1 "TRUE" ;
VAL_TABLE_ HiVltgSysDsbld 0 "FALSE" 1 "TRUE" ;
VAL_TABLE_ JmpStrtSts 0 "Inactive" 1 "In Progress" 2 "Complete" 3 "Power Mode" 4 "Disabled" ;
VAL_TABLE_ PrplDispTotPwr_DuD 0 "FALSE" 1 "TRUE" ;
VAL_TABLE_ PrplDispTotPwr_Inv 0 "FALSE" 1 "TRUE" ;
VAL_TABLE_ ServHybSysIndOn 0 "FALSE" 1 "TRUE" ;
VAL_TABLE_ RegenPwrLimdIndOn 0 "FALSE" 1 "TRUE" ;
VAL_TABLE_ RegenPwrLimdDispPctVsbl 0 "FALSE" 1 "TRUE" ;
VAL_TABLE_ PrplDispTotPwrUntDisp 0 "kilowatt" 1 "Horsepower" ;
VAL_TABLE_ LossOfPrplIndOn 0 "FALSE" 1 "TRUE" ;
VAL_TABLE_ ServHiVltgBatIndReq 0 "No Indication" 1 "Shut Down Soon" 2 "No Restart" ;
VAL_TABLE_ BrkPadLifeFrtDistWrnIndReq 0 "No Action" 1 "Low" 2 "Display Distance" ;
VAL_TABLE_ BrkPadLifeStsIndReq 0 "No Action" 1 "Not Present" 2 "Ok" 3 "Change Soon" 4 "Change Now" 5 "Disabled" 6 "Service" ;
VAL_TABLE_ BrkPadLifeRrDistWrnIndReq 0 "No Action" 1 "Low" 2 "Display Distance" ;
VAL_TABLE_ ESCSpdLtdIndReq 0 "No Indication" 1 "Countdown" 2 "Limited" ;
VAL_TABLE_ HillDscntCtlRdcVehSpdIndOn 0 "FALSE" 1 "TRUE" ;
VAL_TABLE_ HillDscntCtlDispActvIndOn 0 "FALSE" 1 "TRUE" ;
VAL_TABLE_ BrkPadLifeFrtCnfrmRplcmtIndOn 0 "FALSE" 1 "TRUE" ;
VAL_TABLE_ BrkOvrhtdIndOn 0 "FALSE" 1 "TRUE" ;
VAL_TABLE_ AllWhlDrvRcmndIndOn 0 "FALSE" 1 "TRUE" ;
VAL_TABLE_ CrwlModeDndRsnIndReq 0 "No Indication" 1 "Unavailable" 2 "Brakes Overtemp" 3 "Shift to 4 High" 4 "Reduce Speed" ;
VAL_TABLE_ BrksOvrht 0 "FALSE" 1 "TRUE" ;
VAL_TABLE_ BrkSysTwoFtdDrvDtdIndOn 0 "FALSE" 1 "TRUE" ;
VAL_TABLE_ BrkSysHillStrtAsstAvl 0 "FALSE" 1 "TRUE" ;
VAL_TABLE_ BrkPadWrnIO 0 "FALSE" 1 "TRUE" ;
VAL_TABLE_ BrkPadLifeRrCnfrmRplcmtIndOn 0 "FALSE" 1 "TRUE" ;
VAL_TABLE_ LnchCtlWhlSlSts 0 "No Action" 1 "Five Percent" 2 "Five And A Half Percent" 3 "Six Percent" 4 "Six And A Half Percent" 5 "Seven Percent" 6 "Seven And A Half Percent" 7 "Eight Percent" 8 "Eight And A Half Percent" 9 "Nine Percent" 10 "Nine And A Half Percent" 11 "Ten Percent" 12 "Ten And A Half Percent" 13 "Eleven Percent" 14 "Eleven And a Half Percent" 15 "Twelve Percent" 16 "Twelve And A Half Percent" 17 "Thirteen Percent" 18 "Thirteen And A Half Percent" 19 "Fourteen Percent" 20 "Fourteen And A Half Percent" 21 "Fifteen Percent" ;
VAL_TABLE_ LnchCtlEngRE46ts 0 "No Action" 1 "800" 2 "900" 3 "1000" 4 "1100" 5 "1200" 6 "1300" 7 "1400" 8 "1500" 9 "1600" 10 "1700" 11 "1800" 12 "1900" 13 "2000" 14 "2100" 15 "2200" 16 "2300" 17 "2400" 18 "2500" 19 "2600" 20 "2700" 21 "2800" 22 "2900" 23 "3000" 24 "3100" 25 "3200" 26 "3300" 27 "3400" 28 "3500" 29 "3600" 30 "3700" 31 "3800" 32 "3900" 33 "4000" 34 "FlexibleRPM 1" 35 "FlexibleRPM 2" 36 "FlexibleRPM 3" 37 "FlexibleRPM 4" 38 "FlexibleRPM 5" ;
VAL_TABLE_ DrvModeVisScreenSts 0 "No_Action" 1 "Custom" 2 "Personal" 3 "Sport" 4 "Snow_Ice" 5 "Weather" 6 "Tour" 7 "Track" 8 "Offroad" 9 "TowHaul" 10 "PerformanceSportPlus" 11 "Terrain" 12 "Baja" ;
VAL_TABLE_ EngSndPerfModeReq 0 "No Action" 1 "Tour" 2 "Sport_OffRoad" 3 "Track" 4 "Stealth" 5 "Max Power" 6 "Terrain" 7 "Performance Mode 7" ;
VAL_TABLE_ PerfTracMgmtMode 0 "Disabled" 1 "Wet" 2 "Dry" 3 "Sport 1" 4 "Sport 2/Race 1" 5 "Race" 6 "Inactive" ;
VAL_TABLE_ HillDscntCtlSysSts 0 "Unknown" 1 "Normal" 2 "Enabled" 3 "Active" 4 "Failed" ;
VAL_TABLE_ SprtModeDrvlineVisDispVal 0 "Setting_Unknown" 1 "Custom_Mode_1" 2 "Custom_Mode_2" 3 "Custom_Mode_3" 4 "Custom_Mode_4" 5 "Custom_Mode_5" 6 "Custom_Mode_6" 7 "Custom_Mode_7" ;
VAL_TABLE_ SprtModeBrkPedVisDispVal 0 "Setting_Unknown" 1 "Custom_Mode_1" 2 "Custom_Mode_2" 3 "Custom_Mode_3" 4 "Custom_Mode_4" 5 "Custom_Mode_5" 6 "Custom_Mode_6" 7 "Custom_Mode_7" ;
VAL_TABLE_ SprtModeActvAeroVisDispVal 0 "Setting_Unknown" 1 "Custom_Mode_1" 2 "Custom_Mode_2" 3 "Custom_Mode_3" 4 "Custom_Mode_4" 5 "Custom_Mode_5" 6 "Custom_Mode_6" 7 "Custom_Mode_7" ;
VAL_TABLE_ SprtModeRideHghtVisDispVal 0 "Setting_Unknown" 1 "Custom_Mode_1" 2 "Custom_Mode_2" 3 "Custom_Mode_3" 4 "Custom_Mode_4" 5 "Custom_Mode_5" 6 "Custom_Mode_6" 7 "Custom_Mode_7" ;
VAL_TABLE_ SprtModePwrtrnVisDispVal 0 "Setting_Unknown" 1 "Custom_Mode_1" 2 "Custom_Mode_2" 3 "Custom_Mode_3" 4 "Custom_Mode_4" 5 "Custom_Mode_5" 6 "Custom_Mode_6" 7 "Custom_Mode_7" ;
VAL_TABLE_ SprtModeESCVisDispVal 0 "Setting_Unknown" 1 "Custom_Mode_1" 2 "Custom_Mode_2" 3 "Custom_Mode_3" 4 "Custom_Mode_4" 5 "Custom_Mode_5" 6 "Custom_Mode_6" 7 "Custom_Mode_7" ;
VAL_TABLE_ SprtModeSpnsnVisDispVal 0 "Setting_Unknown" 1 "Custom_Mode_1" 2 "Custom_Mode_2" 3 "Custom_Mode_3" 4 "Custom_Mode_4" 5 "Custom_Mode_5" 6 "Custom_Mode_6" 7 "Custom_Mode_7" ;
VAL_TABLE_ SprtModeSndVisDispVal 0 "Setting_Unknown" 1 "Custom_Mode_1" 2 "Custom_Mode_2" 3 "Custom_Mode_3" 4 "Custom_Mode_4" 5 "Custom_Mode_5" 6 "Custom_Mode_6" 7 "Custom_Mode_7" ;
VAL_TABLE_ ShfToPrkBfrExtIndOn 0 "FALSE" 1 "TRUE" ;
VAL_TABLE_ HillDscntCtlVirtSwAvl 0 "Not Available" 1 "Available" ;
VAL_TABLE_ WthrSnwModeStrgVisDispVal 0 "Setting_Unknown" 1 "Custom_Mode_1" 2 "Custom_Mode_2" 3 "Custom_Mode_3" 4 "Custom_Mode_4" 5 "Custom_Mode_5" 6 "Custom_Mode_6" 7 "Custom_Mode_7" ;
VAL_TABLE_ SprtModeStrgVisDispVal 0 "Setting_Unknown" 1 "Custom_Mode_1" 2 "Custom_Mode_2" 3 "Custom_Mode_3" 4 "Custom_Mode_4" 5 "Custom_Mode_5" 6 "Custom_Mode_6" 7 "Custom_Mode_7" ;
VAL_TABLE_ TkModeBrkPedVisDispVal 0 "Setting_Unknown" 1 "Custom_Mode_1" 2 "Custom_Mode_2" 3 "Custom_Mode_3" 4 "Custom_Mode_4" 5 "Custom_Mode_5" 6 "Custom_Mode_6" 7 "Custom_Mode_7" ;
VAL_TABLE_ TkModeActvAeroVisDispVal 0 "Setting_Unknown" 1 "Custom_Mode_1" 2 "Custom_Mode_2" 3 "Custom_Mode_3" 4 "Custom_Mode_4" 5 "Custom_Mode_5" 6 "Custom_Mode_6" 7 "Custom_Mode_7" ;
VAL_TABLE_ TireTrdTempSts 0 "Unknown" 1 "Cold" 2 "Cool" 3 "Normal" 4 "Warm" 5 "Hot" ;
VAL_TABLE_ TkModePwrtrnVisDispVal 0 "Setting_Unknown" 1 "Custom_Mode_1" 2 "Custom_Mode_2" 3 "Custom_Mode_3" 4 "Custom_Mode_4" 5 "Custom_Mode_5" 6 "Custom_Mode_6" 7 "Custom_Mode_7" ;
VAL_TABLE_ TkModeESCVisDispVal 0 "Setting_Unknown" 1 "Custom_Mode_1" 2 "Custom_Mode_2" 3 "Custom_Mode_3" 4 "Custom_Mode_4" 5 "Custom_Mode_5" 6 "Custom_Mode_6" 7 "Custom_Mode_7" ;
VAL_TABLE_ TkModeDrvlineVisDispVal 0 "Setting_Unknown" 1 "Custom_Mode_1" 2 "Custom_Mode_2" 3 "Custom_Mode_3" 4 "Custom_Mode_4" 5 "Custom_Mode_5" 6 "Custom_Mode_6" 7 "Custom_Mode_7" ;
VAL_TABLE_ TkModeSndVisDispVal 0 "Setting_Unknown" 1 "Custom_Mode_1" 2 "Custom_Mode_2" 3 "Custom_Mode_3" 4 "Custom_Mode_4" 5 "Custom_Mode_5" 6 "Custom_Mode_6" 7 "Custom_Mode_7" ;
VAL_TABLE_ TkModeRideHghtVisDispVal 0 "Setting_Unknown" 1 "Custom_Mode_1" 2 "Custom_Mode_2" 3 "Custom_Mode_3" 4 "Custom_Mode_4" 5 "Custom_Mode_5" 6 "Custom_Mode_6" 7 "Custom_Mode_7" ;
VAL_TABLE_ TourModeActvAeroVisDispVal 0 "Setting_Unknown" 1 "Custom_Mode_1" 2 "Custom_Mode_2" 3 "Custom_Mode_3" 4 "Custom_Mode_4" 5 "Custom_Mode_5" 6 "Custom_Mode_6" 7 "Custom_Mode_7" ;
VAL_TABLE_ TkModeStrgVisDispVal 0 "Setting_Unknown" 1 "Custom_Mode_1" 2 "Custom_Mode_2" 3 "Custom_Mode_3" 4 "Custom_Mode_4" 5 "Custom_Mode_5" 6 "Custom_Mode_6" 7 "Custom_Mode_7" ;
VAL_TABLE_ TkModeSpnsnVisDispVal 0 "Setting_Unknown" 1 "Custom_Mode_1" 2 "Custom_Mode_2" 3 "Custom_Mode_3" 4 "Custom_Mode_4" 5 "Custom_Mode_5" 6 "Custom_Mode_6" 7 "Custom_Mode_7" ;
VAL_TABLE_ TourModeESCVisDispVal 0 "Setting_Unknown" 1 "Custom_Mode_1" 2 "Custom_Mode_2" 3 "Custom_Mode_3" 4 "Custom_Mode_4" 5 "Custom_Mode_5" 6 "Custom_Mode_6" 7 "Custom_Mode_7" ;
VAL_TABLE_ TourModeDrvlineVisDispVal 0 "Setting_Unknown" 1 "Custom_Mode_1" 2 "Custom_Mode_2" 3 "Custom_Mode_3" 4 "Custom_Mode_4" 5 "Custom_Mode_5" 6 "Custom_Mode_6" 7 "Custom_Mode_7" ;
VAL_TABLE_ TourModeBrkPedVisDispVal 0 "Setting_Unknown" 1 "Custom_Mode_1" 2 "Custom_Mode_2" 3 "Custom_Mode_3" 4 "Custom_Mode_4" 5 "Custom_Mode_5" 6 "Custom_Mode_6" 7 "Custom_Mode_7" ;
VAL_TABLE_ TourModeRideHghtVisDispVal 0 "Setting_Unknown" 1 "Custom_Mode_1" 2 "Custom_Mode_2" 3 "Custom_Mode_3" 4 "Custom_Mode_4" 5 "Custom_Mode_5" 6 "Custom_Mode_6" 7 "Custom_Mode_7" ;
VAL_TABLE_ TourModePwrtrnVisDispVal 0 "Setting_Unknown" 1 "Custom_Mode_1" 2 "Custom_Mode_2" 3 "Custom_Mode_3" 4 "Custom_Mode_4" 5 "Custom_Mode_5" 6 "Custom_Mode_6" 7 "Custom_Mode_7" ;
VAL_TABLE_ TourModeStrgVisDispVal 0 "Setting_Unknown" 1 "Custom_Mode_1" 2 "Custom_Mode_2" 3 "Custom_Mode_3" 4 "Custom_Mode_4" 5 "Custom_Mode_5" 6 "Custom_Mode_6" 7 "Custom_Mode_7" ;
VAL_TABLE_ TourModeSpnsnVisDispVal 0 "Setting_Unknown" 1 "Custom_Mode_1" 2 "Custom_Mode_2" 3 "Custom_Mode_3" 4 "Custom_Mode_4" 5 "Custom_Mode_5" 6 "Custom_Mode_6" 7 "Custom_Mode_7" ;
VAL_TABLE_ TourModeSndVisDispVal 0 "Setting_Unknown" 1 "Custom_Mode_1" 2 "Custom_Mode_2" 3 "Custom_Mode_3" 4 "Custom_Mode_4" 5 "Custom_Mode_5" 6 "Custom_Mode_6" 7 "Custom_Mode_7" ;
VAL_TABLE_ TrlrStbAsstActIO 0 "FALSE" 1 "TRUE" ;
VAL_TABLE_ TrcCntrlOnIO 0 "FALSE" 1 "TRUE" ;
VAL_TABLE_ TrcCntrlOffIO 0 "FALSE" 1 "TRUE" ;
VAL_TABLE_ TnDrvTrCtrlOffUnvIndOn 0 "FALSE" 1 "TRUE" ;
VAL_TABLE_ SrBkLwBkFlDrVisMsgRqOn 0 "FALSE" 1 "TRUE" ;
VAL_TABLE_ TrcStbScrConfig 0 "None" 1 "TCS Only" 2 "TCS and ESC" 3 "TCS ESC and Comp" ;
VAL_TABLE_ Sig2631 0 "FALSE" 1 "TRUE" ;
VAL_TABLE_ Sig3403 0 "FALSE" 1 "TRUE" ;
VAL_TABLE_ Sig2663 0 "FALSE" 1 "TRUE" ;
VAL_TABLE_ Sig2619 0 "FALSE" 1 "TRUE" ;
VAL_TABLE_ Sig3646 0 "FALSE" 1 "TRUE" ;
VAL_TABLE_ Sig3486 0 "FALSE" 1 "TRUE" ;
VAL_TABLE_ Sig3483 0 "FALSE" 1 "TRUE" ;
VAL_TABLE_ ACRfHiSdFldPrs_Inv 0 "FALSE" 1 "TRUE" ;
VAL_TABLE_ ChrgCordThftAlrtCstSetAval 0 "FALSE" 1 "TRUE" ;
VAL_TABLE_ ChrgCordThftAlrtCstCurrSetVal 0 "No Action" 1 "Off" 2 "On" ;
VAL_TABLE_ ChrgPwrLossAlrtCstSetAval 0 "FALSE" 1 "TRUE" ;
VAL_TABLE_ ChrgrSysAudblIndCstCurrSetVal 0 "No Action" 1 "Off" 2 "On" ;
VAL_TABLE_ ChrgPwrLossAlrtCstCurrSetVal 0 "No Action" 1 "Off" 2 "On" ;
VAL_TABLE_ ChrgPortDrIndReq 0 "Inactive" 1 "Open Park" 2 "Open Moving" 3 "Fault" ;
VAL_TABLE_ HVWrlsChrgDrvrAlgnCkReqd 0 "FALSE" 1 "TRUE" ;
VAL_TABLE_ HVChrgVehSysFltSts 0 "None" 1 "Vehicle Control System Fault" 2 "Vehicle Operating Status Fault" ;
VAL_TABLE_ InsfcntTmtoCmpltChrgIndOn 0 "FALSE" 1 "TRUE" ;
VAL_TABLE_ CntctrsOpnUndrTempIndOn 0 "FALSE" 1 "TRUE" ;
VAL_TABLE_ ChrgrSysAudblIndCstSetAval 0 "FALSE" 1 "TRUE" ;
VAL_TABLE_ ChrgStsPeekInScrnActvIndOn 0 "FALSE" 1 "TRUE" ;
VAL_TABLE_ PrtblChrgCordLimCstSetAval 0 "FALSE" 1 "TRUE" ;
VAL_TABLE_ OffBrdChrgStnFltDtd 0 "FALSE" 1 "TRUE" ;
VAL_TABLE_ NeutCstdwnCertModeActvIndOn 0 "FALSE" 1 "TRUE" ;
VAL_TABLE_ LocBsdChrgCstSetAval 0 "FALSE" 1 "TRUE" ;
VAL_TABLE_ LocBsdChrgCstCurrSetVal 0 "No Action" 1 "Off" 2 "On" ;
VAL_TABLE_ LBCPSS_PstnUpdtLoc 0 "No Action" 1 "Update Position 1" 2 "Update Position 2" 3 "Update Position 3" 4 "Update Position 4" ;
VAL_TABLE_ LBCCDRR_PstnNumResp 0 "No Action" 1 "Clear Position 1" 2 "Clear Position 2" 3 "Clear Position 3" 4 "Clear Position 4" ;
VAL_TABLE_ LBCCDRR_ClrStrdPstnResp 0 "No Action" 1 "Clear Position Request Acknowledged" 2 "Clear Position Request Performed" ;
VAL_TABLE_ ServHybChrgSysIndOn 0 "FALSE" 1 "TRUE" ;
VAL_TABLE_ LBCCF_Loc4PstnStrdIndOn 0 "FALSE" 1 "TRUE" ;
VAL_TABLE_ LBCCF_Loc3PstnStrdIndOn 0 "FALSE" 1 "TRUE" ;
VAL_TABLE_ LBCCF_Loc2PstnStrdIndOn 0 "FALSE" 1 "TRUE" ;
VAL_TABLE_ LBCCF_Loc1PstnStrdIndOn 0 "FALSE" 1 "TRUE" ;
VAL_TABLE_ LBCPSS_PstnUpdtSts 0 "No Action" 1 "Position Updated" 2 "Position Modified" ;
VAL_TABLE_ VehLocSts 0 "Not Within Stored Regions" 1 "Within Stored Region 1" 2 "Within Stored Region 2" 3 "Within Stored Region 3" 4 "Within Stored Region 4" ;
VAL_TABLE_ VehLocSts_Inv 0 "FALSE" 1 "TRUE" ;
VAL_TABLE_ TODCSR_ChrgSchedDyOfWkResp 0 "No Action" 1 "Sunday" 2 "Monday" 3 "Tuesday" 4 "Wednesday" 5 "Thursday" 6 "Friday" 7 "Saturday" 8 "All Days Same" 9 "Monday to Friday Same" 10 "Saturday and Sunday Same" ;
VAL_TABLE_ TODCSR_ChrgSchedCstSetVal 0 "No Action" 1 "Off" 2 "On" ;
VAL_TABLE_ TODCSR_ERSPrdDyResp 0 "No Action" 1 "Weekday 1" 2 "Weekday 2" 3 "Weekday 3" 4 "Weekday 4" 5 "Weekday 5" 6 "Weekend 1" 7 "Weekend 2" 8 "Weekend 3" 9 "Weekend 4" 10 "Weekend 5" ;
VAL_TABLE_ TODCSR_ERSCstSetVal 0 "No Action" 1 "Off" 2 "On" ;
VAL_TABLE_ TODCSR_ERSPrdLvlResp 0 "No Action" 1 "Low Rate" 2 "Medium Rate" 3 "High Rate" 4 "Reserved 1" 5 "Invalid Rate" ;
VAL_TABLE_ PrtblChrgCordLimCstSetResp 0 "No Action" 1 "Reduced" 2 "Maximum" ;
VAL_TABLE_ TODCSR_ERSPrfResp 0 "No Action" 1 "Low Rate" 2 "Medium Rate" 3 "High Rate" ;
VAL_TABLE_ TODCCbnPrcndtngSetResp 0 "No Action" 1 "Off" 2 "On" ;
VAL_TABLE_ TODCSR_LocNumResp 0 "No Action" 1 "Not in Stored Location" 2 "Stored Location 1" 3 "Stored Location 2" 4 "Stored Location 3" 5 "Stored Location 4" ;
VAL_TABLE_ TODCSR_LocChrgPwrLvlResp 0 "Unknown" 1 "Level 1" 2 "Level 2" 3 "DC" 4 "Wireless" ;
VAL_TABLE_ UtlChrgIntfrIndOn 0 "FALSE" 1 "TRUE" ;
VAL_TABLE_ TODCNP_DprtrDyOfWk 0 "Unknown" 1 "Sunday" 2 "Monday" 3 "Tuesday" 4 "Wednesday" 5 "Thursday" 6 "Friday" 7 "Saturday" ;
VAL_TABLE_ TODCNP_Chrg 0 "No Action" 1 "Charge Now" 2 "Charge Later" 3 "Invalid" ;
VAL_TABLE_ TODCNP_PCCLCstCurrSetVal 0 "No Action" 1 "Reduced" 2 "Maximum" ;
VAL_TABLE_ TmOfDyChrgInvHMIEntIndReqd 0 "FALSE" 1 "TRUE" ;
VAL_TABLE_ PrtblChrgCordLimSetExpIndOn 0 "FALSE" 1 "TRUE" ;
VAL_TABLE_ RngPerHrGaindThisChrg_DuD 0 "FALSE" 1 "TRUE" ;
VAL_TABLE_ RngGaindThisChrg_DuD 0 "FALSE" 1 "TRUE" ;
VAL_TABLE_ TODCNextPlndCbnPrcndtngSetResp 0 "No Action" 1 "Off" 2 "On" ;
VAL_TABLE_ EngyEconMeasUnt 0 "Distance Per Electrical Energy" 1 "Distance Per Volume Equivalent" 2 "Electrical Energy Per Distance" 3 "Volume Equivalent Per Distance" 4 "Electrical Energy Per Distance x 100" 5 "Volume Equivalent Per Distance x 100" ;
VAL_TABLE_ ECHG_CurrEconRdy 0 "FALSE" 1 "TRUE" ;
VAL_TABLE_ HiVltgChrgAbrtRsn 0 "No Action" 1 "Loss of AC" 2 "Unplugged Charging" 3 "Unplugged Delayed" 4 "Charge Failure" 5 "Cordset Fault" 6 "Cordset Delay" ;
VAL_TABLE_ HiVltgChrgSysSplyFltIndOn 0 "FALSE" 1 "TRUE" ;
VAL_TABLE_ HiVltgBatStopChrgBtnVsbl 0 "FALSE" 1 "TRUE" ;
VAL_TABLE_ HiVltgBatChrgCordCnctdIndOn 0 "FALSE" 1 "TRUE" ;
VAL_TABLE_ HiVltgBatBulkChrgCmplt 0 "FALSE" 1 "TRUE" ;
VAL_TABLE_ ElecPrplMtrOvrSpdIndOn 0 "FALSE" 1 "TRUE" ;
VAL_TABLE_ HiVltgChrgInhbRsn 0 "No Action" 1 "Cord Not Fully Inserted" 2 "Cord Lock Not Engaged" 3 "See Charging Station" ;
VAL_TABLE_ DrvCycEleclEngyUsd_DuD 0 "FALSE" 1 "TRUE" ;
VAL_TABLE_ HiVltgBatPrplRng_Inv 0 "FALSE" 1 "TRUE" ;
VAL_TABLE_ HiVltgBatPrplRng_DuD 0 "FALSE" 1 "TRUE" ;
VAL_TABLE_ HiVltgBatRmnUsblEngy_Inv 0 "FALSE" 1 "TRUE" ;
VAL_TABLE_ HiVltgBatRmnUsblEngy_DuD 0 "FALSE" 1 "TRUE" ;
VAL_TABLE_ DispHiVltgBatChrgCmpltInfo 0 "FALSE" 1 "TRUE" ;
VAL_TABLE_ ElecRateSchedSsnResp 0 "No Action" 1 "Summer" 2 "Winter" 3 "Yearly" ;
VAL_TABLE_ HiVltgBatTotUsblEngy_Inv 0 "FALSE" 1 "TRUE" ;
VAL_TABLE_ HiVltgBatTotUsblEngy_DuD 0 "FALSE" 1 "TRUE" ;
VAL_TABLE_ ElecRateSchedSsnStrtMthResp 0 "No Action" 1 "January" 2 "February" 3 "March" 4 "April" 5 "May" 6 "June" 7 "July" 8 "August" 9 "September" 10 "October" 11 "November" 12 "December" ;
VAL_TABLE_ LIB1PackExtrnVltg_Inv 0 "FALSE" 1 "TRUE" ;
VAL_TABLE_ LIB1PackExtrnVltg_DuD 0 "FALSE" 1 "TRUE" ;
VAL_TABLE_ LIB1AvgTemp_Inv 0 "FALSE" 1 "TRUE" ;
VAL_TABLE_ LIB1AvgTemp_DuD 0 "FALSE" 1 "TRUE" ;
VAL_TABLE_ LIB1MaxTemp_DuD 0 "FALSE" 1 "TRUE" ;
VAL_TABLE_ LIB1MaxTemp_Inv 0 "FALSE" 1 "TRUE" ;
VAL_TABLE_ LIB1MinTemp_Inv 0 "FALSE" 1 "TRUE" ;
VAL_TABLE_ LIB1MinTemp_DuD 0 "FALSE" 1 "TRUE" ;
VAL_TABLE_ LIB1CellBalFlt_DuD 0 "FALSE" 1 "TRUE" ;
VAL_TABLE_ LIB1CellBalFlt 0 "No Fault" 1 "Low Severity" 2 "Medium Severity" 3 "High Severity" ;
VAL_TABLE_ LIB1StatOfChrg_Inv 0 "FALSE" 1 "TRUE" ;
VAL_TABLE_ LIB1StatOfChrg_DuD 0 "FALSE" 1 "TRUE" ;
VAL_TABLE_ LIB1CellVltgFlt_Inv 0 "FALSE" 1 "TRUE" ;
VAL_TABLE_ LIB1CellVltgFlt_DuD 0 "FALSE" 1 "TRUE" ;
VAL_TABLE_ LIB1CellVltgFlt 0 "No Fault" 1 "Low Severity" 2 "Medium Severity" 3 "High Severity" ;
VAL_TABLE_ LIB1CellBalFlt_Inv 0 "FALSE" 1 "TRUE" ;
VAL_TABLE_ StrgWhlTchSnsHndsOnStat 0 "Hands Off" 1 "Hands On" ;
VAL_TABLE_ ACCAutoStSpStat 0 "No_Set_Speed_Change" 1 "Proposed_Speed_Limit_Change" 2 "Accepted_Speed_Limit_Change" 3 "Declined_Speed_Limit_Change" ;
VAL_TABLE_ ACCSpdLimSgnUnt 0 "km/h" 1 "mph" ;
VAL_TABLE_ ACCDrSlctdSpdIndOn 0 "FALSE" 1 "TRUE" ;
VAL_TABLE_ FrwdImpMtgnOpSlctCstCrStVal 0 "SETTING_UNKNOWN" 1 "OFF" 2 "ALERT" 3 "ALERT_BRAKE" 4 "ALERT_BRAKE_STEER" 5 "RESERVED_5" 6 "RESERVED_6" 7 "RESERVED_7" ;
VAL_TABLE_ FrntPCMRspTypCstCrStVal 0 "SETTING_UNKNOWN" 1 "OFF" 2 "ALERT" 3 "ALERT_AND_BRAKE" 4 "ALERT_AND_BRAKE_AND_STEER" 5 "RESERVED_5" 6 "RESERVED_6" 7 "RESERVED_7" ;
VAL_TABLE_ ACCSysSlctdMd 0 "Cruise Control Mode Switching Not Supported" 1 "Adaptive Cruise Control" 2 "Enhanced Cruise Control" ;
VAL_TABLE_ FrntPCMRspTypCstAvlFlg1 0 "FALSE" 1 "TRUE" ;
VAL_TABLE_ AutoEmrgBrkgDsbldIndOn 0 "FALSE" 1 "TRUE" ;
VAL_TABLE_ ACCGoNtfrChmEvntSt 0 "NO_ACTION" 1 "ACTIVE" ;
VAL_TABLE_ AnmlWrnIndReq 0 "Off" 1 "Animal Advisory" 2 "Animal Alert" ;
VAL_TABLE_ FrwdVehAhdIndReq 0 "OFF" 1 "ON" 2 "0.5_Hz" 3 "1_Hz" 4 "2_Hz" 5 "4_Hz" ;
VAL_TABLE_ FrtPedtrnClsnMtgnAudAttnReqd 0 "FALSE" 1 "TRUE" ;
VAL_TABLE_ FrntPCMRspTypCstStAvl 0 "FALSE" 1 "TRUE" ;
VAL_TABLE_ FrntPCMRspTypCstAvlFlg7 0 "FALSE" 1 "TRUE" ;
VAL_TABLE_ FrntPCMRspTypCstAvlFlg6 0 "FALSE" 1 "TRUE" ;
VAL_TABLE_ FrntPCMRspTypCstAvlFlg5 0 "FALSE" 1 "TRUE" ;
VAL_TABLE_ FrntPCMRspTypCstAvlFlg4 0 "FALSE" 1 "TRUE" ;
VAL_TABLE_ FrntPCMRspTypCstAvlFlg3 0 "FALSE" 1 "TRUE" ;
VAL_TABLE_ FrntPCMRspTypCstAvlFlg2 0 "FALSE" 1 "TRUE" ;
VAL_TABLE_ FrwdImpMtgnOpSlctCstAvlFlg7 0 "FALSE" 1 "TRUE" ;
VAL_TABLE_ FrwdImpMtgnOpSlctCstAvlFlg6 0 "FALSE" 1 "TRUE" ;
VAL_TABLE_ FrwdImpMtgnOpSlctCstAvlFlg5 0 "FALSE" 1 "TRUE" ;
VAL_TABLE_ FrwdImpMtgnOpSlctCstAvlFlg4 0 "FALSE" 1 "TRUE" ;
VAL_TABLE_ FrwdImpMtgnOpSlctCstAvlFlg3 0 "FALSE" 1 "TRUE" ;
VAL_TABLE_ FrwdImpMtgnOpSlctCstAvlFlg2 0 "FALSE" 1 "TRUE" ;
VAL_TABLE_ FrwdImpMtgnOpSlctCstAvlFlg1 0 "FALSE" 1 "TRUE" ;
VAL_TABLE_ FrwdClsnAlrtImntAlrtAudAttnReqd 0 "FALSE" 1 "TRUE" ;
VAL_TABLE_ GoNotfrCstAvlFlg7 0 "FALSE" 1 "TRUE" ;
VAL_TABLE_ GoNotfrCstAvlFlg6 0 "FALSE" 1 "TRUE" ;
VAL_TABLE_ GoNotfrCstAvlFlg5 0 "FALSE" 1 "TRUE" ;
VAL_TABLE_ GoNotfrCstAvlFlg4 0 "FALSE" 1 "TRUE" ;
VAL_TABLE_ GoNotfrCstAvlFlg3 0 "FALSE" 1 "TRUE" ;
VAL_TABLE_ GoNotfrCstAvlFlg2 0 "FALSE" 1 "TRUE" ;
VAL_TABLE_ GoNotfrCstAvlFlg1 0 "FALSE" 1 "TRUE" ;
VAL_TABLE_ FrwdImpMtgnOpSlctCstStAvl 0 "FALSE" 1 "TRUE" ;
VAL_TABLE_ SprTireSt 0 "Undetermined" 1 "No Spare Detected" 2 "Spare Detected" ;
VAL_TABLE_ RAI1P_RrAxlStsAuth 0 "Normal" 1 "Temporary Inhibit" 2 "Temporary Limited" 3 "Permanently Failed" ;
VAL_TABLE_ RAI1P_RrAxlEstdTrqAuth_Inv 0 "FALSE" 1 "TRUE" ;
VAL_TABLE_ PIMRI_WE48_PrmntDTCInd 0 "FALSE" 1 "TRUE" ;
VAL_TABLE_ PIMRI_WE48_FltsPrsntInd 0 "FALSE" 1 "TRUE" ;
VAL_TABLE_ TirePrsStatLRInr 0 "Unknown" 1 "Nominal" 2 "Low - Service Now" 3 "Low" 4 "Low - Extended Mobility" 5 "High" ;
VAL_TABLE_ TirePrsLRInr_Inv 0 "FALSE" 1 "TRUE" ;
VAL_TABLE_ TirePrsStatRRInr 0 "Unknown" 1 "Nominal" 2 "Low - Service Now" 3 "Low" 4 "Low - Extended Mobility" 5 "High" ;
VAL_TABLE_ TirePrsRRInr_Inv 0 "FALSE" 1 "TRUE" ;
VAL_TABLE_ ElecRateSchedSsnStrtMthReq 0 "No Action" 1 "January" 2 "February" 3 "March" 4 "April" 5 "May" 6 "June" 7 "July" 8 "August" 9 "September" 10 "October" 11 "November" 12 "December" ;
VAL_TABLE_ ElecRateSchedSsnReq 0 "No Action" 1 "Summer" 2 "Winter" 3 "Yearly" ;
VAL_TABLE_ VirtOnePedDrvReq 0 "No Action" 1 "On" 2 "Off" ;
VAL_TABLE_ TlmHVDCFstChrgSoonReq 0 "No Action" 1 "Off" 2 "On" ;
VAL_TABLE_ HVDCFstChrgSoonReq 0 "No Action" 1 "Off" 2 "On" ;
VAL_TABLE_ OnePedDrvCstChgSetReq 0 "No Action" 1 "Level 1" 2 "Level 2" 3 "Level 3" 4 "Level 4" ;
VAL_TABLE_ Sig2580 0 "Unknown" 1 "Partial Loss" 2 "Full Loss" 3 "No Faults Detected" ;
VAL_TABLE_ Sig0613 0 "Unknown" 1 "Partial Loss" 2 "Full Loss" 3 "No Faults Detected" ;
VAL_TABLE_ E44MutDrvrReq 0 "No Action" 1 "Mute Requested" 2 "Unmute Requested" ;
VAL_TABLE_ CbnPrcndtngSchTempCstSetReqAtv 0 "FALSE" 1 "TRUE" ;
VAL_TABLE_ DMSIntnDrvrCstChgSetReq 0 "No Action" 1 "Off" 2 "On" ;
VAL_TABLE_ DMSDrwDrvrCstChgSetReq 0 "No Action" 1 "Off" 2 "Normal" 3 "Low Sensitivity" ;
VAL_TABLE_ Sig3200 0 "Unknown" 1 "Partial Loss" 2 "Full Loss" 3 "No Faults Detected" ;
VAL_TABLE_ VehDynsPerfModeReq 0 "No Action" 1 "Tour" 2 "Sport" 3 "Track" 4 "Weather" 5 "Performance Mode 5" 6 "Performance Mode 6" 7 "Performance Mode 7" ;
VAL_TABLE_ RrDiffPerfModeReq 0 "No Action" 1 "Normal" 2 "ESC & TCS Off" 3 "PTM 2-5" 4 "TCS Off" 5 "Rear eLocker Speed Limited" 6 "4Hi/Terrain" 7 "Rear eLocker No Speed Limit" ;
VAL_TABLE_ OnePedDrvCstSetAval 0 "FALSE" 1 "TRUE" ;
VAL_TABLE_ OnePedDrvCstSetAllwdFlg7 0 "FALSE" 1 "TRUE" ;
VAL_TABLE_ OnePedDrvCstSetAllwdFlg6 0 "FALSE" 1 "TRUE" ;
VAL_TABLE_ OnePedDrvCstSetAllwdFlg5 0 "FALSE" 1 "TRUE" ;
VAL_TABLE_ OnePedDrvCstSetAllwdFlg4 0 "FALSE" 1 "TRUE" ;
VAL_TABLE_ OnePedDrvCstSetAllwdFlg3 0 "FALSE" 1 "TRUE" ;
VAL_TABLE_ OnePedDrvCstSetAllwdFlg2 0 "FALSE" 1 "TRUE" ;
VAL_TABLE_ OnePedDrvCstSetAllwdFlg1 0 "FALSE" 1 "TRUE" ;
VAL_TABLE_ VirtOnePedDrvCtlAval 0 "Not Available" 1 "Available" ;
VAL_TABLE_ OnePedDrvCstSetAvlFlg7 0 "FALSE" 1 "TRUE" ;
VAL_TABLE_ OnePedDrvCstSetAvlFlg6 0 "FALSE" 1 "TRUE" ;
VAL_TABLE_ OnePedDrvCstSetAvlFlg5 0 "FALSE" 1 "TRUE" ;
VAL_TABLE_ OnePedDrvCstSetAvlFlg4 0 "FALSE" 1 "TRUE" ;
VAL_TABLE_ OnePedDrvCstSetAvlFlg3 0 "FALSE" 1 "TRUE" ;
VAL_TABLE_ OnePedDrvCstSetAvlFlg2 0 "FALSE" 1 "TRUE" ;
VAL_TABLE_ OnePedDrvCstSetAvlFlg1 0 "FALSE" 1 "TRUE" ;
VAL_TABLE_ VirtOnePedDrvUserCtlAllwd 0 "Allowed" 1 "Not Allowed" ;
VAL_TABLE_ OnePedDrvIndOn 0 "FALSE" 1 "TRUE" ;
VAL_TABLE_ OnePedDrvWrnIndReq 0 "No Action" 1 "Forced Exit" ;
VAL_TABLE_ OnePedDrvCurrSeltnVal 0 "Unknown" 1 "On" 2 "Off" ;
VAL_TABLE_ OnePedDrvCstCurrSetVal 0 "Setting Unknown" 1 "Level 1" 2 "Level 2" 3 "Level 3" 4 "Level 4" ;
VAL_TABLE_ ElecMchnAInvrtStat 0 "Power Consumption" 1 "Power Generation" 2 "Deactivated" 3 "Readiness" 4 "Faulted" 5 "Invalid" ;
VAL_TABLE_ Sig4928 0 "FALSE" 1 "TRUE" ;
VAL_TABLE_ PrplSysInvrtBDCCurrAuth_Inv 0 "FALSE" 1 "TRUE" ;
VAL_TABLE_ PrplSysMtrBRotrTemp_Inv 0 "FALSE" 1 "TRUE" ;
VAL_TABLE_ Sig2567 0 "Power Consumption" 1 "Power Generation" 2 "Deactivated" 3 "Readiness" 4 "Faulted" 5 "Invalid" ;
VAL_TABLE_ PrplSysMtrBSttrTemp_Inv 0 "FALSE" 1 "TRUE" ;
VAL_TABLE_ PIMRI_VECM_PrmntDTCInd 0 "FALSE" 1 "TRUE" ;
VAL_TABLE_ PIMRI_VECM_FltsPrsntInd 0 "FALSE" 1 "TRUE" ;
VAL_TABLE_ BECM2EmsRltMlfAtv 0 "FALSE" 1 "TRUE" ;
VAL_TABLE_ BECM2ERDTC_SysDes 0 "P0-Powertrain Codes SAE Controlled" 1 "P1-Powertrain Codes MFG Controlled" 2 "P2-Powertrain Codes Reserved" 3 "P3-Powertrain Codes Reserved" 4 "C0-Chassis Codes SAE Controlled" 5 "C1-Chassis Codes MFG Controlled" 6 "C2-Chassis Codes Reserved" 7 "C3-Chassis Codes Reserved" 8 "B0-Body Codes SAE Controlled" 9 "B1-Body Codes MFG Controlled" 10 "B2-Body Codes Reserved" 11 "B3-Body Codes Reserved" 12 "U0-Network Codes SAE Controlled" 13 "U1-Network Codes MFG Controlled" 14 "U2- Network Codes Reserved" 15 "U3-Network Codes Reserved" ;
VAL_TABLE_ HiVltgBatDispTempLvlPct_DuD 0 "FALSE" 1 "TRUE" ;
VAL_TABLE_ HiVltgBatLoSOCIndReq 0 "No Action" 1 "Warning Level 1" 2 "Warning Level 2" 3 "Warning Level 3" ;
VAL_TABLE_ HiVltgBatLoSOCIndReq_DuD 0 "FALSE" 1 "TRUE" ;
VAL_TABLE_ HiVltgBatPrcndtngSts 0 "No Action" 1 "Inactive" 2 "Active" 3 "Performance Limited" 4 "Battery At Target" 5 "Disabled" ;
VAL_TABLE_ HiVltgBatPrcndtngSts_DuD 0 "FALSE" 1 "TRUE" ;
VAL_TABLE_ HVDCFstChrgPrepCmpltIndOn 0 "FALSE" 1 "TRUE" ;
VAL_TABLE_ HVDCFstChrgPerfLtdIndOn 0 "FALSE" 1 "TRUE" ;
VAL_TABLE_ CbnPrcndtngSchTempCstSetAval 0 "FALSE" 1 "TRUE" ;
VAL_TABLE_ HiVltgBatMaxCellVltg_Inv 0 "FALSE" 1 "TRUE" ;
VAL_TABLE_ HiVltgBatMinCellVltg_Inv 0 "FALSE" 1 "TRUE" ;
VAL_TABLE_ AuxPwrModDCDCStat 0 "In Operation" 1 "Cut-off" ;
VAL_TABLE_ PrplSysInvrtADCCurrAuth_Inv 0 "FALSE" 1 "TRUE" ;
VAL_TABLE_ HVWrlsChrgFncActvtd 0 "FALSE" 1 "TRUE" ;
VAL_TABLE_ HVBatWrlsCntctrSts 0 "Open" 1 "Precharge" 2 "Close" ;
VAL_TABLE_ HVWrlsChrgFncActvtdTyp 0 "None" 1 "Local Enable" 2 "Remote Enable" 3 "Reserved" 4 "User Disable" 5 "Vehicle Operating Mode Disable" 6 "PPC Fault Disable" 7 "PTC Fault Disable" 8 "CSU Fault Disable" 9 "WCCMS Disable" 10 "PFC Fault Disable" 11 "Vehicle Actively Disable" ;
VAL_TABLE_ HVWrlsChrgModeCmd 0 "None" 1 "Voltage Control Mode" 2 "Current Control Mode" ;
VAL_TABLE_ SecAxlDrvUntOilTemp_Inv 0 "FALSE" 1 "TRUE" ;
VAL_TABLE_ RrStrgModeSeltnIndOn 0 "FALSE" 1 "TRUE" ;
VAL_TABLE_ RrStrgModeUnvIndReq 0 "No Indication" 1 "Speed Too High" 2 "Incorrect Gear" 3 "Mode Unavailable" 4 "Steering Too Fast" 5 "Automated Driving 1" 6 "Automated Driving 2" ;
VAL_TABLE_ Sig4476 0 "FALSE" 1 "TRUE" ;
VAL_TABLE_ Sig5020 0 "FALSE" 1 "TRUE" ;
VAL_TABLE_ PnCActnReqCertfctTyp 0 "None" 1 "GM Provisioning Certificate" 2 "Contract Certificate" 3 "V2G Root Certificate" 4 "OCSP Certificate" 5 "Private Operator Root Certificate" 6 "Reserved1" 7 "Reserved2" 8 "Reserved3" 9 "Reserved4" 10 "Reserved5" 11 "Reserved6" 12 "Reserved7" 13 "Reserved8" 14 "All Contract And Private Operator Root Certificates" ;
VAL_TABLE_ PnCActnReqCertfctOp 0 "No Action" 1 "Disable Certificate" 2 "Enable Certificate" 3 "Erase Certificate" 4 "Install Certificate" ;
VAL_TABLE_ PnCEnblReq 0 "Unknown" 1 "No Action" 2 "Enable" 3 "Disable" ;
VAL_TABLE_ AutoCoolServFllIndReq 0 "No Indication" 1 "ACSF Enabled" 2 "ACSF Completed Successfully" 3 "ACSF Canceled" ;
VAL_TABLE_ Sig4478 0 "Cleaning Not Required" 1 "Allowed" 2 "Not Allowed" 3 "In Progress" 4 "Complete" 5 "Pending Driver Input" 6 "Not Available" 7 "Do Not Press Pedals" ;
VAL_TABLE_ Sig2583 0 "No Action" 1 "No Indication" 2 "Idle Needed" 3 "Overheated" 4 "Interrupted" ;
VAL_TABLE_ Sig4480 0 "FALSE" 1 "TRUE" ;
VAL_TABLE_ PrplSysChsSysPriAxlRtTrqReqSts 0 "No Request" 1 "Request Honored" 2 "Lost Arbitration" 3 "Serial Data Failure Temporary" 4 "Serial Data Failure Permanent" 5 "Control System Failure Temporary" 6 "Control System Failure Permanent" ;
VAL_TABLE_ PrplSysChsSysPriAxlLtTrqReqSts 0 "No Request" 1 "Request Honored" 2 "Lost Arbitration" 3 "Serial Data Failure Temporary" 4 "Serial Data Failure Permanent" 5 "Control System Failure Temporary" 6 "Control System Failure Permanent" ;
VAL_TABLE_ PrplSysElecPrkBrkApplReqd 0 "FALSE" 1 "TRUE" ;
VAL_TABLE_ DrvMtrSysFltd 0 "FALSE" 1 "TRUE" ;
VAL_TABLE_ ICMTrngOncmgTrfcChmEvntStat 0 "No Action" 1 "Active" 2 "Cancel Chime" ;
VAL_TABLE_ ICMRtChmEvntStat 0 "No Action" 1 "Active" 2 "Cancel Chime" ;
VAL_TABLE_ ICMLtChmEvntStat 0 "No Action" 1 "Active" 2 "Cancel Chime" ;
VAL_TABLE_ RIMUnvTlgtIndOn 0 "FALSE" 1 "TRUE" ;
VAL_TABLE_ ICMWrnIndReq 0 "Off" 1 "Left" 2 "Right" 3 "Oncoming" ;
VAL_TABLE_ PnCCertStsDispCertTyp2 0 "None" 1 "GM Provisioning Certificate" 2 "Contract Certificate" 3 "V2G Root Certificate" 4 "OCSP Certificate" 5 "Private Operator Root Certificate" ;
VAL_TABLE_ PnCCertStsDispCertTyp3 0 "None" 1 "GM Provisioning Certificate" 2 "Contract Certificate" 3 "V2G Root Certificate" 4 "OCSP Certificate" 5 "Private Operator Root Certificate" ;
VAL_TABLE_ PnCCertStsDispCertTyp4 0 "None" 1 "GM Provisioning Certificate" 2 "Contract Certificate" 3 "V2G Root Certificate" 4 "OCSP Certificate" 5 "Private Operator Root Certificate" ;
VAL_TABLE_ PnCCertStsDispCertTyp1 0 "None" 1 "GM Provisioning Certificate" 2 "Contract Certificate" 3 "V2G Root Certificate" 4 "OCSP Certificate" 5 "Private Operator Root Certificate" ;
VAL_TABLE_ PnCCertStsDispCertSts 0 "No Action" 1 "Certificate Not Installed" 2 "Certificate Disabled" 3 "Certificate Enabled" ;
VAL_TABLE_ PnCCertStsDispCertTyp5 0 "None" 1 "GM Provisioning Certificate" 2 "Contract Certificate" 3 "V2G Root Certificate" 4 "OCSP Certificate" 5 "Private Operator Root Certificate" ;
VAL_TABLE_ Sig0071 0 "FALSE" 1 "TRUE" ;
VAL_TABLE_ HVBatOutOfEngyRdcdPrplReq 0 "FALSE" 1 "TRUE" ;
VAL_TABLE_ Sig0070 0 "FALSE" 1 "TRUE" ;
VAL_TABLE_ DrvMtrInvrt3MaxTemp_Inv 0 "FALSE" 1 "TRUE" ;
VAL_TABLE_ ManRgnModeOvrrdn 0 "FALSE" 1 "TRUE" ;
VAL_TABLE_ PnCActnStsCertfctTyp 0 "None" 1 "GM Provisioning Certificate" 2 "Contract Certificate" 3 "V2G Root Certificate" 4 "OCSP Certificate" 5 "Private Operator Root Certificate" 6 "Reserved1" 7 "Reserved2" 8 "Reserved3" 9 "Reserved4" 10 "Reserved5" 11 "Reserved6" 12 "Reserved7" 13 "Reserved8" 14 "All Contract And Private Operator Root Certificates" ;
VAL_TABLE_ PnCActnStsCertfctOpSts 0 "NoAction" 1 "CertificateDisabledSuccessfully" 2 "CertificateDisableFailed" 3 "CertificateEnabledSuccessfully" 4 "CertificateEnableFailed" 5 "CertificateErasedSuccessfully" 6 "CertificateErasureFailed" 7 "CertificateDisableOperationInProgress" 8 "CertificateEnableOperationInProgress" 9 "CertificateEraseOperationInProgress" 10 "SelectedCertificateOperationLocationisOutofBounds" 11 "NoCertificateisInstalledintheRequestedCertificateLocation" 12 "NoCertificateofThisCertificateTypeisInstalledintheEVCC" 13 "CertificateOperationNotSupportedonThisCertificateType" 14 "CertificateOperationCannotbePerformedatThisTime" 15 "CertificateInstallOperationInProgress" 16 "CertificateInstalledSuccessfully" 17 "CertificateInstallFailed" ;
VAL_TABLE_ PnCStsDisp 0 "No Action" 1 "No Errors" 2 "Unplug And Replug" 3 "Two Factor Authentication Failure" 4 "Try Different Charging Station" 5 "Install Contract or Private Operator Certificate" 6 "Contract Certificate Invalid" 7 "Service Vehicle" 8 "Certificate Revoked" ;
VAL_TABLE_ PnCEnbldSts 0 "Unknown" 1 "Enabled" 2 "Disabled" ;
VAL_TABLE_ GNSSVel01EstVelUncrtnty_DuD 0 "FALSE" 1 "TRUE" ;
VAL_TABLE_ GNSSVel01EstVel_Inv 0 "FALSE" 1 "TRUE" ;
VAL_TABLE_ GNSSVel01EstVel_DuD 0 "FALSE" 1 "TRUE" ;
VAL_TABLE_ GNSSVel01EstVelUncrtnty_Inv 0 "FALSE" 1 "TRUE" ;
VAL_TABLE_ GNSSVel01NrthVel_Inv 0 "FALSE" 1 "TRUE" ;
VAL_TABLE_ GNSSVel01NrthVel_DuD 0 "FALSE" 1 "TRUE" ;
VAL_TABLE_ GNSSVel01NrthVelUncrtnty_Inv 0 "FALSE" 1 "TRUE" ;
VAL_TABLE_ GNSSVel01NrthVelUncrtnty_DuD 0 "FALSE" 1 "TRUE" ;
VAL_TABLE_ GNSSVel02UpVel_Inv 0 "FALSE" 1 "TRUE" ;
VAL_TABLE_ GNSSVel02UpVel_DuD 0 "FALSE" 1 "TRUE" ;
VAL_TABLE_ GNSSVel02UpVelUncrtnty_Inv 0 "FALSE" 1 "TRUE" ;
VAL_TABLE_ GNSSVel02UpVelUncrtnty_DuD 0 "FALSE" 1 "TRUE" ;
VAL_TABLE_ GPSQM_PPSMode 0 "GNSS Standalone" 1 "GNSS and SBAS" 2 "GNSS and RTX" 3 "GNSS and DR" 4 "GNSS and SBAS and DR" 5 "GNSS and RTX and DR" 6 "DR ONLY" 7 "GNSS and RTX and DR and MM" ;
VAL_TABLE_ GPSQM_PPSMode_Inv 0 "FALSE" 1 "TRUE" ;
VAL_TABLE_ WndPstnStsRR 0 "Denormalized" 1 "Fully Closed" 2 "Less Than Position A" 3 "Position A" 4 "Greater Than A but less than Position C" 5 "Position C" 6 "Greater than Position C but less than Fully open" 7 "Fully Open" ;
VAL_TABLE_ WndPstnStsLR 0 "Denormalized" 1 "Fully Closed" 2 "Less Than Position A" 3 "Position A" 4 "Greater Than A but less than Position C" 5 "Position C" 6 "Greater than Position C but less than Fully open" 7 "Fully Open" ;
VAL_TABLE_ HiBmSelSwActv 0 "FALSE" 1 "TRUE" ;
VAL_TABLE_ AE44BkBtnSts 0 "No Request" 1 "Back Request" ;
VAL_TABLE_ AE44SuprPrkSts 0 "No Request" 1 "In Vehicle Request" 2 "Supervised Request" ;
VAL_TABLE_ LnchCtlUnvRsn 0 "No Indication" 1 "Steering Turned" 2 "Generic Unused 2" 3 "Generic Unused 3" 4 "Generic Unused 4" 5 "Generic Unused 5" 6 "Generic Unused 6" 7 "Generic Unused 7" ;
VAL_TABLE_ LnchCtlSts 0 "No Action" 1 "Unavailable" 2 "Available" 3 "Armed" 4 "Active" 5 "Generic Unused 5" 6 "Generic Unused 6" 7 "Generic Unused 7" ;
VAL_TABLE_ LnchCtlCchTrgrd 0 "FALSE" 1 "TRUE" ;
VAL_TABLE_ EVPedMpPerfModeReq 0 "No Action" 1 "Normal" 2 "Sport" 3 "Snow" 4 "Track_Baja_Offroad" 5 "Crawl" 6 "Max Power" 7 "Tow_Haul" ;
VAL_TABLE_ Sig2415 0 "FALSE" 1 "TRUE" ;
VAL_TABLE_ VirtRrAxlLckSts 0 "Off" 1 "On" 2 "Unavailable" 3 "Faulted" ;
VAL_TABLE_ PrplSysMtrCRotrTemp_Inv 0 "FALSE" 1 "TRUE" ;
VAL_TABLE_ PrplSysMtrCSttrTemp_Inv 0 "FALSE" 1 "TRUE" ;
VAL_TABLE_ Sig2414 0 "No Fault" 1 "Propulsion Fault" 2 "HV Fault" 3 "Controller Fault" 4 "Latent Fault" 5 "Full Propulsion System Fault" ;
VAL_TABLE_ SuprRmtPrkAval 0 "Not Available" 1 "Available" ;
VAL_TABLE_ Sig4600 0 "FALSE" 1 "TRUE" ;
VAL_TABLE_ Sig4599 0 "FALSE" 1 "TRUE" ;
VAL_TABLE_ Sig4598 0 "FALSE" 1 "TRUE" ;
VAL_TABLE_ Sig4597 0 "FALSE" 1 "TRUE" ;
VAL_TABLE_ Sig4596 0 "FALSE" 1 "TRUE" ;
VAL_TABLE_ Sig4595 0 "FALSE" 1 "TRUE" ;
VAL_TABLE_ E49HrnChrpReq 0 "No Action" 1 "Active" 2 "Cancel Horn" ;
VAL_TABLE_ Sig4608 0 "FALSE" 1 "TRUE" ;
VAL_TABLE_ Sig4607 0 "FALSE" 1 "TRUE" ;
VAL_TABLE_ Sig4606 0 "FALSE" 1 "TRUE" ;
VAL_TABLE_ Sig4605 0 "FALSE" 1 "TRUE" ;
VAL_TABLE_ Sig4604 0 "FALSE" 1 "TRUE" ;
VAL_TABLE_ Sig4603 0 "FALSE" 1 "TRUE" ;
VAL_TABLE_ Sig4602 0 "FALSE" 1 "TRUE" ;
VAL_TABLE_ Sig4601 0 "FALSE" 1 "TRUE" ;
VAL_TABLE_ Sig4802 0 "FALSE" 1 "TRUE" ;
VAL_TABLE_ Sig4801 0 "FALSE" 1 "TRUE" ;
VAL_TABLE_ Sig4800 0 "FALSE" 1 "TRUE" ;
VAL_TABLE_ Sig4688 0 "FALSE" 1 "TRUE" ;
VAL_TABLE_ Sig4687 0 "FALSE" 1 "TRUE" ;
VAL_TABLE_ Sig4626 0 "FALSE" 1 "TRUE" ;
VAL_TABLE_ Sig4625 0 "FALSE" 1 "TRUE" ;
VAL_TABLE_ Sig4609 0 "FALSE" 1 "TRUE" ;
VAL_TABLE_ Sig4810 0 "FALSE" 1 "TRUE" ;
VAL_TABLE_ Sig4809 0 "FALSE" 1 "TRUE" ;
VAL_TABLE_ Sig4808 0 "FALSE" 1 "TRUE" ;
VAL_TABLE_ Sig4807 0 "FALSE" 1 "TRUE" ;
VAL_TABLE_ Sig4806 0 "FALSE" 1 "TRUE" ;
VAL_TABLE_ Sig4805 0 "FALSE" 1 "TRUE" ;
VAL_TABLE_ Sig4804 0 "FALSE" 1 "TRUE" ;
VAL_TABLE_ Sig4803 0 "FALSE" 1 "TRUE" ;
VAL_TABLE_ Sig4826 0 "FALSE" 1 "TRUE" ;
VAL_TABLE_ Sig4825 0 "FALSE" 1 "TRUE" ;
VAL_TABLE_ Sig4824 0 "FALSE" 1 "TRUE" ;
VAL_TABLE_ Sig4823 0 "FALSE" 1 "TRUE" ;
VAL_TABLE_ Sig4814 0 "FALSE" 1 "TRUE" ;
VAL_TABLE_ Sig4813 0 "FALSE" 1 "TRUE" ;
VAL_TABLE_ Sig4812 0 "FALSE" 1 "TRUE" ;
VAL_TABLE_ Sig4811 0 "FALSE" 1 "TRUE" ;
VAL_TABLE_ Sig4834 0 "FALSE" 1 "TRUE" ;
VAL_TABLE_ Sig4833 0 "FALSE" 1 "TRUE" ;
VAL_TABLE_ Sig4832 0 "FALSE" 1 "TRUE" ;
VAL_TABLE_ Sig4831 0 "FALSE" 1 "TRUE" ;
VAL_TABLE_ Sig4830 0 "FALSE" 1 "TRUE" ;
VAL_TABLE_ Sig4829 0 "FALSE" 1 "TRUE" ;
VAL_TABLE_ Sig4828 0 "FALSE" 1 "TRUE" ;
VAL_TABLE_ Sig4827 0 "FALSE" 1 "TRUE" ;
VAL_TABLE_ Sig4860 0 "FALSE" 1 "TRUE" ;
VAL_TABLE_ Sig4859 0 "FALSE" 1 "TRUE" ;
VAL_TABLE_ Sig4858 0 "FALSE" 1 "TRUE" ;
VAL_TABLE_ Sig4857 0 "FALSE" 1 "TRUE" ;
VAL_TABLE_ Sig4856 0 "FALSE" 1 "TRUE" ;
VAL_TABLE_ Sig4837 0 "FALSE" 1 "TRUE" ;
VAL_TABLE_ Sig4836 0 "FALSE" 1 "TRUE" ;
VAL_TABLE_ Sig4835 0 "FALSE" 1 "TRUE" ;
VAL_TABLE_ Sig4883 0 "FALSE" 1 "TRUE" ;
VAL_TABLE_ Sig4882 0 "FALSE" 1 "TRUE" ;
VAL_TABLE_ Sig4881 0 "FALSE" 1 "TRUE" ;
VAL_TABLE_ Sig4880 0 "FALSE" 1 "TRUE" ;
VAL_TABLE_ Sig4879 0 "FALSE" 1 "TRUE" ;
VAL_TABLE_ Sig4878 0 "FALSE" 1 "TRUE" ;
VAL_TABLE_ Sig4862 0 "FALSE" 1 "TRUE" ;
VAL_TABLE_ Sig4861 0 "FALSE" 1 "TRUE" ;
VAL_TABLE_ Sig4884 0 "FALSE" 1 "TRUE" ;
VAL_TABLE_ LIBSOCCalReqd 0 "FALSE" 1 "TRUE" ;
VAL_TABLE_ ChrgCycEleclEngyUsd_DuD 0 "FALSE" 1 "TRUE" ;
VAL_TABLE_ OffBrdVehImbNtfn 0 "No action" 1 "Warning Level 1" 2 "Warning Level 2" 3 "Warning Level 3" ;
VAL_TABLE_ LifetmEleclEngyEcon_DuD 0 "FALSE" 1 "TRUE" ;
VAL_TABLE_ HVThrmlPwrCnsmd_Inv 0 "FALSE" 1 "TRUE" ;
VAL_TABLE_ HVThrmlPwrCnsmd_DuD 0 "FALSE" 1 "TRUE" ;
VAL_TABLE_ Sig4940 0 "FALSE" 1 "TRUE" ;
VAL_TABLE_ EngCmptAjr 0 "FALSE" 1 "TRUE" ;
VAL_TABLE_ EngCmptAjr_Inv 0 "FALSE" 1 "TRUE" ;
VAL_TABLE_ Sig7819 0 "RVC Active" 1 "Loss of Arbitration" 2 "Unknown" ;
VAL_TABLE_ ElecShfPriLoManSeltnIndReq 0 "No Indication" 1 "Low" 2 "Manual" ;
VAL_TABLE_ DrLckLRStsAuth 0 "Unknown" 1 "Locked" 2 "Unlocked" ;
VAL_TABLE_ DrLckLFStsAuth 0 "Unknown" 1 "Locked" 2 "Unlocked" ;
VAL_TABLE_ CntrStckDispFlrIndOn 0 "FALSE" 1 "TRUE" ;
VAL_TABLE_ ICMCstChgSetReq 0 "No Action" 1 "Off" 2 "Alert" 3 "Alert Brake" 4 "Alert Brake Steer" ;
VAL_TABLE_ PrplDispExtndCpbltyLvlPct_DuD 0 "FALSE" 1 "TRUE" ;
VAL_TABLE_ Sig7636 0 "No Request" 1 "Reset Request Active" ;
VAL_TABLE_ CrnrLmpRtCmndOn 0 "FALSE" 1 "TRUE" ;
VAL_TABLE_ CrnrLmpLtCmndOn 0 "FALSE" 1 "TRUE" ;
VAL_TABLE_ DrLckRRStsAuth 0 "Unknown" 1 "Locked" 2 "Unlocked" ;
VAL_TABLE_ DrLckRFStsAuth 0 "Unknown" 1 "Locked" 2 "Unlocked" ;
VAL_TABLE_ DMSDrwIntnWrnDrvrResp 0 "No Action" 1 "Dismiss" ;
VAL_TABLE_ E44SftBtnSeltdStatRw 0 "Not_Pressed" 1 "Pressed" 2 "Unknown" 3 "Failed" ;
VAL_TABLE_ FrtCmptShftrLckReqd 0 "FALSE" 1 "TRUE" ;
VAL_TABLE_ VirtCtlVehEmrgOffSwReqd 0 "FALSE" 1 "TRUE" ;
VAL_TABLE_ VirtCtlVehOffSwReq 0 "Not Pressed" 1 "Pressed" 2 "Press and Hold" ;
VAL_TABLE_ DrMtzdStBltUnIndOn 0 "FALSE" 1 "TRUE" ;
VAL_TABLE_ ICMCstAvlFlg5 0 "FALSE" 1 "TRUE" ;
VAL_TABLE_ ICMCstAvlFlg4 0 "FALSE" 1 "TRUE" ;
VAL_TABLE_ ICMCstAvlFlg3 0 "FALSE" 1 "TRUE" ;
VAL_TABLE_ ICMCstAvlFlg2 0 "FALSE" 1 "TRUE" ;
VAL_TABLE_ ICMCstAvlFlg1 0 "FALSE" 1 "TRUE" ;
VAL_TABLE_ ICMCstSelCstCurSetVal 0 "Setting Unknown" 1 "Off" 2 "Alert" 3 "Alert Brake" 4 "Alert Brake Steer" ;
VAL_TABLE_ ICMCstSelCstSetAval 0 "FALSE" 1 "TRUE" ;
VAL_TABLE_ ICMCstAvlFlg7 0 "FALSE" 1 "TRUE" ;
VAL_TABLE_ ICMCstAvlFlg6 0 "FALSE" 1 "TRUE" ;
VAL_TABLE_ Sig2582 0 "FALSE" 1 "TRUE" ;
VAL_TABLE_ PrplSysSecAxlTrqReqStsChsSys 0 "No Request" 1 "Request Honored" 2 "Lost Arbitration" 3 "Serial Data Failure Temporary" 4 "Serial Data Failure Permanent" 5 "Control System Failure Temporary" 6 "Control System Failure Permanent" ;
VAL_TABLE_ Sig2659 0 "FALSE" 1 "TRUE" ;
VAL_TABLE_ NavRteChgOcc 0 "FALSE" 1 "TRUE" ;
VAL_TABLE_ NavRteSts 0 "No Action" 1 "Inactive" 2 "Active" 3 "Predicted" 4 "Learned" ;
VAL_TABLE_ NextChrgDestSts 0 "No Action" 1 "Charge Not Planned" 2 "Charge Planned" 3 "Charge Location Reached" ;
VAL_TABLE_ RegnOnDmndActv 0 "FALSE" 1 "TRUE" ;
VAL_TABLE_ OnePedDrvMdDrvrSeltnEnbld 0 "FALSE" 1 "TRUE" ;
VAL_TABLE_ SDGE44RS_CntrLtSd 0 "OFF" 1 "FAILED" 2 "BLOCKED" 3 "ATTACHED_OBJECT" 4 "NO_OBJECT" 5 "ZONE_1" 6 "ZONE_2" 7 "ZONE_3" 8 "ZONE_4" 9 "ZONE_5" 10 "ZONE_6" 11 "OFF_NO_FAULT" 12 "RESERVED_1" 13 "RESERVED_2" 14 "RESERVED_3" ;
VAL_TABLE_ SuprRmtPrkPwrWndsClsReqd 0 "FALSE" 1 "TRUE" ;
VAL_TABLE_ SuprRmtPrkKyFbSrchReqd 0 "FALSE" 1 "TRUE" ;
VAL_TABLE_ SuprRmtPrkStEntExtMemReq 0 "No Request" 1 "Seat Entry" 2 "Seat Exit" 3 "Stop Movement" ;
VAL_TABLE_ SuprRmtPrkSdMirFoldUnfldReq 0 "No Request" 1 "Fold" 2 "Unfold" ;
VAL_TABLE_ SDGE44RS_FrtLtSd 0 "OFF" 1 "FAILED" 2 "BLOCKED" 3 "ATTACHED_OBJECT" 4 "NO_OBJECT" 5 "ZONE_1" 6 "ZONE_2" 7 "ZONE_3" 8 "ZONE_4" 9 "ZONE_5" 10 "ZONE_6" 11 "OFF_NO_FAULT" 12 "RESERVED_1" 13 "RESERVED_2" 14 "RESERVED_3" ;
VAL_TABLE_ SDGE44RS_CntrRtSd 0 "OFF" 1 "FAILED" 2 "BLOCKED" 3 "ATTACHED_OBJECT" 4 "NO_OBJECT" 5 "ZONE_1" 6 "ZONE_2" 7 "ZONE_3" 8 "ZONE_4" 9 "ZONE_5" 10 "ZONE_6" 11 "OFF_NO_FAULT" 12 "RESERVED_1" 13 "RESERVED_2" 14 "RESERVED_3" ;
VAL_TABLE_ SDGE44RS_RrLtSd 0 "OFF" 1 "FAILED" 2 "BLOCKED" 3 "ATTACHED_OBJECT" 4 "NO_OBJECT" 5 "ZONE_1" 6 "ZONE_2" 7 "ZONE_3" 8 "ZONE_4" 9 "ZONE_5" 10 "ZONE_6" 11 "OFF_NO_FAULT" 12 "RESERVED_1" 13 "RESERVED_2" 14 "RESERVED_3" ;
VAL_TABLE_ SDGE44RS_FrtRtSd 0 "OFF" 1 "FAILED" 2 "BLOCKED" 3 "ATTACHED_OBJECT" 4 "NO_OBJECT" 5 "ZONE_1" 6 "ZONE_2" 7 "ZONE_3" 8 "ZONE_4" 9 "ZONE_5" 10 "ZONE_6" 11 "OFF_NO_FAULT" 12 "RESERVED_1" 13 "RESERVED_2" 14 "RESERVED_3" ;
VAL_TABLE_ PrkAsstTrHtchPsntCstCrStVal 0 "SETTING_UNKNOWN" 1 "OFF_NOT_ATTACHED" 2 "ON_ATTACHED" 3 "RESERVED_3" 4 "RESERVED_4" 5 "RESERVED_5" 6 "RESERVED_6" 7 "RESERVED_7" ;
VAL_TABLE_ SDGE44RS_RrRtSd 0 "OFF" 1 "FAILED" 2 "BLOCKED" 3 "ATTACHED_OBJECT" 4 "NO_OBJECT" 5 "ZONE_1" 6 "ZONE_2" 7 "ZONE_3" 8 "ZONE_4" 9 "ZONE_5" 10 "ZONE_6" 11 "OFF_NO_FAULT" 12 "RESERVED_1" 13 "RESERVED_2" 14 "RESERVED_3" ;
VAL_TABLE_ PrkAsstTrHtchPsntCstStAvl 0 "FALSE" 1 "TRUE" ;
VAL_TABLE_ PrkAsstONOFFCstStAvl 0 "FALSE" 1 "TRUE" ;
VAL_TABLE_ CGMERDTC_SysDes 0 "P0-Powertrain Codes SAE Controlled" 1 "P1-Powertrain Codes MFG Controlled" 2 "P2-Powertrain Codes Reserved" 3 "P3-Powertrain Codes Reserved" 4 "C0-Chassis Codes SAE Controlled" 5 "C1-Chassis Codes MFG Controlled" 6 "C2-Chassis Codes Reserved" 7 "C3-Chassis Codes Reserved" 8 "B0-Body Codes SAE Controlled" 9 "B1-Body Codes MFG Controlled" 10 "B2-Body Codes Reserved" 11 "B3-Body Codes Reserved" 12 "U0-Network Codes SAE Controlled" 13 "U1-Network Codes MFG Controlled" 14 "U2- Network Codes Reserved" 15 "U3-Network Codes Reserved" ;
VAL_TABLE_ CGMEmsRltMlfAtv 0 "FALSE" 1 "TRUE" ;
VAL_TABLE_ PIMRI_CGM_PrmntDTCInd 0 "FALSE" 1 "TRUE" ;
VAL_TABLE_ PIMRI_CGM_FltsPrsntInd 0 "FALSE" 1 "TRUE" ;
VAL_TABLE_ Sig7635 0 "FALSE" 1 "TRUE" ;
VAL_TABLE_ PrplSysWhlFlrCtlPriAxlActv 0 "FALSE" 1 "TRUE" ;
VAL_TABLE_ PrplSysPriAxlLtTrqActl_Inv 0 "FALSE" 1 "TRUE" ;
VAL_TABLE_ PrplSysPriAxlRtTrqActl_Inv 0 "FALSE" 1 "TRUE" ;
VAL_TABLE_ PrplSysWhlFlrCtlSecAxlActv 0 "FALSE" 1 "TRUE" ;
VAL_TABLE_ PrplSysWhlFlrCtlPriAxlLtActv 0 "FALSE" 1 "TRUE" ;
VAL_TABLE_ PrplSysWhlFlrCtlPriAxlRtActv 0 "FALSE" 1 "TRUE" ;
VAL_TABLE_ PrkAsstFllFrZn2ChEvntSt 0 "NO_ACTION" 1 "ACTIVE" 2 "CANCEL_CHIME" ;
VAL_TABLE_ PrkAsstFllFrZn1ChEvntSt 0 "NO_ACTION" 1 "ACTIVE" 2 "CANCEL_CHIME" ;
VAL_TABLE_ PrkAsstFlChEvntSt 0 "NO_ACTION" 1 "ACTIVE" 2 "CANCEL_CHIME" ;
VAL_TABLE_ E44MutSts 0 "No Action" 1 "Show Mute" 2 "Show Unmute" ;
VAL_TABLE_ PrkAsstFllFrZn6ChEvntSt 0 "NO_ACTION" 1 "ACTIVE" 2 "CANCEL_CHIME" ;
VAL_TABLE_ PrkAsstFllFrZn5ChEvntSt 0 "NO_ACTION" 1 "ACTIVE" 2 "CANCEL_CHIME" ;
VAL_TABLE_ PrkAsstFllFrZn4ChEvntSt 0 "NO_ACTION" 1 "ACTIVE" 2 "CANCEL_CHIME" ;
VAL_TABLE_ PrkAsstFllFrZn3ChEvntSt 0 "NO_ACTION" 1 "ACTIVE" 2 "CANCEL_CHIME" ;
VAL_TABLE_ PrkAsstFllRrZn4ChEvntSt 0 "NO_ACTION" 1 "ACTIVE" 2 "CANCEL_CHIME" ;
VAL_TABLE_ PrkAsstFllRrZn3ChEvntSt 0 "NO_ACTION" 1 "ACTIVE" 2 "CANCEL_CHIME" ;
VAL_TABLE_ PrkAsstFllRrZn2ChEvntSt 0 "NO_ACTION" 1 "ACTIVE" 2 "CANCEL_CHIME" ;
VAL_TABLE_ PrkAsstFllRrZn1ChEvntSt 0 "NO_ACTION" 1 "ACTIVE" 2 "CANCEL_CHIME" ;
VAL_TABLE_ PrkAsstFrLftSdZn1ChEvntSt 0 "NO_ACTION" 1 "ACTIVE" 2 "CANCEL_CHIME" ;
VAL_TABLE_ PrkAsstFrFrstRprtChEvntSt 0 "NO_ACTION" 1 "ACTIVE" 2 "CANCEL_CHIME" ;
VAL_TABLE_ PrkAsstFllRrZn6ChEvntSt 0 "NO_ACTION" 1 "ACTIVE" 2 "CANCEL_CHIME" ;
VAL_TABLE_ PrkAsstFllRrZn5ChEvntSt 0 "NO_ACTION" 1 "ACTIVE" 2 "CANCEL_CHIME" ;
VAL_TABLE_ PrkAsstFrLftSdZn5ChEvntSt 0 "NO_ACTION" 1 "ACTIVE" 2 "CANCEL_CHIME" ;
VAL_TABLE_ PrkAsstFrLftSdZn4ChEvntSt 0 "NO_ACTION" 1 "ACTIVE" 2 "CANCEL_CHIME" ;
VAL_TABLE_ PrkAsstFrLftSdZn3ChEvntSt 0 "NO_ACTION" 1 "ACTIVE" 2 "CANCEL_CHIME" ;
VAL_TABLE_ PrkAsstFrLftSdZn2ChEvntSt 0 "NO_ACTION" 1 "ACTIVE" 2 "CANCEL_CHIME" ;
VAL_TABLE_ PrkAsstFrRghtSdZn3ChEvntSt 0 "NO_ACTION" 1 "ACTIVE" 2 "CANCEL_CHIME" ;
VAL_TABLE_ PrkAsstFrRghtSdZn2ChEvntSt 0 "NO_ACTION" 1 "ACTIVE" 2 "CANCEL_CHIME" ;
VAL_TABLE_ PrkAsstFrRghtSdZn1ChEvntSt 0 "NO_ACTION" 1 "ACTIVE" 2 "CANCEL_CHIME" ;
VAL_TABLE_ PrkAsstFrLftSdZn6ChEvntSt 0 "NO_ACTION" 1 "ACTIVE" 2 "CANCEL_CHIME" ;
VAL_TABLE_ PrkAsstFrRgrChEvntSt 0 "NO_ACTION" 1 "ACTIVE" 2 "CANCEL_CHIME" ;
VAL_TABLE_ PrkAsstFrRghtSdZn6ChEvntSt 0 "NO_ACTION" 1 "ACTIVE" 2 "CANCEL_CHIME" ;
VAL_TABLE_ PrkAsstFrRghtSdZn5ChEvntSt 0 "NO_ACTION" 1 "ACTIVE" 2 "CANCEL_CHIME" ;
VAL_TABLE_ PrkAsstFrRghtSdZn4ChEvntSt 0 "NO_ACTION" 1 "ACTIVE" 2 "CANCEL_CHIME" ;
VAL_TABLE_ PrkAsstRrLftSdZn3ChEvntSt 0 "NO_ACTION" 1 "ACTIVE" 2 "CANCEL_CHIME" ;
VAL_TABLE_ PrkAsstRrLftSdZn2ChEvntSt 0 "NO_ACTION" 1 "ACTIVE" 2 "CANCEL_CHIME" ;
VAL_TABLE_ PrkAsstRrLftSdZn1ChEvntSt 0 "NO_ACTION" 1 "ACTIVE" 2 "CANCEL_CHIME" ;
VAL_TABLE_ PrkAsstRrFrstRprtChEvntSt 0 "NO_ACTION" 1 "ACTIVE" 2 "CANCEL_CHIME" ;
VAL_TABLE_ PrkAsstRrRghtSdZn1ChEvntSt 0 "NO_ACTION" 1 "ACTIVE" 2 "CANCEL_CHIME" ;
VAL_TABLE_ PrkAsstRrLftSdZn6ChEvntSt 0 "NO_ACTION" 1 "ACTIVE" 2 "CANCEL_CHIME" ;
VAL_TABLE_ PrkAsstRrLftSdZn5ChEvntSt 0 "NO_ACTION" 1 "ACTIVE" 2 "CANCEL_CHIME" ;
VAL_TABLE_ PrkAsstRrLftSdZn4ChEvntSt 0 "NO_ACTION" 1 "ACTIVE" 2 "CANCEL_CHIME" ;
VAL_TABLE_ PrkAsstRrRghtSdZn5ChEvntSt 0 "NO_ACTION" 1 "ACTIVE" 2 "CANCEL_CHIME" ;
VAL_TABLE_ PrkAsstRrRghtSdZn4ChEvntSt 0 "NO_ACTION" 1 "ACTIVE" 2 "CANCEL_CHIME" ;
VAL_TABLE_ PrkAsstRrRghtSdZn3ChEvntSt 0 "NO_ACTION" 1 "ACTIVE" 2 "CANCEL_CHIME" ;
VAL_TABLE_ PrkAsstRrRghtSdZn2ChEvntSt 0 "NO_ACTION" 1 "ACTIVE" 2 "CANCEL_CHIME" ;
VAL_TABLE_ PrkAsstRrRgrChEvntSt 0 "NO_ACTION" 1 "ACTIVE" 2 "CANCEL_CHIME" ;
VAL_TABLE_ PrkAsstRrRghtSdZn6ChEvntSt 0 "NO_ACTION" 1 "ACTIVE" 2 "CANCEL_CHIME" ;
VAL_TABLE_ SuprRmtPrkWrnIndReq 0 "Off" 1 "Searching Parallel Right" 2 "Searching Parallel Left" 3 "Searching Cross Right" 4 "Searching Cross Left" 5 "Spot Found" 6 "Spot Found Parallel Left" 7 "Spot Found Cross Left" 8 "Spot Found Parallel Right" 9 "Spot Found Cross Right" 10 "Move Ahead" 11 "Move Ahead Parallel Left" 12 "Move Ahead Cross Left" 13 "Move Ahead Parallel Right" 14 "Move Ahead Cross Right" 15 "Stop And R Parallel Left" 16 "Stop And R Cross Back Left" 17 "Stop And R Cross Front Left" 18 "Stop And R Parallel Right" 19 "Stop And R Cross Back Right" 20 "Stop And R Cross Front Right" 21 "Search Speed Warning" 22 "Search Deactivated" 23 "Exit Park To Left" 24 "Exit Park To Right" 25 "Select Drive GEAR" 26 "Auto Steering Active" 27 "Auto Parking Active" 28 "Drive Backward" 29 "Backward Move" 30 "Drive Forward" 31 "Forward Move" 32 "Stop" 33 "Shifting" 34 "Position Reached" 35 "Take Control" 36 "ParkIng Complete" 37 "Exit Park Complete" 38 "Deactivated" 39 "Canceled General" 40 "Canceled Moves" 41 "Canceled Speed" 42 "Canceled Interference" 43 "Canceled Exit Park" 44 "Stopping" 45 "Auto Parking Complete" 46 "Release Brake" 47 "In Vehicle Or Remote" 48 "Remote Stay Alert" 49 "Remote Connecting" 50 "Remote Cannot Connect" 51 "Remote No Device" 52 "Remote Shift To Park" 53 "Remote Retry" 54 "Remote Canceled Range" 55 "Remote Canceled Supervision" 56 "Remote Canceled ConnectIon" 57 "Remote Paused Range" 58 "Remote Paused Supervision" 59 "Remote Paused ConnectIon" 60 "Search Drawer Exit" 61 "Search Drawer Park" 62 "Spot Selection Accept" 63 "Unable To Connect" 64 "Cancel Door" 65 "Pause Obstruction" 66 "Cancel Obstruction" 67 "No Exit Spot Found" 68 "Handshake Failure" 69 "Failed To Engage" 70 "Fasten Seatbelt" ;
VAL_TABLE_ SuprRmtPrkDctvSftBtnReq 0 "Hidden" 1 "Disabled" 2 "Enabled" 3 "Highlighted" ;
VAL_TABLE_ SuprRmtPrkFcsReq 0 "No Request" 1 "Focus Request IPC" 2 "Focus Request CSM" 3 "Focus Request VCU" ;
VAL_TABLE_ SuprRmtPrkAutoStrgIconReq 0 "No Icon" 1 "Active" 2 "Deactivated" ;
VAL_TABLE_ RE44RS_LtCntr 0 "OFF" 1 "FAILED" 2 "BLOCKED" 3 "ATTACHED_OBJECT" 4 "NO_OBJECT" 5 "ZONE_1" 6 "ZONE_2" 7 "ZONE_3" 8 "ZONE_4" 9 "ZONE_5" 10 "ZONE_6" 11 "OFF_NO_FAULT" 12 "RESERVED_1" 13 "RESERVED_2" 14 "RESERVED_3" ;
VAL_TABLE_ RE44RS_Lt 0 "OFF" 1 "FAILED" 2 "BLOCKED" 3 "ATTACHED_OBJECT" 4 "NO_OBJECT" 5 "ZONE_1" 6 "ZONE_2" 7 "ZONE_3" 8 "ZONE_4" 9 "ZONE_5" 10 "ZONE_6" 11 "OFF_NO_FAULT" 12 "RESERVED_1" 13 "RESERVED_2" 14 "RESERVED_3" ;
VAL_TABLE_ RE44RS_RtCntr 0 "OFF" 1 "FAILED" 2 "BLOCKED" 3 "ATTACHED_OBJECT" 4 "NO_OBJECT" 5 "ZONE_1" 6 "ZONE_2" 7 "ZONE_3" 8 "ZONE_4" 9 "ZONE_5" 10 "ZONE_6" 11 "OFF_NO_FAULT" 12 "RESERVED_1" 13 "RESERVED_2" 14 "RESERVED_3" ;
VAL_TABLE_ RE44RS_Rt 0 "OFF" 1 "FAILED" 2 "BLOCKED" 3 "ATTACHED_OBJECT" 4 "NO_OBJECT" 5 "ZONE_1" 6 "ZONE_2" 7 "ZONE_3" 8 "ZONE_4" 9 "ZONE_5" 10 "ZONE_6" 11 "OFF_NO_FAULT" 12 "RESERVED_1" 13 "RESERVED_2" 14 "RESERVED_3" ;
VAL_TABLE_ HVBCC_DyOfWk 0 "Unknown" 1 "Sunday" 2 "Monday" 3 "Tuesday" 4 "Wednesday" 5 "Thursday" 6 "Friday" 7 "Saturday" ;
VAL_TABLE_ HVBCC_TmDispFormat 0 "No Action" 1 "Display Complete Time" 2 "Display Minutes to Complete" ;
VAL_TABLE_ HVBCC_MinRmn_DuD 0 "FALSE" 1 "TRUE" ;
VAL_TABLE_ HVBCC_TmDispPwrLvl 0 "Unknown" 1 "Level 1" 2 "Level 2" 3 "DC" 4 "Wireless" ;
VAL_TABLE_ Sig0101 0 "FALSE" 1 "TRUE" ;
VAL_TABLE_ DMSDrwDrvrCstSetAval 0 "FALSE" 1 "TRUE" ;
VAL_TABLE_ DMSDrwDrvrCstAvlFlg7 0 "FALSE" 1 "TRUE" ;
VAL_TABLE_ DMSDrwDrvrCstAvlFlg6 0 "FALSE" 1 "TRUE" ;
VAL_TABLE_ DMSDrwDrvrCstAvlFlg5 0 "FALSE" 1 "TRUE" ;
VAL_TABLE_ DMSDrwDrvrCstAvlFlg4 0 "FALSE" 1 "TRUE" ;
VAL_TABLE_ DMSDrwDrvrCstAvlFlg3 0 "FALSE" 1 "TRUE" ;
VAL_TABLE_ DMSDrwDrvrCstAvlFlg2 0 "FALSE" 1 "TRUE" ;
VAL_TABLE_ DMSDrwDrvrCstAvlFlg1 0 "FALSE" 1 "TRUE" ;
VAL_TABLE_ DMSIntnDrvrCstSetAval 0 "FALSE" 1 "TRUE" ;
VAL_TABLE_ DMSIntnDrvrCstAvlFlg7 0 "FALSE" 1 "TRUE" ;
VAL_TABLE_ DMSIntnDrvrCstAvlFlg6 0 "FALSE" 1 "TRUE" ;
VAL_TABLE_ DMSIntnDrvrCstAvlFlg5 0 "FALSE" 1 "TRUE" ;
VAL_TABLE_ DMSIntnDrvrCstAvlFlg4 0 "FALSE" 1 "TRUE" ;
VAL_TABLE_ DMSIntnDrvrCstAvlFlg3 0 "FALSE" 1 "TRUE" ;
VAL_TABLE_ DMSIntnDrvrCstAvlFlg2 0 "FALSE" 1 "TRUE" ;
VAL_TABLE_ DMSIntnDrvrCstAvlFlg1 0 "FALSE" 1 "TRUE" ;
VAL_TABLE_ DMSDrwIntnDrvrDtnAlrtMutReqd 0 "FALSE" 1 "TRUE" ;
VAL_TABLE_ DMSDrwIntnDrvrLvl1ChmEvntStat 0 "No Action" 1 "Active" 2 "Cancel Chime" ;
VAL_TABLE_ DMSDrwIntnDrvrLvl2ChmEvntStat 0 "No Action" 1 "Active" 2 "Cancel Chime" ;
VAL_TABLE_ DMSDrwDrvrCstCurrSetVal 0 "Setting Unknown" 1 "Off" 2 "Normal" 3 "Low Sensitivity" ;
VAL_TABLE_ DMSDrwIntnDrvrWrnIndReq 0 "No Indication" 1 "Level 1" 2 "Level 2" 3 "Level 3" 4 "Level 4a" 5 "Level 4b" 6 "Level 4c" 7 "Inattentive Alert" 8 "Drowsy Off" 9 "Inattentive Off" 10 "Failed" 11 "Unavailable" ;
VAL_TABLE_ DMSDrwDrvrIndReq 0 "Indicator Off" 1 "White Indicator" 2 "Green Indicator" 3 "Amber Indicator" 4 "Amber Flashing Indicator" 5 "Red Indicator" ;
VAL_TABLE_ DMSDrwDrvrDispLvl 0 "No Indication" 1 "4 bars" 2 "3 bars" 3 "2 bars" 4 "1 bar" 5 "1 bar pulse" ;
VAL_TABLE_ DMSIntnDrvrIndReq 0 "Indicator Off" 1 "White Indicator" 2 "Green Indicator" 3 "Amber Indicator" 4 "Amber Flashing Indicator" 5 "Red Indicator" ;
VAL_TABLE_ DMSIntnDrvrDispLvl 0 "No Indication" 1 "4 bars" 2 "3 bars" 3 "2 bars" 4 "1 bar" 5 "1 bar pulse" ;
VAL_TABLE_ DMSIntnDrvrCstCurrSetVal 0 "Setting Unknown" 1 "Off" 2 "On" ;
VAL_TABLE_ DMSTnDrvrDrwIntnOffUnvIndOn 0 "FALSE" 1 "TRUE" ;
VAL_TABLE_ DMSIntnDrvrDispFcsInd 0 "Unknown" 1 "Off Road" 2 "On Road" ;
VAL_TABLE_ DMSDrwIntnDrvrDtnMtzdStBltPulRq 0 "No Action" 1 "Tug Profile 1" ;
VAL_TABLE_ VehDynsTkDtctSts 0 "No Detection" 1 "Track1" 2 "Track2" ;
VAL_TABLE_ PrkAsstTrHtchPsntCstAvlFlg1 0 "FALSE" 1 "TRUE" ;
VAL_TABLE_ PrkAsstONOFFCstAvlFlg7 0 "FALSE" 1 "TRUE" ;
VAL_TABLE_ PrkAsstONOFFCstAvlFlg6 0 "FALSE" 1 "TRUE" ;
VAL_TABLE_ PrkAsstONOFFCstAvlFlg5 0 "FALSE" 1 "TRUE" ;
VAL_TABLE_ PrkAsstONOFFCstAvlFlg4 0 "FALSE" 1 "TRUE" ;
VAL_TABLE_ PrkAsstONOFFCstAvlFlg3 0 "FALSE" 1 "TRUE" ;
VAL_TABLE_ PrkAsstONOFFCstAvlFlg2 0 "FALSE" 1 "TRUE" ;
VAL_TABLE_ PrkAsstONOFFCstAvlFlg1 0 "FALSE" 1 "TRUE" ;
VAL_TABLE_ PrkAsstTrHtchPsntCstAvlFlg7 0 "FALSE" 1 "TRUE" ;
VAL_TABLE_ PrkAsstTrHtchPsntCstAvlFlg6 0 "FALSE" 1 "TRUE" ;
VAL_TABLE_ PrkAsstTrHtchPsntCstAvlFlg5 0 "FALSE" 1 "TRUE" ;
VAL_TABLE_ PrkAsstTrHtchPsntCstAvlFlg4 0 "FALSE" 1 "TRUE" ;
VAL_TABLE_ PrkAsstTrHtchPsntCstAvlFlg3 0 "FALSE" 1 "TRUE" ;
VAL_TABLE_ PrkAsstTrHtchPsntCstAvlFlg2 0 "FALSE" 1 "TRUE" ;
VAL_TABLE_ ALCGI_VehTopSpdLimReqTyp 0 "Inactive" 1 "Faulted" 2 "Safety_woBrake" 3 "Safety_wBrake" 4 "OBD" 5 "nonOBD" 6 "Legislated" ;
VAL_TABLE_ ALCGI_RideHghtESCEnblReqd 0 "FALSE" 1 "TRUE" ;
VAL_TABLE_ VLCGI_4CrnrLvlTopSpdLimReqTyp 0 "Inactive" 1 "Faulted" 2 "Safety_woBrake" 3 "Safety_wBrake" 4 "OBD" 5 "nonOBD" 6 "Legislated" ;
VAL_TABLE_ VLCGI_4CrnrLvlESCEnblReqd 0 "FALSE" 1 "TRUE" ;
VAL_TABLE_ RrwdImpMtgnAval 0 "FALSE" 1 "TRUE" ;
VAL_TABLE_ SBMERDTC_SysDes 0 "P0_Powertrain Codes SAE Controlled" 1 "P1_Powertrain Codes MFG Controlled" 2 "P2_Powertrain Codes Reserved" 3 "P3_Powertrain Codes Reserved" 4 "C0_Chassis Codes SAE Controlled" 5 "C1_Chassis Codes MFG Controlled" 6 "C2_Chassis Codes Reserved" 7 "C3_Chassis Codes Reserved" 8 "B0_Body Codes SAE Controlled" 9 "B1_Body Codes MFG Controlled" 10 "B2_Body Codes Reserved" 11 "B3_Body Codes Reserved" 12 "U0_Network Codes SAE Controlled" 13 "U1_Network Codes MFG Controlled" 14 "U2_Network Codes Reserved" 15 "U3_Network Codes Reserved" ;
VAL_TABLE_ PIMRI_SBM_PrmntDTCInd 0 "FALSE" 1 "TRUE" ;
VAL_TABLE_ PIMRI_SBM_FltsPrsntInd 0 "FALSE" 1 "TRUE" ;
VAL_TABLE_ SBMEmsRltMlfAtv 0 "FALSE" 1 "TRUE" ;
VAL_TABLE_ RrClsrAjrStat 0 "FALSE" 1 "TRUE" ;
VAL_TABLE_ RrClsrAjrStat_Inv 0 "FALSE" 1 "TRUE" ;
VAL_TABLE_ CldrMth 0 "Unknown" 1 "January" 2 "February" 3 "March" 4 "April" 5 "May" 6 "June" 7 "July" 8 "August" 9 "September" 10 "October" 11 "November" 12 "December" ;
VAL_TABLE_ TODCSR_ChrgSchedDyOfWkReq 0 "No Action" 1 "Sunday" 2 "Monday" 3 "Tuesday" 4 "Wednesday" 5 "Thursday" 6 "Friday" 7 "Saturday" 8 "All Days Same" 9 "Monday to Friday Same" 10 "Saturday and Sunday Same" ;
VAL_TABLE_ TODCSR_ChrgSchedCstSetReq 0 "No Action" 1 "Off" 2 "On" ;
VAL_TABLE_ TODCSR_ERSPrdDyReq 0 "No Action" 1 "Weekday 1" 2 "Weekday 2" 3 "Weekday 3" 4 "Weekday 4" 5 "Weekday 5" 6 "Weekend 1" 7 "Weekend 2" 8 "Weekend 3" 9 "Weekend 4" 10 "Weekend 5" ;
VAL_TABLE_ TODCSR_ERSCstSetReq 0 "No Action" 1 "Off" 2 "On" ;
VAL_TABLE_ TODCSR_ERSPrdLvlReq 0 "No Action" 1 "Low Rate" 2 "Medium Rate" 3 "High Rate" 4 "Reserved 1" 5 "Invalid Rate" ;
VAL_TABLE_ PrtblChrgCordLimCstSetReq 0 "No Action" 1 "Reduced" 2 "Maximum" ;
VAL_TABLE_ TODCSR_ERSPrfReq 0 "No Action" 1 "Low Rate" 2 "Medium Rate" 3 "High Rate" ;
VAL_TABLE_ TODCCbnPrcndtngSetReq 0 "No Action" 1 "Off" 2 "On" ;
VAL_TABLE_ TODCSR_LocNumReq 0 "No Action" 1 "Not in Stored Location" 2 "Stored Location 1" 3 "Stored Location 2" 4 "Stored Location 3" 5 "Stored Location 4" ;
VAL_TABLE_ TODCSR_LocChrgPwrLvlReq 0 "Unknown" 1 "Level 1" 2 "Level 2" 3 "DC" 4 "Wireless" ;
VAL_TABLE_ Sig0087 0 "FALSE" 1 "TRUE" ;

BA_DEF_ SG_  "SignalType" STRING ;
BA_DEF_ SG_  "SignalLongName" STRING ;
BA_DEF_ BO_  "GenMsgCycleTime" INT 0 10000;
BA_DEF_ BO_  "GenMsgSendType" ENUM "cyclicX","spontanX","cyclicIfActiveX","spontanWithDelay","cyclicAndSpontanX","cyclicAndSpontanWithDelay","spontanWithRepetition","cyclicIfActiveAndSpontanWD";
BA_DEF_ BO_  "VFrameFormat" ENUM  "StandardCAN","ExtendedCAN","reserved","reserved","reserved","reserved","reserved","reserved","reserved","reserved","reserved","reserved","reserved","reserved","StandardCAN_FD","ExtendedCAN_FD";
BA_DEF_DEF_  "SignalType" "";
BA_DEF_DEF_  "SignalLongName" "";
BA_DEF_DEF_  "GenMsgCycleTime" 0;
BA_DEF_DEF_  "GenMsgSendType" "cyclicX";
BA_DEF_DEF_  "VFrameFormat" "StandardCAN";
